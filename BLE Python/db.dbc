VERSION ""

NS_ :

BS_:

BU_: CANNode

BO_ 255 lockstatus: 1 CANNode
 SG_ lockstatus : 4|5@0- (1,0) [0|0] ""  CANNode

BA_DEF_  "BusType" STRING ;
BA_DEF_DEF_  "BusType" "CAN";
