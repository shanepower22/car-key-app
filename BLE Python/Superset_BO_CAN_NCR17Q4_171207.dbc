VERSION "BO_HSCAN"

NS_ :

BS_:

BU_: BCM_Gp CCF_Server DDM DRDM DSM FTCM FTCMB GWM LPDM PDM PRDM PSM RFA RGTM RGTMB RLSM RPDM RRSM TBM TSTR VIM Virtual_Node WDCM Vector_XXX

BO_ 1944 TST_PhysicalRespFTCMB_BOCAN: 8 FTCMB
 SG_ TesterPhysicalResFTCMB : 7|64@0+ (1,0) [0|1.84467440737096E+019] ""  Vector_XXX

BO_ 1849 TST_PhysicalRespKVM_BOCAN: 8 RFA
 SG_ TesterPhysicalResKVM : 7|64@0+ (1,0) [0|1.84467440737096E+019] ""  GWM

BO_ 2025 TST_PhysicalRespLPDM_BOCAN: 8 LPDM
 SG_ TesterPhysicalResLPDM : 7|64@0+ (1,0) [0|1.84467440737096E+019] ""  Vector_XXX

BO_ 1865 TST_PhysicalRespPDM_BOCAN_ASAR: 8 PDM

BO_ 1867 TST_PhysicalRespPRDM_BOCAN_ASAR: 8 PRDM

BO_ 1963 TST_PhysicalRespPSM_BOCAN: 8 PSM
 SG_ TesterPhysicalResPSM : 7|64@0+ (1,0) [0|1.84467440737096E+019] ""  GWM

BO_ 1917 TST_PhysicalRespRGTM_BOCAN: 8 RGTM
 SG_ TesterPhysicalResRGTM : 7|64@0+ (1,0) [0|1.84467440737096E+019] ""  GWM

BO_ 1982 TST_PhysicalRespRGTMB_BOCAN: 8 RGTMB
 SG_ TesterPhysicalResRGTMB : 7|64@0+ (1,0) [0|1.84467440737096E+019] ""  GWM

BO_ 1802 TST_PhysicalRespRLSM_BOCAN: 8 RLSM
 SG_ TesterPhysicalResRLSM : 7|64@0+ (1,0) [0|1.84467440737096E+019] ""  GWM

BO_ 2024 TST_PhysicalRespRPDM_BOCAN: 8 RPDM
 SG_ TesterPhysicalResRPDM : 7|64@0+ (1,0) [0|1.84467440737096E+019] ""  GWM

BO_ 1899 TST_PhysicalRespRRSM_BOCAN: 8 RRSM
 SG_ TesterPhysicalResRRSM : 7|64@0+ (1,0) [0|1.84467440737096E+019] ""  GWM

BO_ 1887 TST_PhysicalRespTBM_BOCAN: 8 TBM
 SG_ TesterPhysicalResTBM : 7|64@0+ (1,0) [0|1.84467440737096E+019] ""  GWM

BO_ 1834 TST_PhysicalRespVIM_BOCAN: 8 VIM
 SG_ TesterPhysicalResVIM : 7|64@0+ (1,0) [0|1.84467440737096E+019] ""  GWM

BO_ 1807 TST_PhysicalRespWDCM_BOCAN: 8 WDCM
 SG_ TesterPhysicalResWDCM : 7|64@0+ (1,0) [0|1.84467440737096E+019] ""  GWM

BO_ 1024 VEHCONFIG_400BO: 8 GWM
 SG_ VehicleConfParameters : 7|64@0+ (1,0) [0|1.84467440737096E+019] ""  BCM_Gp,DSM,FTCM,LPDM,PSM,RFA,RGTM,RGTMB,RLSM,RPDM,RRSM,TBM,WDCM

BO_ 1025 VEHCONFIG_400BO_AutoSAR: 8 CCF_Server
 SG_ SF_VEHCONFIG_400BO_AutoSAR_PDU M : 0|8@1+ (1,0) [0|255] ""  Vector_XXX,DRDM,PRDM,PDM,DDM
 SG_ CcfAlternator m1 : 63|8@0+ (1,0) [0|255] ""  Vector_XXX
 SG_ CcfBifuel m1 : 39|8@0+ (1,0) [0|255] ""  Vector_XXX
 SG_ CcfDoors m1 : 23|8@0+ (1,0) [0|255] ""  DDM,DRDM,PDM,PRDM
 SG_ CcfEngine m1 : 47|8@0+ (1,0) [0|255] ""  Vector_XXX
 SG_ CcfFuel m1 : 55|8@0+ (1,0) [0|255] ""  Vector_XXX
 SG_ CcfTransmissionDriveLn m1 : 31|8@0+ (1,0) [0|255] ""  Vector_XXX
 SG_ CcfVehicleType m1 : 15|8@0+ (1,0) [0|255] ""  DDM,DRDM,PDM,PRDM
 SG_ CcfAlarm m2 : 47|8@0+ (1,0) [0|255] ""  Vector_XXX
 SG_ CcfFuelTankVolume m2 : 39|8@0+ (1,0) [0|255] ""  Vector_XXX
 SG_ CcfGearbox m2 : 23|8@0+ (1,0) [0|255] ""  Vector_XXX
 SG_ CcfGearboxType m2 : 31|8@0+ (1,0) [0|255] ""  DDM,DRDM,PDM,PRDM
 SG_ CcfHeadlightsType m2 : 63|8@0+ (1,0) [0|255] ""  Vector_XXX
 SG_ CcfSeatMassage m2 : 55|8@0+ (1,0) [0|255] ""  Vector_XXX
 SG_ CcfSteeringWheelPosn m2 : 15|8@0+ (1,0) [0|255] ""  DDM,DRDM,PDM,PRDM
 SG_ CcfAckSignalLockAlarm m5 : 31|8@0+ (1,0) [0|255] ""  Vector_XXX
 SG_ CcfAutoLockingBySpeed m5 : 39|8@0+ (1,0) [0|255] ""  Vector_XXX
 SG_ CcfChildLockRearDrs m5 : 15|8@0+ (1,0) [0|255] ""  DDM,DRDM,PDM,PRDM
 SG_ CcfKeyLockProtection2EXT m5 : 55|8@0+ (1,0) [0|255] ""  Vector_XXX
 SG_ CcfKeyLockProtectionINT m5 : 63|8@0+ (1,0) [0|255] ""  Vector_XXX
 SG_ CcfLevelSensorIfAlarm m5 : 47|8@0+ (1,0) [0|255] ""  Vector_XXX
 SG_ CcfUnlockSetting m5 : 23|8@0+ (1,0) [0|255] ""  Vector_XXX
 SG_ CcfBatteryRear m6 : 47|8@0+ (1,0) [0|255] ""  Vector_XXX
 SG_ CcfBlindSpotInfoSystem m6 : 23|8@0+ (1,0) [0|255] ""  DDM,DRDM,PDM,PRDM
 SG_ CcfClimateControlUnit m6 : 63|8@0+ (1,0) [0|255] ""  Vector_XXX
 SG_ CcfCoupeFilter m6 : 55|8@0+ (1,0) [0|255] ""  Vector_XXX
 SG_ CcfPanicAlarm m6 : 15|8@0+ (1,0) [0|255] ""  Vector_XXX
 SG_ CcfPPTCHeater m6 : 39|8@0+ (1,0) [0|255] ""  Vector_XXX
 SG_ CcfRoadFrictionDetection m6 : 31|8@0+ (1,0) [0|255] ""  Vector_XXX
 SG_ CcfBrand m9 : 55|8@0+ (1,0) [0|255] ""  DDM,DRDM,PDM,PRDM
 SG_ CcfFreqRemoteControls m9 : 63|8@0+ (1,0) [0|255] ""  Vector_XXX
 SG_ CcfHeatedWindscreen m9 : 23|8@0+ (1,0) [0|255] ""  Vector_XXX
 SG_ CcfHillDescentControl m9 : 39|8@0+ (1,0) [0|255] ""  Vector_XXX
 SG_ CcfParkingAssistance m9 : 31|8@0+ (1,0) [0|255] ""  Vector_XXX
 SG_ CcfParkingBrakeType m9 : 15|8@0+ (1,0) [0|255] ""  Vector_XXX
 SG_ CcfSafetyBeltReminder m9 : 47|8@0+ (1,0) [0|255] ""  Vector_XXX
 SG_ CcfActiveSuspension m12 : 39|8@0+ (1,0) [0|255] ""  Vector_XXX
 SG_ CcfCentralLockType m12 : 55|8@0+ (1,0) [0|255] ""  DDM,DRDM,PDM,PRDM
 SG_ CcfDrivenAxle m12 : 15|8@0+ (1,0) [0|255] ""  Vector_XXX
 SG_ CcfRearWheelType m12 : 23|8@0+ (1,0) [0|255] ""  Vector_XXX
 SG_ CcfSideWindows m12 : 63|8@0+ (1,0) [0|255] ""  DDM,DRDM,PDM,PRDM
 SG_ CcfSteeringGear m12 : 47|8@0+ (1,0) [0|255] ""  Vector_XXX
 SG_ CcfWheelbaseSeries m12 : 31|8@0+ (1,0) [0|255] ""  Vector_XXX
 SG_ CcfAirbagPassengerSide m13 : 47|8@0+ (1,0) [0|255] ""  Vector_XXX
 SG_ CcfAutoLights m13 : 39|8@0+ (1,0) [0|255] ""  Vector_XXX
 SG_ CcfCutoffSwitchPassAirbag m13 : 55|8@0+ (1,0) [0|255] ""  Vector_XXX
 SG_ CcfMemoryFunction m13 : 23|8@0+ (1,0) [0|255] ""  DDM,DRDM,PDM,PRDM
 SG_ CcfPuddleLightOuterMirrors m13 : 31|8@0+ (1,0) [0|255] ""  DDM,DRDM,PDM,PRDM
 SG_ CcfRearViewMirrorsOuter m13 : 15|8@0+ (1,0) [0|255] ""  DDM,DRDM,PDM,PRDM
 SG_ CcfSideAirbagDriver m13 : 63|8@0+ (1,0) [0|255] ""  Vector_XXX
 SG_ CcfAuxiliaryLights m16 : 23|8@0+ (1,0) [0|255] ""  Vector_XXX
 SG_ CcfEmergencyBrakeLight m16 : 15|8@0+ (1,0) [0|255] ""  Vector_XXX
 SG_ CcfInCarEntertainment m16 : 63|8@0+ (1,0) [0|255] ""  Vector_XXX
 SG_ CcfPowerWindows m16 : 39|8@0+ (1,0) [0|255] ""  DDM,DRDM,PDM,PRDM
 SG_ CcfRadioFrequencyBand m16 : 47|8@0+ (1,0) [0|255] ""  DDM,DRDM,PDM,PRDM
 SG_ CcfRoofHatch m16 : 31|8@0+ (1,0) [0|255] ""  Vector_XXX
 SG_ CcfTrimLevel m16 : 55|8@0+ (1,0) [0|255] ""  Vector_XXX
 SG_ CcfPowerHeatedMirrors m21 : 39|8@0+ (1,0) [0|255] ""  DDM,DRDM,PDM,PRDM
 SG_ CcfRearGlazing m21 : 15|8@0+ (1,0) [0|255] ""  Vector_XXX
 SG_ CcfDampSensor m26 : 55|8@0+ (1,0) [0|255] ""  Vector_XXX
 SG_ CcfDoorHandleTechnology m26 : 15|8@0+ (1,0) [0|255] ""  DDM,DRDM,PDM,PRDM
 SG_ CcfMirrorMountTurnSig m28 : 47|8@0+ (1,0) [0|255] ""  DDM,DRDM,PDM,PRDM
 SG_ CcfRearDoorSunblinds m28 : 15|8@0+ (1,0) [0|255] ""  DDM,DRDM,PDM,PRDM
 SG_ Ccf4x4InfoDisplay m33 : 31|8@0+ (1,0) [0|255] ""  Vector_XXX
 SG_ CcfAdvancedChauffeurFunc m33 : 15|8@0+ (1,0) [0|255] ""  Vector_XXX
 SG_ CcfDoorLatchType m33 : 63|8@0+ (1,0) [0|255] ""  DDM,DRDM,PDM,PRDM
 SG_ CcfLowSpdIntEmergBrake m33 : 23|8@0+ (1,0) [0|255] ""  Vector_XXX
 SG_ CcfModelYear m33 : 47|8@0+ (0.25,2009.75) [2010|2073.25] "MY"  Vector_XXX
 SG_ CcfAmbientLighting m35 : 23|8@0+ (1,0) [0|255] ""  DDM,DRDM,PDM,PRDM
 SG_ CcfConnectAndView m35 : 55|8@0+ (1,0) [0|255] ""  Vector_XXX
 SG_ CcfDynamici m35 : 63|8@0+ (1,0) [0|255] ""  Vector_XXX
 SG_ CcfHandbook m35 : 47|8@0+ (1,0) [0|255] ""  Vector_XXX
 SG_ CcfNavigationSpeedInhibit m35 : 31|8@0+ (1,0) [0|255] ""  Vector_XXX
 SG_ CcfPassiveLockErrorTones m35 : 39|8@0+ (1,0) [0|255] ""  Vector_XXX
 SG_ CcfRearDiff m35 : 15|8@0+ (1,0) [0|255] ""  Vector_XXX
 SG_ CcfCameraHMIStrategy m65 : 10|3@0+ (1,0) [0|7] ""  Vector_XXX
 SG_ CcfDeplBatterySystem m65 : 55|2@0+ (1,0) [0|3] ""  Vector_XXX
 SG_ CcfDriverBuckleSwitch m65 : 57|2@0+ (1,0) [0|3] ""  Vector_XXX
 SG_ CcfDriverKneeAirbag m65 : 37|2@0+ (1,0) [0|3] ""  Vector_XXX
 SG_ CcfDriverPassBeltPret m65 : 28|3@0+ (1,0) [0|7] ""  Vector_XXX
 SG_ CcfDriverSwtchLdLimit m65 : 63|2@0+ (1,0) [0|3] ""  Vector_XXX
 SG_ CcfEventDataRecorder m65 : 61|2@0+ (1,0) [0|3] ""  Vector_XXX
 SG_ CcfFntDIFbdkMech m65 : 25|2@0+ (1,0) [0|3] ""  Vector_XXX
 SG_ CcfInfotainmentType m65 : 13|3@0+ (1,0) [0|7] ""  Vector_XXX
 SG_ CcfLeftCurtainAirbag m65 : 51|2@0+ (1,0) [0|3] ""  Vector_XXX
 SG_ CcfLeftRearHeadAbag m65 : 47|2@0+ (1,0) [0|3] ""  Vector_XXX
 SG_ CcfLeftSideAirbag m65 : 35|2@0+ (1,0) [0|3] ""  Vector_XXX
 SG_ CcfmPACOS m65 : 31|3@0+ (1,0) [0|7] ""  Vector_XXX
 SG_ CcfPADLamp m65 : 42|3@0+ (1,0) [0|7] ""  Vector_XXX
 SG_ CcfPassBuckleSwitch m65 : 59|2@0+ (1,0) [0|3] ""  Vector_XXX
 SG_ CcfPassOccWghtSensor m65 : 39|2@0+ (1,0) [0|3] ""  Vector_XXX
 SG_ CcfRightCurtainAirbag m65 : 53|2@0+ (1,0) [0|3] ""  Vector_XXX
 SG_ CcfRightRearHeadAbag m65 : 49|2@0+ (1,0) [0|3] ""  Vector_XXX
 SG_ CcfRightSideAirbag m65 : 33|2@0+ (1,0) [0|3] ""  Vector_XXX
 SG_ CcfRollOverSensing m65 : 45|3@0+ (1,0) [0|7] ""  Vector_XXX
 SG_ CcfThirdRowChiller m65 : 15|2@0+ (1,0) [0|3] ""  Vector_XXX
 SG_ CcfTrunkLmpOutput m65 : 23|2@0+ (1,0) [0|3] ""  Vector_XXX
 SG_ CcfWindowCalibration m65 : 18|3@0+ (1,0) [0|7] ""  DDM,DRDM,PDM,PRDM
 SG_ CcfWindowOpFeedback m65 : 21|3@0+ (1,0) [0|7] ""  DDM,DRDM,PDM,PRDM
 SG_ CcfATPC m68 : 63|8@0+ (1,0) [0|255] ""  Vector_XXX
 SG_ CcfBumperType m68 : 43|4@0+ (1,0) [0|15] ""  Vector_XXX
 SG_ CcfDLNAStatus m68 : 51|4@0+ (1,0) [0|15] ""  Vector_XXX
 SG_ CcfDriverFrontAirbag m68 : 36|3@0+ (1,0) [0|7] ""  Vector_XXX
 SG_ CcfDriverPassRetractor m68 : 29|3@0+ (1,0) [0|7] ""  Vector_XXX
 SG_ CcfGracenotes m68 : 55|4@0+ (1,0) [0|15] ""  Vector_XXX
 SG_ CcfPassFrontAirbag m68 : 39|3@0+ (1,0) [0|7] ""  Vector_XXX
 SG_ CcfRemoteStartCapable m68 : 9|2@0+ (1,0) [0|3] ""  DDM,DRDM,PDM,PRDM
 SG_ CcfAirIonizer m73 : 50|3@0+ (1,0) [0|7] ""  Vector_XXX
 SG_ CcfAutoAccessHeight m73 : 36|2@0+ (1,0) [0|3] ""  Vector_XXX
 SG_ CcfCameraBtnFCIM m73 : 27|2@0+ (1,0) [0|3] ""  Vector_XXX
 SG_ CcfClusterAlertGFX m73 : 23|3@0+ (1,0) [0|7] ""  Vector_XXX
 SG_ CcfDepSideSteps m73 : 13|2@0+ (1,0) [0|3] ""  Vector_XXX
 SG_ CcfDriverDoorLock m73 : 34|3@0+ (1,0) [0|7] ""  DDM,DRDM,PDM,PRDM
 SG_ CcfDSSOffRoadOperation m73 : 11|2@0+ (1,0) [0|3] ""  Vector_XXX
 SG_ CcfDualViewBtnFCIM m73 : 29|2@0+ (1,0) [0|3] ""  Vector_XXX
 SG_ CcfECOmodeText m73 : 41|2@0+ (1,0) [0|3] ""  Vector_XXX
 SG_ CcfKeyFobTechnology m73 : 18|3@0+ (1,0) [0|7] ""  DDM,DRDM,PDM,PRDM
 SG_ CcfPassDoorLock m73 : 39|3@0+ (1,0) [0|7] ""  DDM,DRDM,PDM,PRDM
 SG_ CcfPedProtectSystem m73 : 25|2@0+ (1,0) [0|3] ""  Vector_XXX
 SG_ CcfRearExitDetect m73 : 31|2@0+ (1,0) [0|3] ""  Vector_XXX
 SG_ CcfRestrictSunroofOpen m73 : 20|2@0+ (1,0) [0|3] ""  Vector_XXX
 SG_ CcfRLPassDoorLock m73 : 44|3@0+ (1,0) [0|7] ""  DDM,DRDM,PDM,PRDM
 SG_ CcfRRPassDoorLock m73 : 47|3@0+ (1,0) [0|7] ""  DDM,DRDM,PDM,PRDM
 SG_ CcfSoftCloseDoors m73 : 53|3@0+ (1,0) [0|7] ""  DDM,DRDM,PDM,PRDM
 SG_ CcfSunGblClTelLock m73 : 61|2@0+ (1,0) [0|3] ""  Vector_XXX
 SG_ CcfTelLock m73 : 57|2@0+ (1,0) [0|3] ""  Vector_XXX
 SG_ CcfTelUnlock m73 : 63|2@0+ (1,0) [0|3] ""  Vector_XXX
 SG_ CcfTrailerLightTest m73 : 9|2@0+ (1,0) [0|3] ""  Vector_XXX
 SG_ CcfVehicleLocator m73 : 55|2@0+ (1,0) [0|3] ""  Vector_XXX
 SG_ CcfWalkAwayLocking m73 : 15|2@0+ (1,0) [0|3] ""  Vector_XXX
 SG_ CcfWinGblClTelLock m73 : 59|2@0+ (1,0) [0|3] ""  Vector_XXX
 SG_ Ccf2ndRowLoadSpace m74 : 23|2@0+ (1,0) [0|3] ""  Vector_XXX
 SG_ CcfActiveVanes m74 : 55|2@0+ (1,0) [0|3] ""  Vector_XXX
 SG_ CcfArmouredVehicle m74 : 63|2@0+ (1,0) [0|3] ""  DDM,DRDM,PDM,PRDM
 SG_ CcfDriverDoorLockLED m74 : 18|3@0+ (1,0) [0|7] ""  DDM,DRDM,PDM,PRDM
 SG_ CcfFntLowBeamProfile m74 : 37|6@0+ (1,0) [0|63] ""  Vector_XXX
 SG_ CcfHeightDataInputSelection m74 : 39|2@0+ (1,0) [0|3] ""  Vector_XXX
 SG_ CcfHUDNavigation m74 : 47|2@0+ (1,0) [0|3] ""  Vector_XXX
 SG_ CcfPassDoorLockLED m74 : 21|3@0+ (1,0) [0|7] ""  DDM,DRDM,PDM,PRDM
 SG_ CcfPwrTailKickSen m74 : 15|2@0+ (1,0) [0|3] ""  Vector_XXX
 SG_ CcfPwrTailProxSenPEPS m74 : 13|2@0+ (1,0) [0|3] ""  Vector_XXX
 SG_ CcfRearPosProfile m74 : 53|6@0+ (1,0) [0|63] ""  Vector_XXX
 SG_ CcfRearSMProfile m74 : 61|6@0+ (1,0) [0|63] ""  Vector_XXX
 SG_ CcfRearStopProfile m74 : 45|6@0+ (1,0) [0|63] ""  Vector_XXX
 SG_ CcfRLPassDoorLockLED m74 : 26|3@0+ (1,0) [0|7] ""  DDM,DRDM,PDM,PRDM
 SG_ CcfRRPassDoorLockLED m74 : 29|3@0+ (1,0) [0|7] ""  DDM,DRDM,PDM,PRDM
 SG_ CcfStopStartInhibitIcon m74 : 31|2@0+ (1,0) [0|3] ""  Vector_XXX
 SG_ CcfTelAlarmReset m74 : 11|2@0+ (1,0) [0|3] ""  Vector_XXX
 SG_ CcfVASSensorOvride m74 : 9|2@0+ (1,0) [0|3] ""  Vector_XXX
 SG_ CcfAlrmSensOnSingLock m81 : 31|2@0+ (1,0) [0|3] ""  Vector_XXX
 SG_ CcfBodyStyleRoofStructure m81 : 63|2@0+ (1,0) [0|3] ""  DDM,DRDM,PDM,PRDM
 SG_ CcfDynamicProgMode m81 : 18|3@0+ (1,0) [0|7] ""  Vector_XXX
 SG_ CcfECOProgMode m81 : 21|3@0+ (1,0) [0|7] ""  Vector_XXX
 SG_ CcfFntDRLOpenLoad m81 : 50|3@0+ (1,0) [0|7] ""  Vector_XXX
 SG_ CcfFntFogOpenLoad m81 : 58|3@0+ (1,0) [0|7] ""  Vector_XXX
 SG_ CcfFntLowBeamOpenLoad m81 : 53|3@0+ (1,0) [0|7] ""  Vector_XXX
 SG_ CcfFntPosOpenLoad m81 : 45|3@0+ (1,0) [0|7] ""  Vector_XXX
 SG_ CcfFntSMOpenLoad m81 : 42|3@0+ (1,0) [0|7] ""  Vector_XXX
 SG_ CcfLockFuelFillFlap m81 : 47|2@0+ (1,0) [0|3] ""  Vector_XXX
 SG_ CcfMaxVehicleSpeed m81 : 39|8@0+ (1,108) [110|362] "kph"  Vector_XXX
 SG_ CcfMHLastUserMode m81 : 55|2@0+ (1,0) [0|3] ""  Vector_XXX
 SG_ CcfPartialNetworkEnable m81 : 15|2@0+ (1,0) [0|3] ""  Vector_XXX
 SG_ CcfRearPosOpenLoad m81 : 61|3@0+ (1,0) [0|7] ""  Vector_XXX
 SG_ CcfRockCrawlMode m81 : 13|3@0+ (1,0) [0|7] ""  Vector_XXX
 SG_ CcfSandProgMode m81 : 10|3@0+ (1,0) [0|7] ""  Vector_XXX
 SG_ CcfSideWinGlassThick m81 : 23|2@0+ (1,0) [0|3] ""  Vector_XXX
 SG_ CcfUSB2Hub m81 : 26|3@0+ (1,0) [0|7] ""  Vector_XXX
 SG_ CcfUSB3Repeater m81 : 29|3@0+ (1,0) [0|7] ""  Vector_XXX
 SG_ CcfAutoAccess m83 : 45|3@0+ (1,0) [0|7] ""  Vector_XXX
 SG_ CcfCoolingFanFitment m83 : 31|3@0+ (1,0) [5|7] "Error"  Vector_XXX
 SG_ CcfDriverMemDrSwtchPk m83 : 17|2@0+ (1,0) [0|3] ""  DDM,DRDM,PDM,PRDM
 SG_ CcfEDiffType m83 : 15|4@0+ (1,0) [0|15] ""  Vector_XXX
 SG_ CcfGenericEngPwrOut m83 : 52|5@0+ (1,0) [1|4] "Eco low power engine variant"  Vector_XXX
 SG_ CcfHdlampLvlSensPos m83 : 47|2@0+ (1,0) [0|3] ""  Vector_XXX
 SG_ CcfLRTerrainJGAllRdLaunch m83 : 39|2@0+ (1,0) [0|3] ""  Vector_XXX
 SG_ CcfPassMemDrSwtchPk m83 : 19|2@0+ (1,0) [0|3] ""  DDM,DRDM,PDM,PRDM
 SG_ CcfPTCruiseFitment m83 : 55|3@0+ (1,0) [0|7] ""  Vector_XXX
 SG_ CcfRearDriverMemDrSwtchPk m83 : 21|2@0+ (1,0) [0|3] ""  DDM,DRDM,PDM,PRDM
 SG_ CcfRearPassMemDrSwtchPk m83 : 23|2@0+ (1,0) [0|3] ""  DDM,DRDM,PDM,PRDM
 SG_ CcfSpdoCalkmhOffset m83 : 11|4@0+ (1,0) [0|15] ""  Vector_XXX
 SG_ CcfSpdoCalPercentScale m83 : 28|5@0+ (1,0) [0|31] ""  Vector_XXX
 SG_ CcfSplitStopFailStrat m83 : 37|3@0+ (1,0) [0|7] ""  Vector_XXX
 SG_ CcfSteerWlhlSwtchType m83 : 34|3@0+ (1,0) [0|7] ""  Vector_XXX
 SG_ CcfTowAssist m83 : 42|3@0+ (1,0) [0|7] ""  Vector_XXX
 SG_ CcfTPMSCalibration m83 : 63|8@0+ (1,0) [0|255] ""  Vector_XXX
 SG_ CcfBrakeDiscMaterial m85 : 26|3@0+ (1,0) [0|7] ""  Vector_XXX
 SG_ CcfBrakeDiscSizeFront m85 : 19|4@0+ (1,0) [0|15] ""  Vector_XXX
 SG_ CcfBrakeDiscSizeRear m85 : 23|4@0+ (1,0) [0|15] ""  Vector_XXX
 SG_ CcfElectricFan m85 : 29|3@0+ (1,0) [0|7] ""  Vector_XXX
 SG_ CcfRearDriverLinSWP m85 : 11|4@0+ (1,0) [0|15] ""  Vector_XXX
 SG_ CcfRearPassLinSWP m85 : 15|4@0+ (1,0) [0|15] ""  Vector_XXX
 SG_ CcfServiceInterval m85 : 39|16@0+ (1,0) [1|65533] "Km"  Vector_XXX
 SG_ CcfSportbrake m85 : 31|2@0+ (1,0) [0|3] ""  DDM,DRDM,PDM,PRDM
 SG_ CcfTyreDynamicRollRad m85 : 55|16@0+ (1,0) [0|65535] ""  Vector_XXX
 SG_ CcfBrakeWarningSymbol m87 : 18|3@0+ (1,0) [0|7] ""  Vector_XXX
 SG_ CcfChassisDescription m87 : 15|4@0+ (1,0) [8|14] "Unused"  Vector_XXX
 SG_ CcfConfigDynamicMode m87 : 25|2@0+ (1,0) [0|3] ""  Vector_XXX
 SG_ CcfGearboxdescription m87 : 11|4@0+ (1,0) [0|15] ""  Vector_XXX
 SG_ ccfGenericWheelBase m87 : 31|4@0+ (1,0) [1|4] "Short"  DDM,DRDM,PDM
 SG_ CcfPTAODieWaterInSensr m87 : 23|2@0+ (1,0) [0|3] ""  Vector_XXX
 SG_ CcfReverseGearSelStrat m87 : 27|2@0+ (1,0) [0|3] ""  Vector_XXX
 SG_ CcfTransmissionSelectr m87 : 21|3@0+ (1,0) [0|7] ""  Vector_XXX
 SG_ CcfVINPart1 m87 : 39|32@0+ (1,0) [0|4294967295] ""  DDM,DRDM,PDM,PRDM
 SG_ CcfVINPart2 m88 : 15|56@0+ (1,0) [0|7.20575940379279E+016] ""  DDM,DRDM,PDM,PRDM
 SG_ CcfFntClusterCableLgth m89 : 63|4@0+ (1,0) [0|15] ""  Vector_XXX
 SG_ CcfFntDispCableLgth m89 : 59|4@0+ (1,0) [0|15] ""  Vector_XXX
 SG_ CcfVINPart3 m89 : 15|48@0+ (1,0) [0|281474976710655] ""  DDM,DRDM,PDM,PRDM
 SG_ CcfAllSurfaceInfo m90 : 31|2@0+ (1,0) [0|3] ""  Vector_XXX
 SG_ CcfBrowserSearch m90 : 34|3@0+ (1,0) [0|7] ""  Vector_XXX
 SG_ CcfDriverWinSWPack m90 : 37|3@0+ (1,0) [0|7] ""  DDM,DRDM,PDM,PRDM
 SG_ CcfFntUIPCableLgth m90 : 11|4@0+ (1,0) [0|15] ""  Vector_XXX
 SG_ CcfRearLftDispCableLgth m90 : 15|4@0+ (1,0) [0|15] ""  Vector_XXX
 SG_ CcfRearRghtDisplayCableLgth m90 : 19|4@0+ (1,0) [0|15] ""  Vector_XXX
 SG_ CcfRearUIPLnk1CableLgth m90 : 23|4@0+ (1,0) [0|15] ""  Vector_XXX
 SG_ CcfRearUIPLnk2CableLgth m90 : 27|4@0+ (1,0) [0|15] ""  Vector_XXX
 SG_ CcfRrLmpBhWhTgateOpen m90 : 29|2@0+ (1,0) [0|3] ""  Vector_XXX
 SG_ CcfSeatLumbSWFittedD m90 : 49|2@0+ (1,0) [0|3] ""  Vector_XXX
 SG_ CcfSeatLumbSWFittedP m90 : 51|2@0+ (1,0) [0|3] ""  Vector_XXX
 SG_ CcfSeatLumbSWFittedRD m90 : 53|2@0+ (1,0) [0|3] ""  Vector_XXX
 SG_ CcfSeatLumbSWFittedRP m90 : 55|2@0+ (1,0) [0|3] ""  Vector_XXX
 SG_ CcfSeatMasgSWFittedD m90 : 41|2@0+ (1,0) [0|3] ""  Vector_XXX
 SG_ CcfSeatMasgSWFittedP m90 : 43|2@0+ (1,0) [0|3] ""  Vector_XXX
 SG_ CcfSeatMasgSWFittedRD m90 : 45|2@0+ (1,0) [0|3] ""  Vector_XXX
 SG_ CcfSeatMasgSWFittedRP m90 : 47|2@0+ (1,0) [0|3] ""  Vector_XXX
 SG_ CcfSeatMovSWFittedD m90 : 57|2@0+ (1,0) [0|3] ""  Vector_XXX
 SG_ CcfSeatMovSWFittedP m90 : 59|2@0+ (1,0) [0|3] ""  Vector_XXX
 SG_ CcfSeatMovSWFittedRD m90 : 61|2@0+ (1,0) [0|3] ""  Vector_XXX
 SG_ CcfSeatMovSWFittedRP m90 : 63|2@0+ (1,0) [0|3] ""  Vector_XXX
 SG_ CcfSeatPSASWFitted m90 : 39|2@0+ (1,0) [0|3] ""  Vector_XXX
 SG_ CcfDieselEMSEmissMkt m92 : 51|4@0+ (1,0) [0|15] ""  Vector_XXX
 SG_ CcfDriverID m92 : 10|3@0+ (1,0) [0|7] ""  Vector_XXX
 SG_ CcfDriverIDKeys m92 : 15|2@0+ (1,0) [0|3] ""  Vector_XXX
 SG_ CcfDriverIDPhones m92 : 23|2@0+ (1,0) [0|3] ""  Vector_XXX
 SG_ CcfDriverIDSeats m92 : 28|2@0+ (1,0) [0|3] ""  Vector_XXX
 SG_ CcfEcoDataGallonType m92 : 31|3@0+ (1,0) [0|7] ""  Vector_XXX
 SG_ CcfFrntLowerDispKeys m92 : 42|3@0+ (1,0) [0|7] ""  Vector_XXX
 SG_ CcfFrntLowerDispVariant m92 : 35|4@0+ (1,0) [0|15] ""  Vector_XXX
 SG_ CcfFrntUpperDeployable m92 : 44|2@0+ (1,0) [0|3] ""  Vector_XXX
 SG_ CcfFrntUpperDispVariant m92 : 39|4@0+ (1,0) [0|15] ""  Vector_XXX
 SG_ CcfFrontPassengerID m92 : 13|3@0+ (1,0) [0|7] ""  Vector_XXX
 SG_ CcfNGICamBanStrat m92 : 55|2@0+ (1,0) [0|3] ""  Vector_XXX
 SG_ CcfNonDepIllumDoorHnd m92 : 53|2@0+ (1,0) [0|3] ""  Vector_XXX
 SG_ CcfPersonalisation m92 : 21|3@0+ (1,0) [0|7] ""  DDM,DRDM,PDM,PRDM
 SG_ CcfRow2PassengerID m92 : 18|3@0+ (1,0) [0|7] ""  Vector_XXX
 SG_ CcfRow3PassengerID m92 : 26|3@0+ (1,0) [0|7] ""  Vector_XXX
 SG_ CcfSmartExitFntDrvDr m92 : 57|2@0+ (1,0) [0|3] ""  DDM,DRDM,PDM,PRDM
 SG_ CcfSmartExitFntPassDoor m92 : 59|2@0+ (1,0) [0|3] ""  DDM,DRDM,PDM,PRDM
 SG_ CcfSmartExitRrDrvDoor m92 : 61|2@0+ (1,0) [0|3] ""  DDM,DRDM,PDM,PRDM
 SG_ CcfSmartExitRrPassDoor m92 : 63|2@0+ (1,0) [0|3] ""  DDM,DRDM,PDM,PRDM
 SG_ CcfTransCalIndex m92 : 47|3@0+ (1,0) [0|7] ""  Vector_XXX
 SG_ CcfChargingInlet1 m93 : 27|4@0+ (1,0) [0|15] ""  Vector_XXX
 SG_ CcfChargingInlet2 m93 : 31|4@0+ (1,0) [0|15] ""  Vector_XXX
 SG_ CcfEMMaxDurEngOff m93 : 47|8@0+ (1,0) [1|254] "Days"  Vector_XXX
 SG_ CcfFMMaxFuelAge m93 : 55|8@0+ (1,0) [1|254] "Days"  Vector_XXX
 SG_ CcfFntPassWdowSwtchPk m93 : 15|4@0+ (1,0) [0|15] ""  DDM,DRDM,PDM,PRDM
 SG_ CcfFrntDrvWdowSwtchpk m93 : 11|4@0+ (1,0) [0|15] ""  DDM,DRDM,PDM,PRDM
 SG_ CcfMicrophoneType m93 : 35|4@0+ (1,0) [0|15] ""  Vector_XXX
 SG_ CcfRrDrWdowSwtchPk m93 : 19|4@0+ (1,0) [0|15] ""  DDM,DRDM,PDM,PRDM
 SG_ CcfRrPassWdowSwtchpk m93 : 23|4@0+ (1,0) [0|15] ""  DDM,DRDM,PDM,PRDM
 SG_ CcfSelectStateCharge m93 : 63|2@0+ (1,0) [0|3] ""  Vector_XXX
 SG_ CcfTelematicsSpkrType m93 : 39|4@0+ (1,0) [0|15] ""  Vector_XXX
 SG_ CcfTimedChrgFeature m93 : 58|3@0+ (1,0) [0|7] ""  Vector_XXX
 SG_ CcfWirelessCharger m93 : 61|3@0+ (1,0) [0|7] ""  Vector_XXX
 SG_ CcfAuxCoolingPump m94 : 52|3@0+ (1,0) [0|7] ""  Vector_XXX
 SG_ CcfBrakePedalFeel m94 : 31|8@0+ (1,0) [0|255] ""  Vector_XXX
 SG_ CcfCleanSurroundCams m94 : 55|3@0+ (1,0) [0|7] ""  Vector_XXX
 SG_ CcfCntrRetractPretRow1 m94 : 41|2@0+ (1,0) [0|3] ""  Vector_XXX
 SG_ CcfCntrRetractPretRow2 m94 : 43|2@0+ (1,0) [0|3] ""  Vector_XXX
 SG_ CcfCntrRetractPretRow3 m94 : 45|2@0+ (1,0) [0|3] ""  Vector_XXX
 SG_ CcfFarSideOccImpAbgRow1 m94 : 47|2@0+ (1,0) [0|3] ""  Vector_XXX
 SG_ CcfGrndMarkingDetect m94 : 60|2@0+ (1,0) [0|3] ""  Vector_XXX
 SG_ CcfIMCClusterAPIXClrDpth m94 : 35|4@0+ (1,0) [0|15] ""  Vector_XXX
 SG_ CcfIMCClusterAPIXVideoSpd m94 : 39|4@0+ (1,0) [0|15] ""  Vector_XXX
 SG_ CcfOpenableICP m94 : 23|2@0+ (1,0) [0|3] ""  Vector_XXX
 SG_ CcfParkAidCommsBus m94 : 15|2@0+ (1,0) [0|3] ""  Vector_XXX
 SG_ CcfParkAssistHMI m94 : 63|3@0+ (1,0) [0|7] ""  Vector_XXX
 SG_ CcfPNPreConEnable m94 : 49|2@0+ (1,0) [0|3] ""  Vector_XXX
 SG_ CcfRearRoofBlindFitted m94 : 21|2@0+ (1,0) [0|3] ""  Vector_XXX
 SG_ CcfReverseMirrorDip m94 : 10|3@0+ (1,0) [0|7] ""  DDM,DRDM,PDM,PRDM
 SG_ CcfReverseMirrorDipStrat m94 : 13|3@0+ (1,0) [0|7] ""  DDM,DRDM,PDM,PRDM
 SG_ CcfRoofType m94 : 58|3@0+ (1,0) [0|7] ""  DDM,DRDM,PDM,PRDM
 SG_ CcfSeatThermHMIControl m94 : 19|4@0+ (1,0) [0|15] ""  Vector_XXX
 SG_ CcfAskOnExit m98 : 35|2@0+ (1,0) [0|3] ""  Vector_XXX
 SG_ CcfBacklightStratSel m98 : 23|2@0+ (1,0) [0|3] ""  Vector_XXX
 SG_ CcfBodyKitStyle m98 : 11|4@0+ (1,0) [0|15] ""  Vector_XXX
 SG_ CcfClearExitDetectionSystem m98 : 13|2@0+ (1,0) [0|3] ""  DDM,DRDM,PDM,PRDM
 SG_ CcfDriveAssist m98 : 21|2@0+ (1,0) [0|3] ""  Vector_XXX
 SG_ CcfDriverHeatedCalfRest m98 : 52|2@0+ (1,0) [0|3] ""  Vector_XXX
 SG_ CcfDynamicLiteMode m98 : 31|3@0+ (1,0) [0|7] ""  Vector_XXX
 SG_ CcfEngineNoiseCancel m98 : 37|2@0+ (1,0) [0|3] ""  Vector_XXX
 SG_ CcfFront23BuckSwitch m98 : 33|2@0+ (1,0) [0|3] ""  Vector_XXX
 SG_ CcfHeatedDoorArmrest m98 : 42|3@0+ (1,0) [0|7] ""  Vector_XXX
 SG_ CcfHeatedMapPocket m98 : 57|2@0+ (1,0) [0|3] ""  Vector_XXX
 SG_ CcfHtdFrntCntreArmrst m98 : 45|3@0+ (1,0) [0|7] ""  Vector_XXX
 SG_ CcfHtdRearCntreArmrst m98 : 50|3@0+ (1,0) [0|7] ""  Vector_XXX
 SG_ CcfIntelEmrgBrkingCAEB m98 : 39|2@0+ (1,0) [0|3] ""  Vector_XXX
 SG_ CcfLowerGloveBox m98 : 63|3@0+ (1,0) [0|7] ""  Vector_XXX
 SG_ CcfRow3BuckleSwitch m98 : 47|2@0+ (1,0) [0|3] ""  Vector_XXX
 SG_ CcfSAPServerType m98 : 26|3@0+ (1,0) [0|7] ""  Vector_XXX
 SG_ CcfSeatTherm2ndRowHMIControl m98 : 28|2@0+ (1,0) [0|3] ""  Vector_XXX
 SG_ CcfSuspensionType m98 : 19|4@0+ (1,0) [0|15] ""  Vector_XXX
 SG_ CcfTaskLighting m98 : 15|2@0+ (1,0) [0|3] ""  Vector_XXX
 SG_ CcfUpperGloveBox m98 : 60|3@0+ (1,0) [0|7] ""  Vector_XXX
 SG_ CcfUWBPEPSRANGEADJUSTUSEVSA m98 : 55|3@0+ (1,0) [0|7] ""  Vector_XXX
 SG_ CcfADBInitialisation m99 : 63|2@0+ (1,0) [0|3] ""  Vector_XXX
 SG_ CcfAutoVentsType m99 : 61|3@0+ (1,0) [0|7] ""  Vector_XXX
 SG_ CcfDisplaySeatTempIntensity m99 : 31|4@0+ (1,0) [0|15] ""  Vector_XXX
 SG_ CcfDisplaySeatTempZone m99 : 27|4@0+ (1,0) [0|15] ""  Vector_XXX
 SG_ CcfDriverMicrophoneType m99 : 58|3@0+ (1,0) [0|7] ""  Vector_XXX
 SG_ CcfElectFrntLoadspace m99 : 37|2@0+ (1,0) [0|3] ""  Vector_XXX
 SG_ CcfExhaustHeatshieldType m99 : 52|5@0+ (1,0) [0|31] ""  Vector_XXX
 SG_ CcfExhaustType m99 : 23|3@0+ (1,0) [0|7] ""  Vector_XXX
 SG_ CcfMirrorPositionFeature m99 : 18|3@0+ (1,0) [0|7] ""  DDM,DRDM,PDM,PRDM
 SG_ CcfRearBumperType m99 : 44|5@0+ (1,0) [0|31] ""  Vector_XXX
 SG_ CcfSeatMsg2ndRowHMIControl m99 : 20|2@0+ (1,0) [0|3] ""  Vector_XXX
 SG_ CcfSeatMsgHMIControl m99 : 35|4@0+ (1,0) [0|15] ""  Vector_XXX
 SG_ CcfSlopeInformation m99 : 55|3@0+ (1,0) [0|7] ""  Vector_XXX
 SG_ CcfTouristMode m99 : 39|2@0+ (1,0) [0|3] ""  Vector_XXX
 SG_ CcfUWBSATFreqChannel m99 : 15|8@0+ (1,0) [0|255] ""  Vector_XXX
 SG_ CcfWheelInformation m99 : 47|3@0+ (1,0) [0|7] ""  Vector_XXX
 SG_ CcfAdapDrvBeamSeg m101 : 39|8@0+ (1,0) [0|255] ""  Vector_XXX
 SG_ CcfAdasNCapESS m101 : 61|2@0+ (1,0) [0|3] ""  Vector_XXX
 SG_ CcfAdasNCapLKAUpcomTraff m101 : 63|2@0+ (1,0) [0|3] ""  Vector_XXX
 SG_ CcfBCMInteriorLightDelay m101 : 31|3@0+ (1,0) [0|7] ""  Vector_XXX
 SG_ CcfBCMInteriorLightTrunk m101 : 28|2@0+ (1,0) [0|3] ""  Vector_XXX
 SG_ CcfBrakeFluidLvlSource m101 : 57|2@0+ (1,0) [0|3] ""  Vector_XXX
 SG_ CcfDeployableSideStepType m101 : 43|4@0+ (1,0) [0|15] ""  Vector_XXX
 SG_ CcfDynBendingLight m101 : 53|2@0+ (1,0) [0|3] ""  Vector_XXX
 SG_ CcfESSCalibration m101 : 10|3@0+ (1,0) [0|7] ""  Vector_XXX
 SG_ CcfExteriorMirrorAutoUnfold m101 : 26|3@0+ (1,0) [0|7] ""  DDM,DRDM,PDM,PRDM
 SG_ CcfFuelGaugeVariant2 m101 : 23|4@0+ (1,0) [0|15] ""  Vector_XXX
 SG_ CcfLKARE m101 : 49|2@0+ (1,0) [0|3] ""  Vector_XXX
 SG_ CcfPassKneeAirbag m101 : 59|2@0+ (1,0) [0|3] ""  Vector_XXX
 SG_ CcfSeatMvmtModuleType m101 : 47|4@0+ (1,0) [0|15] ""  Vector_XXX
 SG_ CcfSignPostDimming m101 : 55|2@0+ (1,0) [0|3] ""  Vector_XXX
 SG_ CcfSupMainBeamRoutIntensity m101 : 19|4@0+ (1,0) [0|15] ""  Vector_XXX
 SG_ CcfTJAICARE m101 : 51|2@0+ (1,0) [0|3] ""  Vector_XXX
 SG_ CcfWakeupShutdownSeqTyp m101 : 15|5@0+ (1,0) [0|31] ""  Vector_XXX
 SG_ CcfACCAccelProfileSelect m102 : 45|2@0+ (1,0) [0|3] ""  Vector_XXX
 SG_ CcfACCLeadCarDistDisp m102 : 41|2@0+ (1,0) [0|3] ""  Vector_XXX
 SG_ CcfACCStopGapSelect m102 : 43|2@0+ (1,0) [0|3] ""  Vector_XXX
 SG_ CcfAdasDCR m102 : 51|2@0+ (1,0) [0|3] ""  Vector_XXX
 SG_ CcfAdasLongCRA m102 : 9|2@0+ (1,0) [0|3] ""  Vector_XXX
 SG_ CcfAdasLongRPC m102 : 11|2@0+ (1,0) [0|3] ""  DDM,DRDM,PDM,PRDM
 SG_ CcfAdasNCapCyclistAEB m102 : 19|2@0+ (1,0) [0|3] ""  Vector_XXX
 SG_ CcfAdasTJP m102 : 21|2@0+ (1,0) [0|3] ""  Vector_XXX
 SG_ CcfAutoHold m102 : 35|2@0+ (1,0) [0|3] ""  Vector_XXX
 SG_ CcfDSMFitment m102 : 23|2@0+ (1,0) [0|3] ""  Vector_XXX
 SG_ CcfESSCalNo m102 : 63|8@0+ (1,0) [0|255] ""  Vector_XXX
 SG_ CcfIntMirrorVariant m102 : 39|4@0+ (1,0) [0|15] ""  Vector_XXX
 SG_ CcfLaneKeepAssistLDW m102 : 17|2@0+ (1,0) [0|3] ""  Vector_XXX
 SG_ CcfLeftManoeuvringLgt m102 : 13|2@0+ (1,0) [0|3] ""  Vector_XXX
 SG_ CcfParkPawlLocation m102 : 55|4@0+ (1,0) [0|15] ""  Vector_XXX
 SG_ CcfPassHeatedCalfRest m102 : 47|2@0+ (1,0) [0|3] ""  Vector_XXX
 SG_ CcfPSMFitment m102 : 25|2@0+ (1,0) [0|3] ""  Vector_XXX
 SG_ CcfR2SMFitment m102 : 31|2@0+ (1,0) [0|3] ""  Vector_XXX
 SG_ CcfR3SMFitment m102 : 33|2@0+ (1,0) [0|3] ""  Vector_XXX
 SG_ CcfRghtManoeuvringLgt m102 : 15|2@0+ (1,0) [0|3] ""  Vector_XXX
 SG_ CcfRLSMFitment m102 : 27|2@0+ (1,0) [0|3] ""  Vector_XXX
 SG_ CcfRRSMFitment m102 : 29|2@0+ (1,0) [0|3] ""  Vector_XXX
 SG_ CcfSeatMassHanded m102 : 49|2@0+ (1,0) [0|3] ""  Vector_XXX
 SG_ CcfARNCCalNo m103 : 23|8@0+ (1,0) [0|255] ""  Vector_XXX
 SG_ CcfASDExhaustCalNo m103 : 55|8@0+ (1,0) [0|255] ""  Vector_XXX
 SG_ CcfAVNCalNo m103 : 63|8@0+ (1,0) [0|255] ""  Vector_XXX
 SG_ CcfCDLGlobalClose m103 : 47|2@0+ (1,0) [0|3] ""  DDM,DRDM,PDM,PRDM
 SG_ CcfCDLGlobalOpen m103 : 45|2@0+ (1,0) [0|3] ""  DDM,DRDM,PDM,PRDM
 SG_ CcfCityUrbanAutoEmerBraking m103 : 28|2@0+ (1,0) [0|3] ""  Vector_XXX
 SG_ CcfCyCAutoEmerBraking m103 : 43|2@0+ (1,0) [0|3] ""  Vector_XXX
 SG_ CcfEOCCalNo m103 : 15|8@0+ (1,0) [0|255] ""  Vector_XXX
 SG_ CcfFrontBeltMinder m103 : 26|3@0+ (1,0) [0|7] ""  Vector_XXX
 SG_ CcfFrontPreCrashSunRoof m103 : 37|2@0+ (1,0) [0|3] ""  Vector_XXX
 SG_ CcfFwdCollisionWarn m103 : 31|3@0+ (1,0) [0|7] ""  Vector_XXX
 SG_ CcfIntelligentEmerBraking m103 : 41|2@0+ (1,0) [0|3] ""  Vector_XXX
 SG_ CcfJuncAutoEmerBraking m103 : 35|2@0+ (1,0) [0|3] ""  Vector_XXX
 SG_ CcfOverspeedIndia m103 : 39|2@0+ (1,0) [0|3] ""  Vector_XXX
 SG_ CcfPedAutoEmerBraking m103 : 33|2@0+ (1,0) [0|3] ""  Vector_XXX
 SG_ CcfAutolampFastResponse m104 : 61|2@0+ (1,0) [0|3] ""  Vector_XXX
 SG_ CcfChargeFlap1 m104 : 27|4@0+ (1,0) [0|15] ""  Vector_XXX
 SG_ CcfChargeFlap2 m104 : 31|4@0+ (1,0) [0|15] ""  Vector_XXX
 SG_ CcfEOCExhaustCalNo m104 : 15|8@0+ (1,0) [0|255] ""  Vector_XXX
 SG_ CcfHeadlampWash m104 : 63|2@0+ (1,0) [0|3] ""  Vector_XXX
 SG_ CcfMemorySwitchType m104 : 33|2@0+ (1,0) [0|3] ""  DDM,DRDM,PDM,PRDM
 SG_ CcfRainSensorFitment m104 : 37|2@0+ (1,0) [0|3] ""  Vector_XXX
 SG_ CcfRCTAConfiguration m104 : 20|3@0+ (1,0) [0|7] ""  Vector_XXX
 SG_ CcfSeatSwitchPackPos m104 : 23|3@0+ (1,0) [0|7] ""  DDM,DRDM,PDM,PRDM
 SG_ CcfSMRFGlobalClose m104 : 17|2@0+ (1,0) [0|3] ""  DDM,DRDM,PDM,PRDM
 SG_ CcfWiperColdClimDLRWash m104 : 51|2@0+ (1,0) [0|3] ""  Vector_XXX
 SG_ CcfWiperCollarSwtchRnSenSeni m104 : 53|2@0+ (1,0) [0|3] ""  Vector_XXX
 SG_ CcfWiperDripWipeFeature m104 : 45|2@0+ (1,0) [0|3] ""  Vector_XXX
 SG_ CcfWiperFntSpeedDepend m104 : 41|2@0+ (1,0) [0|3] ""  Vector_XXX
 SG_ CcfWiperHdlmpWshPressure m104 : 57|2@0+ (1,0) [0|3] ""  Vector_XXX
 SG_ CcfWiperHeadlmpWashDLR m104 : 49|2@0+ (1,0) [0|3] ""  Vector_XXX
 SG_ CcfWiperInterSpdDepend m104 : 35|2@0+ (1,0) [0|3] ""  Vector_XXX
 SG_ CcfWiperProgramWipeActive m104 : 43|2@0+ (1,0) [0|3] ""  Vector_XXX
 SG_ CcfWiperRearContinue m104 : 39|2@0+ (1,0) [0|3] ""  Vector_XXX
 SG_ CcfWiperRrHlfMoonParkSwtch m104 : 59|2@0+ (1,0) [0|3] ""  Vector_XXX
 SG_ CcfWiperTwinWasherBottle m104 : 55|2@0+ (1,0) [0|3] ""  Vector_XXX
 SG_ CcfWiperUpStroke m104 : 47|2@0+ (1,0) [0|3] ""  Vector_XXX
 SG_ CcfActiveExhaustMap m107 : 51|4@0+ (1,0) [0|15] ""  Vector_XXX
 SG_ CcfClimateSeatSigType m107 : 33|2@0+ (1,0) [0|3] ""  Vector_XXX
 SG_ CcfCornerOnThreshold m107 : 63|8@0+ (1,0) [0|255] ""  Vector_XXX
 SG_ CcfDIFlashOnArmDisarm m107 : 15|2@0+ (1,0) [0|3] ""  Vector_XXX
 SG_ CcfDoubleLockingChirp m107 : 9|2@0+ (1,0) [0|3] ""  Vector_XXX
 SG_ CcfDriverConditionMon m107 : 27|4@0+ (1,0) [0|15] ""  Vector_XXX
 SG_ CcfHeadrestDrop m107 : 37|4@0+ (1,0) [0|15] ""  Vector_XXX
 SG_ CcfHVBattRegCompliance m107 : 31|4@0+ (1,0) [0|15] ""  Vector_XXX
 SG_ CcfNASTrailerLighting m107 : 55|2@0+ (1,0) [0|3] ""  Vector_XXX
 SG_ CcfOpenCloseRFKey m107 : 17|2@0+ (1,0) [0|3] ""  Vector_XXX
 SG_ CcfPreCrashWindowLift m107 : 21|2@0+ (1,0) [0|3] ""  DDM
 SG_ CcfRemoteConvRoofOperation m107 : 39|2@0+ (1,0) [0|3] ""  Vector_XXX
 SG_ CcfSecurityDIFlashOnErr m107 : 13|2@0+ (1,0) [0|3] ""  Vector_XXX
 SG_ CcfSecurityErrorTone m107 : 11|2@0+ (1,0) [0|3] ""  Vector_XXX
 SG_ CcfSmartEye m107 : 47|2@0+ (1,0) [0|3] ""  Vector_XXX
 SG_ CcfTailgateRemoteRel m107 : 19|2@0+ (1,0) [0|3] ""  Vector_XXX
 SG_ CcfTJAICAHOD m107 : 42|3@0+ (1,0) [0|7] ""  Vector_XXX
 SG_ CcfTripComputerUnitsWh m107 : 53|2@0+ (1,0) [0|3] ""  Vector_XXX
 SG_ CcfWindowPWMMode m107 : 23|2@0+ (1,0) [0|3] ""  DDM,DRDM,PDM,PRDM
 SG_ CcfAutoSSSelectInFCPB m111 : 42|3@0+ (1,0) [0|7] ""  Vector_XXX
 SG_ CcfDSCSelectInFCPB m111 : 45|3@0+ (1,0) [0|7] ""  Vector_XXX
 SG_ CcfHDCSelectInFCPB m111 : 50|3@0+ (1,0) [0|7] ""  Vector_XXX
 SG_ CcfRemoteWingMirrorFold m111 : 47|2@0+ (1,0) [0|3] ""  DDM,PDM
 SG_ CcfTerComSelectInFCPB m111 : 58|3@0+ (1,0) [0|7] ""  Vector_XXX
 SG_ CcfTerDynSelectInFCPB m111 : 61|3@0+ (1,0) [0|7] ""  Vector_XXX
 SG_ CcfTerECOSelectInFCPB m111 : 53|3@0+ (1,0) [0|7] ""  Vector_XXX
 SG_ CcfDD00GlobalRealTime m176 : 15|32@0+ (1,0) [0|4294967295] ""  DDM,DRDM,PDM,PRDM
 SG_ CcfDD02MainECUSupVolts m176 : 47|8@0+ (0.25,0) [0|63.75] "Volts"  DDM,DRDM,PDM,PRDM
 SG_ CcfDD06PowerModePKT m176 : 52|5@0+ (1,0) [0|31] ""  DDM,DRDM,PDM,PRDM
 SG_ CcfDD01TotalDistance m177 : 15|24@0+ (1,0) [0|16777215] ""  DDM,DRDM,PDM,PRDM
 SG_ CcfDD04InCarTemp m177 : 39|8@0+ (1,-40) [-40|215] "Deg C"  DDM,DRDM,PDM,PRDM
 SG_ CcfDD05OutdoorTemp m177 : 47|8@0+ (1,-40) [-40|215] "Deg C"  DDM,DRDM,PDM,PRDM

BO_ 1029 VIP_405BO: 8 GWM
 SG_ VehicleInfoParametersBO : 7|64@0+ (1,0) [0|1.84467440737096E+019] ""  BCM_Gp,DSM,FTCM,FTCMB,LPDM,PSM,RFA,RGTM,RGTMB,RLSM,RPDM,RRSM,TBM,VIM,WDCM

BO_ 1006 VirtNode_OMM_RFA: 0 Virtual_Node

BO_ 324 WDCM_PR_GW_1: 8 WDCM
 SG_ DeviceChargeLevel : 59|2@0+ (1,0) [0|3] ""  GWM
 SG_ WDCFault : 57|2@0+ (1,0) [0|3] ""  GWM

BO_ 1566 XCPCalibrationSlaveDSM_BOCAN: 8 DSM
 SG_ XcpCalibrationSlaveDSM : 7|64@0+ (1,0) [0|1.84467440737096E+019] ""  GWM

BO_ 1568 XCPCalibrationSlavePSM_BOCAN: 8 PSM
 SG_ XcpCalibrationSlavePSM : 7|64@0+ (1,0) [0|1.84467440737096E+019] ""  GWM

BO_ 1565 XCPCalMasterDSM_BOCAN: 8 GWM
 SG_ XcpCalMasterDSM : 7|64@0+ (1,0) [0|1.84467440737096E+019] ""  DSM

BO_ 1567 XCPCalMasterPSM_BOCAN: 8 GWM
 SG_ XcpCalMasterPSM : 7|64@0+ (1,0) [0|1.84467440737096E+019] ""  PSM

CM_ SG_ 1944 TesterPhysicalResFTCMB "This is the diagnostic response from the FTCMB.

The MSB of the signal must be written to the COM layer first (with an offset of zero in wr_bytes() ) and therefore transmitted on the bus first.
Similarly, subscribing modules will receive the MSB of the signal when they call rd_bytes(0).

E.g. wr_bytes(0) = published_signal_MSB;

Subscribed_Signal_MSB = rd_bytes(0).
";
CM_ SG_ 1849 TesterPhysicalResKVM "Diagnostic Physically Addressed Response from KVM. Signal name is according to EuCD convention!!

The MSB of the signal must be written to the COM layer first (with an offset of zero in wr_bytes() ) and therefore transmitted on the bus first.
Similarly, subscribing modules will receive the MSB of the signal when they call rd_bytes(0).

E.g. wr_bytes(0) = published_signal_MSB;

Subscribed_Signal_MSB = rd_bytes(0);";
CM_ SG_ 2025 TesterPhysicalResLPDM "This is the diagnostic response from the LPDM.

The MSB of the signal must be written to the COM layer first (with an offset of zero in wr_bytes() ) and therefore transmitted on the bus first.
Similarly, subscribing modules will receive the MSB of the signal when they call rd_bytes(0).

E.g. wr_bytes(0) = published_signal_MSB;

Subscribed_Signal_MSB = rd_bytes(0);";
CM_ SG_ 1963 TesterPhysicalResPSM "Diagnostic Physically Addressed Response from PSM.

The MSB of the signal must be written to the COM layer first (with an offset of zero in wr_bytes() ) and therefore transmitted on the bus first.
Similarly, subscribing modules will receive the MSB of the signal when they call rd_bytes(0).

E.g. wr_bytes(0) = published_signal_MSB;

Subscribed_Signal_MSB = rd_bytes(0).";
CM_ SG_ 1917 TesterPhysicalResRGTM "Diagnostic Physically Addressed Response from RGTM.

The MSB of the signal must be written to the COM layer first (with an offset of zero in wr_bytes() ) and therefore transmitted on the bus first.
Similarly, subscribing modules will receive the MSB of the signal when they call rd_bytes(0).

E.g. wr_bytes(0) = published_signal_MSB;

Subscribed_Signal_MSB = rd_bytes(0).";
CM_ SG_ 1982 TesterPhysicalResRGTMB "Diagnostic Physically Addressed Response from RGTMB.

The MSB of the signal must be written to the COM layer first (with an offset of zero in wr_bytes() ) and therefore transmitted on the bus first.
Similarly, subscribing modules will receive the MSB of the signal when they call rd_bytes(0).

E.g. wr_bytes(0) = published_signal_MSB;

Subscribed_Signal_MSB = rd_bytes(0).";
CM_ SG_ 1802 TesterPhysicalResRLSM "Diagnostic Physically Addressed Response from PSM.

The MSB of the signal must be written to the COM layer first (with an offset of zero in wr_bytes() ) and therefore transmitted on the bus first.
Similarly, subscribing modules will receive the MSB of the signal when they call rd_bytes(0).

E.g. wr_bytes(0) = published_signal_MSB;

Subscribed_Signal_MSB = rd_bytes(0).";
CM_ SG_ 2024 TesterPhysicalResRPDM "This is the diagnostic response from the RPDM.

The MSB of the signal must be written to the COM layer first (with an offset of zero in wr_bytes() ) and therefore transmitted on the bus first.
Similarly, subscribing modules will receive the MSB of the signal when they call rd_bytes(0).

E.g. wr_bytes(0) = published_signal_MSB;

Subscribed_Signal_MSB = rd_bytes(0);";
CM_ SG_ 1899 TesterPhysicalResRRSM "Diagnostic Physically Addressed Response from PSM.

The MSB of the signal must be written to the COM layer first (with an offset of zero in wr_bytes() ) and therefore transmitted on the bus first.
Similarly, subscribing modules will receive the MSB of the signal when they call rd_bytes(0).

E.g. wr_bytes(0) = published_signal_MSB;

Subscribed_Signal_MSB = rd_bytes(0).";
CM_ SG_ 1887 TesterPhysicalResTBM "This is the diagnostic response from the TBM.

The MSB of the signal must be written to the COM layer first (with an offset of zero in wr_bytes() ) and therefore transmitted on the bus first.
Similarly, subscribing modules will receive the MSB of the signal when they call rd_bytes(0).

E.g. wr_bytes(0) = published_signal_MSB;

Subscribed_Signal_MSB = rd_bytes(0);
";
CM_ SG_ 1807 TesterPhysicalResWDCM "This is the diagnostic response from the WDCM.

The MSB of the signal must be written to the COM layer first (with an offset of zero in wr_bytes() ) and therefore transmitted on the bus first.
Similarly, subscribing modules will receive the MSB of the signal when they call rd_bytes(0).

E.g. wr_bytes(0) = published_signal_MSB;

Subscribed_Signal_MSB = rd_bytes(0).
EuCD signal";
CM_ SG_ 1024 VehicleConfParameters "This signal contains EuCD Configuration Parameters in accordance with the Car Configuration EuCD - Vehicle Information Parameters Specification 31812330.

The MSB of the signal must be written to the COM layer first (with an offset of zero in wr_bytes() ) and therefore transmitted on the bus first.
Similarly, subscribing modules will receive the MSB of the signal when they call rd_bytes(0).

E.g. wr_bytes(0) = published_signal_MSB;

Subscribed_Signal_MSB = rd_bytes(0);

Common signal publishes by BCM XCL, replacing the individual MS and HS version";
CM_ SG_ 1025 CcfAlternator "Car Configuration Alternator type

Payload 0x0187 bits 7-0
 ";
CM_ SG_ 1025 CcfBifuel "CCF Parameter - Bifuel

MDF - 0x0157";
CM_ SG_ 1025 CcfDoors "Car Configuration - Doors

MDF = 0x0137";
CM_ SG_ 1025 CcfEngine "Car Configuration - Engine

Payload MDF = 0x0167";
CM_ SG_ 1025 CcfFuel "Car Configuration - Fuel

Payload MDF = 0x0177";
CM_ SG_ 1025 CcfTransmissionDriveLn "Car Configuration - TRANSMISSION  - DRIVELINE

Payload MDF = 0x0147";
CM_ SG_ 1025 CcfVehicleType "Car Configuration - Vehicle Type

Payload MDF = 0x0127";
CM_ SG_ 1025 CcfAlarm "CCF Parameter - ALARM

MDF - 0x0267";
CM_ SG_ 1025 CcfFuelTankVolume "CCF Parameter - FUEL TANK VOLUME

MDF - 0x0257";
CM_ SG_ 1025 CcfGearbox "Car Configuration - Gearbox

Payload MDF = 0x0237";
CM_ SG_ 1025 CcfGearboxType "Car Configuration - Gearbox Type

Payload MDF = 0x0247";
CM_ SG_ 1025 CcfHeadlightsType "CCF Parameter - HEADLIGHTS TYPE

MDF - 0x0287";
CM_ SG_ 1025 CcfSeatMassage "CCF Parameter - Seat Massage

MDF - 0x0277";
CM_ SG_ 1025 CcfSteeringWheelPosn "Car Configuration - Steering Wheel Position

Payload MDF = 0x0227";
CM_ SG_ 1025 CcfAckSignalLockAlarm "CCF Parameter - ACKNOWL. SIGNAL LOCK/ALARM

MDF - 0x0547";
CM_ SG_ 1025 CcfAutoLockingBySpeed "CCF Parameter - AUTOMATIC LOCKING BY SPEED

MDF - 0x0557";
CM_ SG_ 1025 CcfChildLockRearDrs "CCF Parameter - CHILD LOCK. REAR DOORS

MDF - 0x0527";
CM_ SG_ 1025 CcfKeyLockProtection2EXT "CCF Parameter - Key lock in Protection2 EXT

MDF - 0x0577";
CM_ SG_ 1025 CcfKeyLockProtectionINT "CCF Parameter - Key lock in Protection INT

MDF - 0x0587";
CM_ SG_ 1025 CcfLevelSensorIfAlarm "CCF Parameter - LEVEL SENSOR - IF ALARM

MDF - 0x0567";
CM_ SG_ 1025 CcfUnlockSetting "CCF Parameter - UNLOCK SETTING

MDF - 0x0537";
CM_ SG_ 1025 CcfBatteryRear "CCF Parameter - BATTERY REAR

MDF - 0x0667";
CM_ SG_ 1025 CcfBlindSpotInfoSystem "CCF BLIND SPOT INFORMATION SYSTEM

 MDF 0x0637";
CM_ SG_ 1025 CcfClimateControlUnit "Car Configuration - CLIMATE CONTROL UNIT

Payload MDF = 0x0687";
CM_ SG_ 1025 CcfCoupeFilter "CCF Parameter - COUPE FILTER

MDF - 0x0677";
CM_ SG_ 1025 CcfPanicAlarm "CCF Parameter - PANIC ALARM

MDF - 0x0627";
CM_ SG_ 1025 CcfPPTCHeater "Car Configuration - PTC HEATER (SUPPLEMENTARY AIR HEATER)

Payload MDF = 0x0657";
CM_ SG_ 1025 CcfRoadFrictionDetection "CCF Parameter - ROAD FRICTION DETECTION

MDF - 0x0647";
CM_ SG_ 1025 CcfBrand "CCF Parameter Name - Brand

Payload MDF = 0x0977";
CM_ SG_ 1025 CcfFreqRemoteControls "CCF Parameter - FREQUENCY- REMOTE CONTROLS

MDF - 0x0987";
CM_ SG_ 1025 CcfHeatedWindscreen "Car Configuration - HEATED WINDSCREEN

Payload MDF = 0x0937";
CM_ SG_ 1025 CcfHillDescentControl "CCF Parameter - HILL DESCENT CONTROL

MDF - 0x0957";
CM_ SG_ 1025 CcfParkingAssistance "Car Configuration - ParkingAssistance.

MDF = 0x0947";
CM_ SG_ 1025 CcfParkingBrakeType "CCF - PARKING BRAKE TYPE  

MDF 0x0927
";
CM_ SG_ 1025 CcfSafetyBeltReminder "CCF Parameter - SAFETY BELT REMINDER

MDF - 0x0867";
CM_ SG_ 1025 CcfActiveSuspension "CCF Parameter - ACTIVE SUSPENSION

MDF - 0x0C57";
CM_ SG_ 1025 CcfDrivenAxle "CCF Parameter - DRIVEN AXLE

MDF - 0x0C27";
CM_ SG_ 1025 CcfRearWheelType "CCF Parameter - REAR WHEEL TYPE

MDF - 0x0C37";
CM_ SG_ 1025 CcfSideWindows "CCF - Side Windows

MDF - 0x0C87";
CM_ SG_ 1025 CcfSteeringGear "CCF Parameter - STEERING GEAR

MDF - 0x0C67";
CM_ SG_ 1025 CcfWheelbaseSeries "CCF Parameter - WHEELBASE SERIES & EXTENDED LENGTH OPTION

MDF - 0x0C47";
CM_ SG_ 1025 CcfAirbagPassengerSide "CCF Parameter - AIRBAG PASSENGER SIDE

MDF - 0x0D67";
CM_ SG_ 1025 CcfAutoLights "CCF Parameter - AUTO LIGHTS

MDF - 0x0D57";
CM_ SG_ 1025 CcfCutoffSwitchPassAirbag "CCF Parameter - CUTOFF SWITCH PASSENGER AIRBAG

MDF - 0x0D77";
CM_ SG_ 1025 CcfMemoryFunction "CCF - Memory Function

MDF - 0x0D37";
CM_ SG_ 1025 CcfPuddleLightOuterMirrors "CCF - Puddle Light Outer Mirrors

MDF - 0x0D47";
CM_ SG_ 1025 CcfRearViewMirrorsOuter "CCF - REAR VIEW MIRRORS OUTER

MDF - 0x0D27";
CM_ SG_ 1025 CcfSideAirbagDriver "CCF Parameter - SIDE AIRBAG (THORAX)  DRIVER

MDF - 0x0D87";
CM_ SG_ 1025 CcfAuxiliaryLights "CCF Parameter - AUXILIARY LIGHTS

MDF - 0x1037";
CM_ SG_ 1025 CcfEmergencyBrakeLight "CCF Parameter - EMERGENCY BRAKE LIGHT

MDF - 0x1027";
CM_ SG_ 1025 CcfInCarEntertainment "CCF Parameter - IN CAR ENTERTAINMENT

MDF - 0x1087";
CM_ SG_ 1025 CcfPowerWindows "CCF - Power Windows Front/Rear

MDF - 0x1057";
CM_ SG_ 1025 CcfRadioFrequencyBand "CCF - FREQUENCY BAND & STEP RADIO

MDF - 0x1067";
CM_ SG_ 1025 CcfRoofHatch "CCF Parameter - Roof Hatch

MDF - 0x1047";
CM_ SG_ 1025 CcfTrimLevel "CCF Parameter - TRIMLEVEL

MDF - 0x1077";
CM_ SG_ 1025 CcfPowerHeatedMirrors "CCF - POWER /HEATED MIRRORS

MDF - 0x1557";
CM_ SG_ 1025 CcfRearGlazing "Car Configuration - Rear Glazing

Payload MDF = 0x1527";
CM_ SG_ 1025 CcfDampSensor "Car Configuration - Damp Sensor

Payload MDF = 0x1A77";
CM_ SG_ 1025 CcfDoorHandleTechnology "CCF - DOOR HANDLE TECHNOLOGY

MDF - 0x1A27";
CM_ SG_ 1025 CcfMirrorMountTurnSig "CCF Parameter - Mirror mounted turn signal

MDF - 0x1C67";
CM_ SG_ 1025 CcfRearDoorSunblinds "CCF Parameter - Rear Door Sunblinds

MDF - 0x1C27";
CM_ SG_ 1025 Ccf4x4InfoDisplay "Car Configuration - 4x4 Information Display
MDF =  0x2147";
CM_ SG_ 1025 CcfAdvancedChauffeurFunc "CCF Parameter - Advanced Chauffeur Function

MDF - 0x2127";
CM_ SG_ 1025 CcfDoorLatchType "Car Configuration - Door Latch Type

Payload MDF = 0x2187";
CM_ SG_ 1025 CcfLowSpdIntEmergBrake "Car Configuration - Low Speed Intelligent Emergency Braking

Payload MDF = 0x2137";
CM_ SG_ 1025 CcfModelYear "Car Configuration - Model Year

Payload MDF = 0x2167";
CM_ SG_ 1025 CcfAmbientLighting "CCF Parameter - Ambient Lighting

MDF - 0x2337";
CM_ SG_ 1025 CcfConnectAndView "CCF Parameter - Connect and View

MDF - 0x2377";
CM_ SG_ 1025 CcfDynamici "CCF Parameter - Dynamic-i

MDF - 0x2387";
CM_ SG_ 1025 CcfHandbook "CCF Parameter - Handbook

MDF - 0x2367";
CM_ SG_ 1025 CcfNavigationSpeedInhibit "CCF Parameter - Navigation Speed Inhibit

MDF - 0x2347";
CM_ SG_ 1025 CcfPassiveLockErrorTones "CCF Parameter - Passive Locking Error Tones

MDF - 0x2357";
CM_ SG_ 1025 CcfRearDiff "CCF parameter - Rear Diff

MDF - 0x2327";
CM_ SG_ 1025 CcfCameraHMIStrategy "Car Configuration - CameraHMIStrategy

Payload MDF = 0x4122";
CM_ SG_ 1025 CcfDeplBatterySystem "CCF Parameter Name - DeplBatterySystem

Payload MDF = 0x4177";
CM_ SG_ 1025 CcfDriverBuckleSwitch "CCF Parameter Name - DriverBuckleSwitch

Payload MDF = 0x4181";
CM_ SG_ 1025 CcfDriverKneeAirbag "CCF Parameter Name - DriverKneeAirbag

Payload MDF = 0x4155";
CM_ SG_ 1025 CcfDriverPassBeltPret "CCF Parameter Name - DriverPassBeltPret

Payload MDF = 0x4144";
CM_ SG_ 1025 CcfDriverSwtchLdLimit "CCF Parameter Name - DriverSwtchLdLimit

Payload MDF = 0x4187";
CM_ SG_ 1025 CcfEventDataRecorder "CCF Parameter Name - EventDataRecorder

Payload MDF = 0x4185";
CM_ SG_ 1025 CcfFntDIFbdkMech "CCF Parameter - FntDIFbdkMech

MDF - 0x4141";
CM_ SG_ 1025 CcfInfotainmentType "CCF Parameter Name - InfotainmentType

Payload MDF = 0x4125";
CM_ SG_ 1025 CcfLeftCurtainAirbag "CCF Parameter Name - LeftCurtainAirbag

Payload MDF = 0x4173";
CM_ SG_ 1025 CcfLeftRearHeadAbag "CCF Parameter Name - LeftRearHeadAbag

Payload MDF = 0x4167";
CM_ SG_ 1025 CcfLeftSideAirbag "CCF Parameter Name - LeftSideAirbag

Payload MDF = 0x4153";
CM_ SG_ 1025 CcfmPACOS "CCF Parameter Name - mPACOS

Payload MDF = 0x4147";
CM_ SG_ 1025 CcfPADLamp "CCF Parameter Name - PADLamp

Payload MDF = 0x4162";
CM_ SG_ 1025 CcfPassBuckleSwitch "CCF Parameter Name - PassBuckleSwitch

Payload MDF = 0x4183";
CM_ SG_ 1025 CcfPassOccWghtSensor "CCF Parameter Name - PassOccWghtSensor

Payload MDF = 0x4157";
CM_ SG_ 1025 CcfRightCurtainAirbag "CCF Parameter Name - RightCurtainAirbag
Payload MDF = 0x4175";
CM_ SG_ 1025 CcfRightRearHeadAbag "CCF Parameter Name - RightRearHeadAbag

Payload MDF = 0x4171";
CM_ SG_ 1025 CcfRightSideAirbag "CCF Parameter Name - RightSideAirbag

Payload MDF = 0x4151";
CM_ SG_ 1025 CcfRollOverSensing "CCF Parameter Name - RollOverSensing

Payload MDF = 0x4165";
CM_ SG_ 1025 CcfThirdRowChiller "Car Configuration - Thrid Row Chiller

Payload MDF = 0x4127";
CM_ SG_ 1025 CcfTrunkLmpOutput "CCF Parameter - TrunkLmpOutput

MDF - 0x4137";
CM_ SG_ 1025 CcfWindowCalibration "CCF Parameter - WindowCalibration

MDF - 0x4132";
CM_ SG_ 1025 CcfWindowOpFeedback "CCF Parameter - WindowOpFeedback

MDF - 0x4135";
CM_ SG_ 1025 CcfATPC "Car Configuration - ATPC

Payload MDF = 0x4487";
CM_ SG_ 1025 CcfBumperType "CCF Parameter Name - BumperType

Payload MDF = 0x4463";
CM_ SG_ 1025 CcfDLNAStatus "CCF Parameter - DLNAStatus

MDF - 0x4473";
CM_ SG_ 1025 CcfDriverFrontAirbag "CCF Parameter Name - DriverFrontAirbag

Payload MDF = 0x4454";
CM_ SG_ 1025 CcfDriverPassRetractor "CCF Parameter Name - DriverPassRetractor

Payload MDF = 0x4445";
CM_ SG_ 1025 CcfGracenotes "CCF Parameter - Gracenotes

MDF - 0x4477";
CM_ SG_ 1025 CcfPassFrontAirbag "CCF Parameter Name - PassFrontAirbag

Payload MDF = 0x4457";
CM_ SG_ 1025 CcfRemoteStartCapable "RemoteStartCapable - Payload Description

Payload MDF = 0x4421";
CM_ SG_ 1025 CcfAirIonizer "Car Configuration - Air Ionizer

Payload MDF = 0x4972";
CM_ SG_ 1025 CcfAutoAccessHeight "CCF Parameter - AutoAccessHeight

MDF - 0x4954";
CM_ SG_ 1025 CcfCameraBtnFCIM "Car Configuration - CameraBtnFCIM

Payload MDF = 0x4943
";
CM_ SG_ 1025 CcfClusterAlertGFX "CCF Parameter - ClusterAlertGFX

MDF - 0x4937";
CM_ SG_ 1025 CcfDepSideSteps "CCF Parameter - DepSideSteps

MDF - 0x4925";
CM_ SG_ 1025 CcfDriverDoorLock "CCF Parameter - DriverDoorLock

MDF - 0x4952";
CM_ SG_ 1025 CcfDSSOffRoadOperation "CCF Parameter - DSSOffRoadOperation

MDF - 0x4923



";
CM_ SG_ 1025 CcfDualViewBtnFCIM "Car Configuration - DualViewBtnFCIM

Payload MDF = 0x4945

";
CM_ SG_ 1025 CcfECOmodeText "CCF Parameter - ECOmodeText

MDF - 0x4961";
CM_ SG_ 1025 CcfKeyFobTechnology "CCF Parameter - KeyFobTechnology

MDF - 0x4932";
CM_ SG_ 1025 CcfPassDoorLock "CCF Parameter - PassDoorLock

MDF - 0x4957";
CM_ SG_ 1025 CcfPedProtectSystem "CCF Parameter - PedProtectSystem

Payload MDF = 0x4941";
CM_ SG_ 1025 CcfRearExitDetect "CCF Parameter - RearExitDetect

MDF - 0x4947";
CM_ SG_ 1025 CcfRestrictSunroofOpen "CCF Parameter - RestrictSunroofOpen

MDF - 0x4934";
CM_ SG_ 1025 CcfRLPassDoorLock "CCF Parameter - RLPassDoorLock

MDF - 0x4964";
CM_ SG_ 1025 CcfRRPassDoorLock "CCF Parameter - RRPassDoorLock

MDF - 0x4967";
CM_ SG_ 1025 CcfSoftCloseDoors "CCF Parameter - SoftCloseDoors

MDF - 0x4975";
CM_ SG_ 1025 CcfSunGblClTelLock "CCF Parameter - SunGblClTelLock

MDF - 0x4985";
CM_ SG_ 1025 CcfTelLock "CCF Parameter - TelLock

MDF - 0x4981";
CM_ SG_ 1025 CcfTelUnlock "CCF Parameter - TelUnlock

MDF - 0x4987";
CM_ SG_ 1025 CcfTrailerLightTest "CCF Parameter - TrailerLightTest

MDF - 0x4921";
CM_ SG_ 1025 CcfVehicleLocator "CCF Parameter - VehicleLocator

MDF - 0x4977";
CM_ SG_ 1025 CcfWalkAwayLocking "CCF Parameter - WalkAwayLocking

MDF - 0x4927";
CM_ SG_ 1025 CcfWinGblClTelLock "CCF Parameter - WinGblClTelLock

MDF - 0x4983";
CM_ SG_ 1025 Ccf2ndRowLoadSpace "CCF Parameter - 2ndRowLoadSpace

MDF - 0x4A37";
CM_ SG_ 1025 CcfActiveVanes "Car Configuration Active Vanes
Payload MDF = 0x4A77

LogicalValue 2 indicates that the vehicle features Active vanes technology. This could be Active Vanes in the upper grill aperture only, Active Vanes in the lower grill aperture only, Active Vanes in the upper and lower grill aperture.";
CM_ SG_ 1025 CcfArmouredVehicle "CCF Parameter Name - ArmouredVehicle

Payload MDF = 0x4A87";
CM_ SG_ 1025 CcfDriverDoorLockLED "CCF Parameter Name - DriverDoorLockLED

Payload MDF = 0x4A32";
CM_ SG_ 1025 CcfFntLowBeamProfile "CCF Parameter - FntLowBeamProfile

MDF - 0x4A55";
CM_ SG_ 1025 CcfHeightDataInputSelection "CCF Parameter - HeightDataInputSelection

MDF - 0x4A57";
CM_ SG_ 1025 CcfHUDNavigation "CCF Parameter - HUDNavigation

MDF - 0x4A67";
CM_ SG_ 1025 CcfPassDoorLockLED "CCF Parameter Name - PassDoorLockLED

Payload MDF = 0x4A35";
CM_ SG_ 1025 CcfPwrTailKickSen "CCF Parameter - PwrTailKickSen

MDF - 0x4A27";
CM_ SG_ 1025 CcfPwrTailProxSenPEPS "CCF Parameter - PwrTailProxSenPEPS

MDF - 0x4A25";
CM_ SG_ 1025 CcfRearPosProfile "CCF Parameter - RearPosProfile

MDF - 0x4A75";
CM_ SG_ 1025 CcfRearSMProfile "CCF Parameter - RearSMProfile

MDF - 0x4A85";
CM_ SG_ 1025 CcfRearStopProfile "CCF Parameter - RearStopProfile

MDF - 0x4A65";
CM_ SG_ 1025 CcfRLPassDoorLockLED "CCF Parameter Name - RLPassDoorLockLED

Payload MDF = 0x4A42";
CM_ SG_ 1025 CcfRRPassDoorLockLED "CCF Parameter Name - RRPassDoorLockLED

Payload MDF = 0x4A45";
CM_ SG_ 1025 CcfStopStartInhibitIcon "CCF Parameter - StopStartInhibitIcon

MDF - 0x4A47";
CM_ SG_ 1025 CcfTelAlarmReset "CCF Parameter - TelAlarmReset

MDF - 0x4A23";
CM_ SG_ 1025 CcfVASSensorOvride "CCF Parameter - VASSensorOvride

MDF - 0x4A21";
CM_ SG_ 1025 CcfAlrmSensOnSingLock "CCF Parameter - AlrmSensOnSingLock

MDF - 0x5147";
CM_ SG_ 1025 CcfBodyStyleRoofStructure "Car Configuration - BodyStyleRoofStructure
MDF = 0x5187";
CM_ SG_ 1025 CcfDynamicProgMode "CCF Parameter - DynamicProgMode

MDF - 0x5132";
CM_ SG_ 1025 CcfECOProgMode "CCF Parameter - ECOProgMode

MDF - 0x5135";
CM_ SG_ 1025 CcfFntDRLOpenLoad "CCF Parameter - FntDRLOpenLoad

MDF - 0x5172";
CM_ SG_ 1025 CcfFntFogOpenLoad "CCF Parameter - FntFogOpenLoad

MDF - 0x5182";
CM_ SG_ 1025 CcfFntLowBeamOpenLoad "CCF Parameter - FntLowBeamOpenLoad

MDF - 0x5175";
CM_ SG_ 1025 CcfFntPosOpenLoad "CCF Parameter - FntPosOpenLoad

MDF - 0x5165";
CM_ SG_ 1025 CcfFntSMOpenLoad "CCF Parameter - FntSMOpenLoad

MDF - 0x5162";
CM_ SG_ 1025 CcfLockFuelFillFlap "CCF Parameter - LockFuelFillFlap

MDF - 0x5167";
CM_ SG_ 1025 CcfMaxVehicleSpeed "Car Configuration -  Maximum Vehicle Speed

Payload MDF = 0x5157";
CM_ SG_ 1025 CcfMHLastUserMode "Car Configuration - Micro Hybrid Last User Memory mode
MDF - 0x5177";
CM_ SG_ 1025 CcfPartialNetworkEnable "CCF Parameter - PartialNetworkEnable

MDF - 0x5127";
CM_ SG_ 1025 CcfRearPosOpenLoad "CCF Parameter - RearPosOpenLoad

MDF - 0x5185";
CM_ SG_ 1025 CcfRockCrawlMode "CCF Parameter - RockCrawlMode

MDF - 0x5125";
CM_ SG_ 1025 CcfSandProgMode "CCF Parameter - SandProgMode

MDF - 0x5122";
CM_ SG_ 1025 CcfSideWinGlassThick "CCF Parameter - SideWinGlassThick

MDF - 0x5137";
CM_ SG_ 1025 CcfUSB2Hub "CCF Parameter - USB2Hub

MDF - 0x5142";
CM_ SG_ 1025 CcfUSB3Repeater "CCF Parameter - USB3Repeater

MDF - 0x5145";
CM_ SG_ 1025 CcfAutoAccess "CCF Parameter - AutoAccess

MDF - 0x5365";
CM_ SG_ 1025 CcfCoolingFanFitment "Car Configuration - CoolingFanFitment
Payload MDF = 0x5347";
CM_ SG_ 1025 CcfDriverMemDrSwtchPk "CCF Parameter - DriverMemDrSwtchPk

MDF - 0x5331";
CM_ SG_ 1025 CcfEDiffType "Car configuration Parameter - EDiff Type

Payload MDF = 0x5327";
CM_ SG_ 1025 CcfGenericEngPwrOut "Car Configuration - Generic Engine Power Output (owned by TCM)
Payload MDF = 0x5374
";
CM_ SG_ 1025 CcfHdlampLvlSensPos "CCF Parameter - HdlampLvlSensPos

MDF - 0x5367";
CM_ SG_ 1025 CcfLRTerrainJGAllRdLaunch "CCF Parameter - LRTerrainJGAllRdLaunch

MDF - 0x5357";
CM_ SG_ 1025 CcfPassMemDrSwtchPk "CCF Parameter - PassMemDrSwtchPk

MDF - 0x5333";
CM_ SG_ 1025 CcfPTCruiseFitment "Car Configuration - Powertrain Cruise fitment (owned by PCM)

Payload MDF = 0x5377";
CM_ SG_ 1025 CcfRearDriverMemDrSwtchPk "CCF Parameter - RearDriverMemDrSwtchPk

MDF - 0x5335";
CM_ SG_ 1025 CcfRearPassMemDrSwtchPk "CCF Parameter - RearPassMemDrSwtchPk

MDF - 0x5337";
CM_ SG_ 1025 CcfSpdoCalkmhOffset "Car Configuration - Jaguar Speedo calibration - km/h Offset

Payload MDF = 0x5323";
CM_ SG_ 1025 CcfSpdoCalPercentScale "Car Configuration - Jaguar Speedo calibration - Percentage Scaling

Payload MDF = 0x5344";
CM_ SG_ 1025 CcfSplitStopFailStrat "CCF Parameter - SplitStopFailStrat

MDF - 0x5355";
CM_ SG_ 1025 CcfSteerWlhlSwtchType "CCF Parameter - SteerWlhlSwtchType

MDF - 0x5352";
CM_ SG_ 1025 CcfTowAssist "CCF Parameter Name - TowAssist

Payload MDF = 0x5362";
CM_ SG_ 1025 CcfTPMSCalibration "CCF Parameter - TPMSCalibration

MDF - 0x5387";
CM_ SG_ 1025 CcfBrakeDiscMaterial "Car Configuration - BrakeDiscMaterial
Payload MDF = 0x5542";
CM_ SG_ 1025 CcfBrakeDiscSizeFront "Car Configuration - BrakeDiscSizeFront

Payload MDF = 0x5533";
CM_ SG_ 1025 CcfBrakeDiscSizeRear "Car Configuration - BrakeDiscSizeRear
Payload MDF = 0x5537";
CM_ SG_ 1025 CcfElectricFan "Car Configuration - Electric Fan

Payload MDF = 0x5545";
CM_ SG_ 1025 CcfRearDriverLinSWP "CCF Parameter - RearDriverLinSWP

MDF - 0x5523";
CM_ SG_ 1025 CcfRearPassLinSWP "CCF Parameter - RearPassLinSWP

MDF - 0x5527";
CM_ SG_ 1025 CcfServiceInterval "Car Configuration - Service Interval

Payload MDF = 0x5557 & 0x5567";
CM_ SG_ 1025 CcfSportbrake "CCF to indicate whether the vehicle is sportbrake or not

MDF = 0x5547
";
CM_ SG_ 1025 CcfTyreDynamicRollRad "Car Configuration - Tyre Dynamic Rolling Radius signal

Payload MDF = 0x5577 & 0x5587";
CM_ SG_ 1025 CcfBrakeWarningSymbol "CCF Parameter - BrakeWarningSymbol

MDF - 0x5732";
CM_ SG_ 1025 CcfChassisDescription "Car Configuration - ChassisDescription

Payload MDF = 0x5727";
CM_ SG_ 1025 CcfConfigDynamicMode "Car Configuration - ConfigDynamicMode
Payload MDF = 0x5741
";
CM_ SG_ 1025 CcfGearboxdescription "Car Configuration - Gearbox description

Payload MDF = 0x5723";
CM_ SG_ 1025 ccfGenericWheelBase "Car Configuration - Generic Wheel Base

Payload MDF = 0x5747";
CM_ SG_ 1025 CcfPTAODieWaterInSensr "Car Configuration - Powertrain Accessory options - Diesel Water in Fuel Sensor

Payload MDF = 0x5737";
CM_ SG_ 1025 CcfReverseGearSelStrat "Car Configuration - Reverse Gear Selection Strategy

Value	State Description
0x00	Not supported
0X01    Reverse Gear Selection Strategy Disabled
0x02    Reverse Gear Selection Strategy Enabled
0x03    Error 


Payload MDF = 0x5743";
CM_ SG_ 1025 CcfTransmissionSelectr "Car Configuration - Transmission Selector

Payload MDF = 0x5735";
CM_ SG_ 1025 CcfVINPart1 "Car Configuration - VIN Part 1

VIN Character 1 (Geographic Area) 
VIN Character 2 (Country) 
VIN Character 3 (Manufacturer) 
VIN Character 4 (Market/Specification) 

Payload MDF = 0x5757, 0x5767, 0x5777, 0x5787
";
CM_ SG_ 1025 CcfVINPart2 "Car Configuration - VIN Part 2

VIN Character 5 (Transmission & Steering) 
VIN Character 6 (Model Range) 
VIN Character 7 (Model Range) 
VIN Character 8 (Emission Control System) 
VIN Character 9 (Check Digit) 
VIN Character 10 (Model Year) 
VIN Character 11 (Assembly Plant & Model Line) 

Payload MDF = 0x0x5827, 0x5837, 0x5847, 0x5857, 0x5867, 0x5877, 0x5887";
CM_ SG_ 1025 CcfFntClusterCableLgth "CCF Parameter - FntClusterCableLgth

MDF - 0x5987";
CM_ SG_ 1025 CcfFntDispCableLgth "CCF Parameter - FntDispCableLgth

MDF - 0x5983";
CM_ SG_ 1025 CcfVINPart3 "Car Configuration - VIN Part 3

VIN Character 12 (Serial Number 1) 
VIN Character 13 (Serial Number 2) 
VIN Character 14 (Serial Number 3) 
VIN Character 15 (Serial Number 4) 
VIN Character 16 (Serial Number 5) 
VIN Character 17 (Serial Number 6)

Payload MDF = 0x5927,  0x5937, 0x5947, 0x5957, 0x5967, 0x5977
";
CM_ SG_ 1025 CcfAllSurfaceInfo "CCF Parameter - AllSurfaceInfo

MDF - 0x5A47";
CM_ SG_ 1025 CcfBrowserSearch "CCF Parameter - BrowserSearch

MDF - 0x5A52";
CM_ SG_ 1025 CcfDriverWinSWPack "CCF Parameter - DriverWinSWPack

MDF - 0x5A55";
CM_ SG_ 1025 CcfFntUIPCableLgth "CCF Parameter - FntUIPCableLgth

MDF - 0x5A23";
CM_ SG_ 1025 CcfRearLftDispCableLgth "CCF Parameter - RearLftDispCableLgth

MDF - 0x5A27";
CM_ SG_ 1025 CcfRearRghtDisplayCableLgth "CCF Parameter - RearRghtDisplayCableLgth

MDF - 0x5A33";
CM_ SG_ 1025 CcfRearUIPLnk1CableLgth "CCF Parameter - RearUIPLnk1CableLgth

MDF - 0x5A37";
CM_ SG_ 1025 CcfRearUIPLnk2CableLgth "CCF Parameter - RearUIPLnk2CableLgth

MDF - 0x5A43";
CM_ SG_ 1025 CcfRrLmpBhWhTgateOpen "CCF Parameter - RrLmpBhWhTgateOpen

MDF - 0x5A45";
CM_ SG_ 1025 CcfSeatLumbSWFittedD "CCF Parameter - SeatLumbSWFittedD

MDF - 0x5A71";
CM_ SG_ 1025 CcfSeatLumbSWFittedP "CCF Parameter - SeatLumbSWFittedP

MDF - 0x5A73";
CM_ SG_ 1025 CcfSeatLumbSWFittedRD "CCF Parameter - SeatLumbSWFittedRD

MDF - 0x5A75";
CM_ SG_ 1025 CcfSeatLumbSWFittedRP "CCF Parameter - SeatLumbSWFittedRP

MDF - 0x5A77";
CM_ SG_ 1025 CcfSeatMasgSWFittedD "CCF Parameter - SeatMasgSWFittedD

MDF - 0x5A61";
CM_ SG_ 1025 CcfSeatMasgSWFittedP "CCF Parameter - SeatMasgSWFittedP

MDF - 0x5A63";
CM_ SG_ 1025 CcfSeatMasgSWFittedRD "CCF Parameter - SeatMasgSWFittedRD

MDF - 0x5A65";
CM_ SG_ 1025 CcfSeatMasgSWFittedRP "CCF Parameter - SeatMasgSWFittedRP

MDF - 0x5A67";
CM_ SG_ 1025 CcfSeatMovSWFittedD "CCF Parameter - SeatMovSWFittedD

MDF - 0x5A81";
CM_ SG_ 1025 CcfSeatMovSWFittedP "CCF Parameter - SeatMovSWFittedP

MDF - 0x5A83";
CM_ SG_ 1025 CcfSeatMovSWFittedRD "CCF Parameter - SeatMovSWFittedRD

MDF - 0x5A85";
CM_ SG_ 1025 CcfSeatMovSWFittedRP "CCF Parameter - SeatMovSWFittedRP

MDF - 0x5A87";
CM_ SG_ 1025 CcfSeatPSASWFitted "CCF Parameter - SeatPSASWFitted

MDF - 0x5A57";
CM_ SG_ 1025 CcfDieselEMSEmissMkt "Car Configuration - DieselEMSEmissMkt

Payload MDF = 0x5C73";
CM_ SG_ 1025 CcfDriverID "CCF Parameter - DriverID

MDF - 0x5C22";
CM_ SG_ 1025 CcfDriverIDKeys "CCF Parameter - DriverIDKeys

MDF - 0x5C27";
CM_ SG_ 1025 CcfDriverIDPhones "CCF Parameter - DriverIDPhones

MDF - 0x5C37";
CM_ SG_ 1025 CcfDriverIDSeats "CCF Parameter - DriverIDSeats

MDF - 0x5C44";
CM_ SG_ 1025 CcfEcoDataGallonType "CCF Parameter - EcoDataGallonType

MDF - 0x5C47";
CM_ SG_ 1025 CcfFrntLowerDispKeys "CCF Parameter - FrntLowerDispKeys

MDF - 0x5C62";
CM_ SG_ 1025 CcfFrntLowerDispVariant "CCF Parameter - FrntLowerDispVariant

MDF - 0x5C53";
CM_ SG_ 1025 CcfFrntUpperDeployable "CCF Parameter - FrntUpperDeployable

MDF - 0x5C64";
CM_ SG_ 1025 CcfFrntUpperDispVariant "CCF Parameter - FrntUpperDispVariant

MDF - 0x5C57";
CM_ SG_ 1025 CcfFrontPassengerID "CCF Parameter - FrontPassengerID

MDF - 0x5C25";
CM_ SG_ 1025 CcfNGICamBanStrat "CCF Parameter - NGICamBanStrat

MDF - 0x5C77";
CM_ SG_ 1025 CcfNonDepIllumDoorHnd "CCF Parameter - NonDepIllumDoorHnd

MDF - 0x5C75";
CM_ SG_ 1025 CcfPersonalisation "Car COnfiguration Parameter 639 - Personalisation

Payload MDF: 0x5C35
";
CM_ SG_ 1025 CcfRow2PassengerID "CCF Parameter - Row2PassengerID

MDF - 0x5C32";
CM_ SG_ 1025 CcfRow3PassengerID "CCF Parameter - Row3PassengerID

MDF - 0x5C42";
CM_ SG_ 1025 CcfSmartExitFntDrvDr "CCF - SmartExitFntDrvDr 

MDF 0x5C81
";
CM_ SG_ 1025 CcfSmartExitFntPassDoor "CCF - SmartExitFntPassDoor 

 MDF 0x5C83
";
CM_ SG_ 1025 CcfSmartExitRrDrvDoor "CCF - SmartExitRrDrvDoor 

MDF 0x5C85
";
CM_ SG_ 1025 CcfSmartExitRrPassDoor "CCF - SmartExitRrPassDoor 

MDF 0x5C87
";
CM_ SG_ 1025 CcfTransCalIndex "Car Configuration Parameter - TransCalibrationIndex

Payload MDF = 0x5C67";
CM_ SG_ 1025 CcfChargingInlet1 "CCF Parameter - ChargingInlet1

MDF - 0x5D43";
CM_ SG_ 1025 CcfChargingInlet2 "CCF Parameter - ChargingInlet2

MDF - 0x5D47";
CM_ SG_ 1025 CcfEMMaxDurEngOff "Signal required to transmit CCF variable EMMaxDurEngOff to the PCM. which allows the dealer to update the maximum time between engine maintenance engine starts. If we find that certain combinations of components in certain regions require shorter intervals, then this car config parameter will save us time and money.

MDF: 0x5D67";
CM_ SG_ 1025 CcfFMMaxFuelAge "Signal required to transmit CCF variable FMMaxFuelAge to the PCM. Which allows the dealer to update the maximum fuel age before fuel maintanance mode starts. If we find that certain combinations of componants in certain reigions require shorter or longer intervals, then this car config perameter will save us time and money.
MDF = 0x5D77
";
CM_ SG_ 1025 CcfFntPassWdowSwtchPk "CCF Parameter Name - FntPassWdowSwtchpk

Payload MDF = 0x5D27";
CM_ SG_ 1025 CcfFrntDrvWdowSwtchpk "CCF Parameter - FrntDrvWdowSwtchpk

MDF - 0x5D23";
CM_ SG_ 1025 CcfMicrophoneType "CCF Parameter - MicrophoneType

MDF - 0x5D53";
CM_ SG_ 1025 CcfRrDrWdowSwtchPk "CCF Parameter - RrDrvWdowSwtchpk

MDF - 0x5D33";
CM_ SG_ 1025 CcfRrPassWdowSwtchpk "CCF Parameter - RrPassWdowSwtchpk

MDF - 0x5D37";
CM_ SG_ 1025 CcfSelectStateCharge "CCF Parameter - SelectStateCharge

MDF - 0x5D87";
CM_ SG_ 1025 CcfTelematicsSpkrType "CCF Parameter - TelematicsSpkrType

MDF - 0x5D57";
CM_ SG_ 1025 CcfTimedChrgFeature "CCF Parameter - TimedChrgFeature

MDF - 0x5D82";
CM_ SG_ 1025 CcfWirelessCharger "Car Configuration Parameter - WirelessCharger
MDF = 0x5D85";
CM_ SG_ 1025 CcfAuxCoolingPump "Car Configuration - Auxiliary Cooling Pump
Vehicle fitted with this pump will be market based and cannot use the generic FED, RoW, EU2, EU6 calibrations to define it.
MDF = 0x5E74";
CM_ SG_ 1025 CcfBrakePedalFeel "Car Configuration - BrakePedalFeel

Payload MDF = 0x5E47";
CM_ SG_ 1025 CcfCleanSurroundCams "CCF Parameter - CleanSurroundCams

MDF - 0x5E77";
CM_ SG_ 1025 CcfCntrRetractPretRow1 "CCF Parameter - CntrRetractPretRow1

MDF - 0x5E61";
CM_ SG_ 1025 CcfCntrRetractPretRow2 "CCF Parameter - CntrRetractPretRow2

MDF - 0x5E63";
CM_ SG_ 1025 CcfCntrRetractPretRow3 "CCF Parameter - CntrRetractPretRow3

MDF - 0x5E65";
CM_ SG_ 1025 CcfFarSideOccImpAbgRow1 "CCF Parameter - FarSideOccImpAbgRow1

MDF - 0x5E67";
CM_ SG_ 1025 CcfGrndMarkingDetect "CCF to show if ground marking detection is available

MDF = 0x5E84";
CM_ SG_ 1025 CcfIMCClusterAPIXClrDpth "CCF Parameter - IMCClusterAPIXClrDpth

MDF - 0x5E53";
CM_ SG_ 1025 CcfIMCClusterAPIXVideoSpd "CCF Parameter - IMCClusterAPIXVideoSpd

MDF - 0x5E57";
CM_ SG_ 1025 CcfOpenableICP "CCF Parameter - OpenableICP

MDF - 0x5E37";
CM_ SG_ 1025 CcfParkAidCommsBus "Car Configuration Parameter - ParkAidCommsBus

MDF = 0x5E27";
CM_ SG_ 1025 CcfParkAssistHMI "CCF to indicate the HMI variant

MDF = 0x5E87
";
CM_ SG_ 1025 CcfPNPreConEnable "CCF Parameter - PNPreConEnable

MDF - 0x5E71";
CM_ SG_ 1025 CcfRearRoofBlindFitted "CCF Parameter - RearRoofBlindFitted

MDF - 0x5E35";
CM_ SG_ 1025 CcfReverseMirrorDip "CCF Parameter Name - ReverseMirrorDip

Payload MDF = 0x5E22";
CM_ SG_ 1025 CcfReverseMirrorDipStrat "Reverse Mirror Dip Strat CCF 

MDF 0x5E25
";
CM_ SG_ 1025 CcfRoofType "CCF parameter - Roof Type
MDF = 0x5E82";
CM_ SG_ 1025 CcfSeatThermHMIControl "CCF Parameter - SeatThermHMIControl

MDF - 0x5E33";
CM_ SG_ 1025 CcfAskOnExit "CCF Parameter - AskOnExit

MDF - 0x6253";
CM_ SG_ 1025 CcfBacklightStratSel "CCF Parameter - BacklightStratSel

MDF - 0x6237";
CM_ SG_ 1025 CcfBodyKitStyle "CCF Parameter - BodyKitStyle

MDF - 0x6223";
CM_ SG_ 1025 CcfClearExitDetectionSystem "CCF Parameter - ClearExitDetectionSystem

MDF - 0x6225";
CM_ SG_ 1025 CcfDriveAssist "CCF Parameter - DriveAssist

MDF - 0x6235";
CM_ SG_ 1025 CcfDriverHeatedCalfRest "CCF for Heated Calf rest fittment
MDF = 0x6274";
CM_ SG_ 1025 CcfDynamicLiteMode "CCF Parameter - DynamicLiteMode

MDF - 0x6247";
CM_ SG_ 1025 CcfEngineNoiseCancel "CCF Parameter - EngineNoiseCancel

MDF - 0x6255";
CM_ SG_ 1025 CcfFront23BuckSwitch "Car Configuration - Front23BuckSwitch

Payload MDF = 0x6251";
CM_ SG_ 1025 CcfHeatedDoorArmrest "CCF for Heated Door Armrests

Payload MDF value = 0x6262";
CM_ SG_ 1025 CcfHeatedMapPocket "CCF for Heated Map pocket

MDF value = 0x6281";
CM_ SG_ 1025 CcfHtdFrntCntreArmrst "CCF for Front Centre Heated Armrest

MDF 0x6265";
CM_ SG_ 1025 CcfHtdRearCntreArmrst "CCF for rear centre heated armrest
MDF value = 0x6272";
CM_ SG_ 1025 CcfIntelEmrgBrkingCAEB "CCF Parameter - IntelEmrgBrkingCAEB

MDF - 0x6257";
CM_ SG_ 1025 CcfLowerGloveBox "CCF Parameter - LowerGloveBox

MDF - 0x6287";
CM_ SG_ 1025 CcfRow3BuckleSwitch "CCF Parameter - Row3BuckleSwitch

MDF - 0x6267";
CM_ SG_ 1025 CcfSAPServerType "CCF Parameter - SAPServerType

MDF - 0x6242";
CM_ SG_ 1025 CcfSeatTherm2ndRowHMIControl "CCF Parameter - SeatTherm2ndRowHMIControl

MDF - 0x6244";
CM_ SG_ 1025 CcfSuspensionType "CCF Parameter - SuspensionType

MDF - 0x6233";
CM_ SG_ 1025 CcfTaskLighting "CCF Parameter - TaskLighting

MDF - 0x6227";
CM_ SG_ 1025 CcfUpperGloveBox "CCF Parameter - UpperGloveBox

MDF - 0x6284";
CM_ SG_ 1025 CcfUWBPEPSRANGEADJUSTUSEVSA "CCF Parameter - UWBPEPSRANGEADJUSTUSEVSA

MDF - 0x6277";
CM_ SG_ 1025 CcfADBInitialisation "CCF Parameter - ADBInitialisation

MDF - 0x6387";
CM_ SG_ 1025 CcfAutoVentsType "CCF Parameter - AutoVentsType

MDF - 0x6385";
CM_ SG_ 1025 CcfDisplaySeatTempIntensity "CCF Parameter - DisplaySeatTempIntensity

MDF - 0x6347";
CM_ SG_ 1025 CcfDisplaySeatTempZone "CCF Parameter - DisplaySeatTempZone

MDF - 0x6343";
CM_ SG_ 1025 CcfDriverMicrophoneType "CCF Parameter - DriverMicrophoneType

MDF - 0x6382";
CM_ SG_ 1025 CcfElectFrntLoadspace "CCF Parameter - ElectFrntLoadspace

MDF - 0x6355";
CM_ SG_ 1025 CcfExhaustHeatshieldType "CCF Parameter - ExhaustHeatshieldType

MDF - 0x6374";
CM_ SG_ 1025 CcfExhaustType "CCF Parameter - ExhaustType

MDF - 0x6337";
CM_ SG_ 1025 CcfMirrorPositionFeature "Level of the DZM feature reporting external mirrors position (estimate/accurate folded/unfolded/intermediate)
MDF 0x6332 ";
CM_ SG_ 1025 CcfRearBumperType "CCF Parameter - RearBumperType

MDF - 0x6364";
CM_ SG_ 1025 CcfSeatMsg2ndRowHMIControl "CCF Parameter - SeatMsg2ndRowHMIControl

MDF - 0x6334";
CM_ SG_ 1025 CcfSeatMsgHMIControl "CCF Parameter - SeatMsgHMIControl

MDF - 0x6353";
CM_ SG_ 1025 CcfSlopeInformation "CCF Parameter - SlopeInformation

MDF - 0x6377";
CM_ SG_ 1025 CcfTouristMode "CCF Parameter - TouristMode

MDF - 0x6357";
CM_ SG_ 1025 CcfUWBSATFreqChannel "CCF Parameter - UWBSATFreqChannel

MDF - 0x6327";
CM_ SG_ 1025 CcfWheelInformation "CCF Parameter - WheelInformation

MDF - 0x6367";
CM_ SG_ 1025 CcfAdapDrvBeamSeg "CCF Parameter - AdapDrvBeamSeg

MDF - 0x6557";
CM_ SG_ 1025 CcfAdasNCapESS "CCF Parameter - AdasNCapESS

MDF - 0x6585";
CM_ SG_ 1025 CcfAdasNCapLKAUpcomTraff "CCF Parameter - AdasNCapLKAUpcomTraff

MDF - 0x6587";
CM_ SG_ 1025 CcfBCMInteriorLightDelay "CCF Parameter - BCMInteriorLightDelay

MDF - 0x6547";
CM_ SG_ 1025 CcfBCMInteriorLightTrunk "CCF Parameter - BCMInteriorLightTrunk

MDF - 0x6544";
CM_ SG_ 1025 CcfBrakeFluidLvlSource "Source of the Brake Fluid Level Warning signal.

MDF - 0x6581";
CM_ SG_ 1025 CcfDeployableSideStepType "CCF Parameter - DeployableSideStepType

MDF - 0x6563";
CM_ SG_ 1025 CcfDynBendingLight "CCF Parameter - DynBendingLight

MDF - 0x6575";
CM_ SG_ 1025 CcfESSCalibration "CCF Parameter - ESSCalibration

MDF - 0x6522";
CM_ SG_ 1025 CcfExteriorMirrorAutoUnfold "CCF Parameter - ExteriorMirrorAutoUnfold

MDF - 0x6542";
CM_ SG_ 1025 CcfFuelGaugeVariant2 "CCF Parameter - FuelGaugeVariant2

MDF - 0x6537";
CM_ SG_ 1025 CcfLKARE "CCF Parameter - LKARE

MDF - 0x6571";
CM_ SG_ 1025 CcfPassKneeAirbag "CCF Parameter Name - PassKneeAirbag 
Payload MDF = 0x6583";
CM_ SG_ 1025 CcfSeatMvmtModuleType "CCF Parameter - SeatMvmtModuleType

MDF - 0x6567";
CM_ SG_ 1025 CcfSignPostDimming "CCF Parameter - SignPostDimming

MDF - 0x6577";
CM_ SG_ 1025 CcfSupMainBeamRoutIntensity "CCF Parameter - SupMainBeamRoutIntensity

MDF - 0x6533";
CM_ SG_ 1025 CcfTJAICARE "CCF Parameter - TJAICARE

MDF - 0x6573";
CM_ SG_ 1025 CcfWakeupShutdownSeqTyp "CCF Parameter - WakeupShutdownSeqTyp

MDF - 0x6527";
CM_ SG_ 1025 CcfACCAccelProfileSelect "CCF Parameter - ACCAccelProfileSelect

MDF - 0x6665";
CM_ SG_ 1025 CcfACCLeadCarDistDisp "CCF Parameter - ACCLeadCarDistDisp

MDF - 0x6661";
CM_ SG_ 1025 CcfACCStopGapSelect "CCF Parameter - ACCStopGapSelect

MDF - 0x6663";
CM_ SG_ 1025 CcfAdasDCR "CCF Parameter - AdasDCR

MDF - 0x6673";
CM_ SG_ 1025 CcfAdasLongCRA "CCF Parameter - AdasLongCRA

MDF - 0x6621";
CM_ SG_ 1025 CcfAdasLongRPC "CCF Parameter - AdasLongRPC

MDF - 0x6623";
CM_ SG_ 1025 CcfAdasNCapCyclistAEB "CCF Parameter - AdasNCapCyclistAEB

MDF - 0x6633";
CM_ SG_ 1025 CcfAdasTJP "CCF Parameter - AdasTJP

MDF - 0x6635";
CM_ SG_ 1025 CcfAutoHold "CCF Parameter to enable or disable Hydraulic Vehicle Hold

MDF = 0x6653";
CM_ SG_ 1025 CcfDSMFitment "CCF Parameter - DSMFitment

MDF - 0x6637";
CM_ SG_ 1025 CcfESSCalNo "CCF Parameter - ESSCalNo

MDF - 0x6687";
CM_ SG_ 1025 CcfIntMirrorVariant "CCF Parameter - IntMirrorVariant

MDF - 0x6657";
CM_ SG_ 1025 CcfLaneKeepAssistLDW "CCF Parameter - LaneKeepAssistLDW

MDF - 0x6631";
CM_ SG_ 1025 CcfLeftManoeuvringLgt "CCF Parameter - LeftManoeuvringLgt

MDF - 0x6625";
CM_ SG_ 1025 CcfParkPawlLocation "CCF Parameter - ParkPawlLocation

MDF - 0x6677";
CM_ SG_ 1025 CcfPassHeatedCalfRest "CCF Parameter - PassHeatedCalfRest

MDF - 0x6667";
CM_ SG_ 1025 CcfPSMFitment "CCF Parameter - PSMFitment

MDF - 0x6641";
CM_ SG_ 1025 CcfR2SMFitment "CCF Parameter - R2SMFitment

MDF - 0x6647";
CM_ SG_ 1025 CcfR3SMFitment "CCF Parameter - R3SMFitment

MDF - 0x6651";
CM_ SG_ 1025 CcfRghtManoeuvringLgt "CCF Parameter - RghtManoeuvringLgt

MDF - 0x6627";
CM_ SG_ 1025 CcfRLSMFitment "CCF Parameter - RLSMFitment

MDF - 0x6643";
CM_ SG_ 1025 CcfRRSMFitment "CCF Parameter - RRSMFitment

MDF - 0x6645";
CM_ SG_ 1025 CcfSeatMassHanded "CCF Parameter - SeatMassHanded

MDF - 0x6671";
CM_ SG_ 1025 CcfARNCCalNo "CCF Parameter - ARNCCalNo

MDF - 0x6737";
CM_ SG_ 1025 CcfASDExhaustCalNo "CCF Parameter - ASDExhaustCalNo

MDF - 0x6777";
CM_ SG_ 1025 CcfAVNCalNo "CCF Parameter - AVNCalNo

MDF - 0x6787";
CM_ SG_ 1025 CcfCDLGlobalClose "CCF Parameter Name - CDLGlobalClose

Payload MDF = 0x6767";
CM_ SG_ 1025 CcfCDLGlobalOpen "CCF Parameter Name - CDLGlobalOpen

Payload MDF = 0x6765";
CM_ SG_ 1025 CcfCityUrbanAutoEmerBraking "CCF Parameter - CityUrbanAutoEmerBraking

MDF - 0x6744
";
CM_ SG_ 1025 CcfCyCAutoEmerBraking "CCF Parameter - CyCAutoEmerBraking

MDF - 0x6763";
CM_ SG_ 1025 CcfEOCCalNo "CCF Parameter - EOCCalNo

MDF - 0x6727";
CM_ SG_ 1025 CcfFrontBeltMinder "CCF Parameter - FrontBeltMinder

MDF - 0x6742";
CM_ SG_ 1025 CcfFrontPreCrashSunRoof "CCF Parameter - FrontPreCrashSunRoof

MDF - 0x6755";
CM_ SG_ 1025 CcfFwdCollisionWarn "CCf - FwdCollisionWarn

MDF - 0x6747";
CM_ SG_ 1025 CcfIntelligentEmerBraking "CCF Parameter - IntelligentEmerBraking

MDF - 0x6761";
CM_ SG_ 1025 CcfJuncAutoEmerBraking "CCF Parameter - JuncAutoEmerBraking

MDF - 0x6753";
CM_ SG_ 1025 CcfOverspeedIndia "CCF Parameter - OverspeedIndia

MDF - 0x6757";
CM_ SG_ 1025 CcfPedAutoEmerBraking "CCF Parameter - PedAutoEmerBraking

MDF - 0x6751";
CM_ SG_ 1025 CcfAutolampFastResponse "CCF Parameter - AutolampFastResponse

MDF - 0x6885";
CM_ SG_ 1025 CcfChargeFlap1 "CCF Parameter - ChargeFlap1

MDF - 0x6843";
CM_ SG_ 1025 CcfChargeFlap2 "CCF Parameter - ChargeFlap2

MDF - 0x6847";
CM_ SG_ 1025 CcfEOCExhaustCalNo "CCF Parameter - EOCExhaustCalNo

MDF - 0x6827";
CM_ SG_ 1025 CcfHeadlampWash "CCF Parameter - HeadlampWash

MDF - 0x6887";
CM_ SG_ 1025 CcfMemorySwitchType "CCF Parameter Name - MemorySwitchType

Payload MDF = 0x6851";
CM_ SG_ 1025 CcfRainSensorFitment "CCF Parameter - RainSensorFitment

MDF - 0x6855";
CM_ SG_ 1025 CcfRCTAConfiguration "CCF Parameter - RCTAConfiguration

MDF - 0x6834";
CM_ SG_ 1025 CcfSeatSwitchPackPos "CCF Parameter Name - SeatSwitchPackPos

Payload MDF = 0x6837";
CM_ SG_ 1025 CcfSMRFGlobalClose "CCF Parameter Name - SMRFGlobalClose

Payload MDF = 0x6831";
CM_ SG_ 1025 CcfWiperColdClimDLRWash "CCF Parameter - WiperColdClimDLRWash

MDF - 0x6873";
CM_ SG_ 1025 CcfWiperCollarSwtchRnSenSeni "CCF Parameter - WiperCollarSwtchRnSenSeni

MDF - 0x6875";
CM_ SG_ 1025 CcfWiperDripWipeFeature "CCF Parameter - WiperDripWipeFeature

MDF - 0x6865";
CM_ SG_ 1025 CcfWiperFntSpeedDepend "CCF Parameter - WiperFntSpeedDepend

MDF - 0x6861";
CM_ SG_ 1025 CcfWiperHdlmpWshPressure "CCF Parameter - WiperHdlmpWshPressure

MDF - 0x6881";
CM_ SG_ 1025 CcfWiperHeadlmpWashDLR "CCF Parameter - WiperHeadlmpWashDLR

MDF - 0x6871";
CM_ SG_ 1025 CcfWiperInterSpdDepend "CCF Parameter - WiperInterSpdDepend

MDF - 0x6853";
CM_ SG_ 1025 CcfWiperProgramWipeActive "CCF Parameter - WiperProgramWipeActive

MDF - 0x6863";
CM_ SG_ 1025 CcfWiperRearContinue "CCF Parameter - WiperRearContinue

MDF - 0x6857";
CM_ SG_ 1025 CcfWiperRrHlfMoonParkSwtch "CCF Parameter - WiperRrHlfMoonParkSwtch

MDF - 0x6883";
CM_ SG_ 1025 CcfWiperTwinWasherBottle "CCF Parameter - WiperTwinWasherBottle

MDF - 0x6877";
CM_ SG_ 1025 CcfWiperUpStroke "CCF Parameter - WiperUpStroke

MDF - 0x6867";
CM_ SG_ 1025 CcfActiveExhaustMap "CCF Parameter - ActiveExhaustMap

MDF - 0x6B73";
CM_ SG_ 1025 CcfClimateSeatSigType "CCF Parameter - ClimateSeatSigType

MDF - 0x6B51";
CM_ SG_ 1025 CcfCornerOnThreshold "CCF Parameter - CornerOnThreshold

MDF - 0x6B87";
CM_ SG_ 1025 CcfDIFlashOnArmDisarm "CCF Parameter - DIFlashOnArmDisarm

MDF - 0x6B27";
CM_ SG_ 1025 CcfDoubleLockingChirp "CCF Parameter - DoubleLockingChirp

MDF - 0x6B21";
CM_ SG_ 1025 CcfDriverConditionMon "CCF Parameter for Driver Condition Monitoring.

MDF - 0x6B43";
CM_ SG_ 1025 CcfHeadrestDrop "CCF Parameter - HeadrestDrop

MDF - 0x6B55";
CM_ SG_ 1025 CcfHVBattRegCompliance "CCF Parameter - HVBattRegCompliance

MDF - 0x6B47";
CM_ SG_ 1025 CcfNASTrailerLighting "CCF Parameter - NASTrailerLighting

MDF - 0x6B77";
CM_ SG_ 1025 CcfOpenCloseRFKey "CCF Parameter - OpenCloseRFKey

MDF - 0x6B31";
CM_ SG_ 1025 CcfPreCrashWindowLift "CCF parameter - CcfPreCrashWindowLift

MDF - 0x6B35";
CM_ SG_ 1025 CcfRemoteConvRoofOperation "CCF Parameter - RemoteConvRoofOperation

MDF - 0x6B57";
CM_ SG_ 1025 CcfSecurityDIFlashOnErr "CCF Parameter - SecurityDIFlashOnErr

MDF - 0x6B25";
CM_ SG_ 1025 CcfSecurityErrorTone "CCF Parameter - SecurityErrorTone

MDF - 0x6B23";
CM_ SG_ 1025 CcfSmartEye "CCF Parameter - SmartEye

MDF - 0x6B67";
CM_ SG_ 1025 CcfTailgateRemoteRel "CCF Parameter - TailgateRemoteRel

MDF - 0x6B33";
CM_ SG_ 1025 CcfTJAICAHOD "CCF Parameter - TJAICAHOD

MDF - 0x6B62

";
CM_ SG_ 1025 CcfTripComputerUnitsWh "CCF Parameter  - TripComputerUnitsWh

MDF - 0x6B75";
CM_ SG_ 1025 CcfWindowPWMMode "CCF Parameter - WindowPWMMode

MDF - 0x6B37";
CM_ SG_ 1025 CcfAutoSSSelectInFCPB "CCF Parameter - AutoSSSelectInFCPB

MDF - 0x6F62";
CM_ SG_ 1025 CcfDSCSelectInFCPB "CCF Parameter - DSCSelectInFCPB

MDF - 0x6F65";
CM_ SG_ 1025 CcfHDCSelectInFCPB "CCF Parameter - HDCSelectInFCPB

MDF - 0x6F72";
CM_ SG_ 1025 CcfRemoteWingMirrorFold "CCF Parameter - RemoteWingMirrorFold

MDF - 0x6F67";
CM_ SG_ 1025 CcfTerComSelectInFCPB "CCF Parameter - TerComSelectInFCPB

MDF - 0x6F82";
CM_ SG_ 1025 CcfTerDynSelectInFCPB "CCF Parameter - TerDynSelectInFCPB

MDF - 0x6F85";
CM_ SG_ 1025 CcfTerECOSelectInFCPB "CCF Parameter - TerECOSelectInFCPB

MDF - 0x6F75";
CM_ SG_ 1025 CcfDD00GlobalRealTime "Global Identifier   DD00	
ID Name               Global Real Time
Size (Bytes)          4
Type                     Unsigned Numeric
Data Description   As defined in GMRDB

Resolution ref: 1/600  Resolution: 0.001666666667 
Numeric size (bits): 32 
Offset: 0.0 
Minimum value: 0.0  Maximum value: 7158278.825 
Unit: min

(from GMRDB)

MDF 0xB027";
CM_ SG_ 1025 CcfDD02MainECUSupVolts "Global Identifier   DD02
ID Name               Main ECU Supply Voltage
Size (Bytes)          1
Type                     Unsigned Numeric
Data Description   As defined in GMRDB

MDF 0xB067";
CM_ SG_ 1025 CcfDD06PowerModePKT "Global Identifier   DD06
ID Name               Power Mode (PKT1)
Size (Bytes)          1
Type                     Packeted
Data Description   As defined in GMRDB

Parameter Size (bits) Datatype Description   

1 3 State Encoded Power Mode Quality Factor   (NOT USED)
2 5 State Encoded Power Mode   

(from GMRDB)

MDF 0xB074";
CM_ SG_ 1025 CcfDD01TotalDistance "Global Identifier   DD01
ID Name               Total Distance
Size (Bytes)          3
Type                     Unsigned Numeric
Data Description   As defined in GMRDB

Resolution ref: 1  Resolution: 1.0 
Numeric size (bits): 24 
Offset: 0.0 
Minimum value: 0.0  Maximum value: 1.6777215E7 
Unit: km 

MDF 0xB127";
CM_ SG_ 1025 CcfDD04InCarTemp "Global Identifier   DD04
ID Name               In-Car Temperature
Size (Bytes)          1
Type                     Unsigned Numeric
Data Description   As defined in GMRDB

MDF 0xB157";
CM_ SG_ 1025 CcfDD05OutdoorTemp "Global Identifier   DD05
ID Name               Outdoor Temperature
Size (Bytes)          1
Type                     Unsigned Numeric
Data Description   As defined in GMRDB

MDF 0xB167";
CM_ SG_ 1029 VehicleInfoParametersBO "This signal contains BOSignalConfigID and GGDS Snapshot Data for the BO-MSCAN Network. This signal is compiled in accordance with the Car Configuration EuCD - Vehicle Information Parameters Specification 31812331.

The Publisher of this signal shall read its local constant BOSignalConfigID and shall copy the value to the correct Block and Offset of VehicleInfoParameters that carries BOSignalConfigID [Block 01h, Bytes 7-8].

The Publisher of this signal shall subscribe to various Source Signals from the Network that shall be used to compile the GGDS Global Snapshot data within VehicleInfoParametersBO. The Source Signals that shall be used to compile the GGDS Global Snapshot data are defined in the Network Specific Requirements document.

The MSB of the signal must be written to the COM layer first (with an offset of zero in wr_bytes() ) and therefore transmitted on the bus first.
Similarly, subscribing modules will receive the MSB of the signal when they call rd_bytes(0).

E.g. wr_bytes(0) = publishe";
CM_ SG_ 324 DeviceChargeLevel "Device Charging (Power Level)
";
CM_ SG_ 324 WDCFault "Error Hi-Temperature/ Foreign Object 
";
CM_ SG_ 1566 XcpCalibrationSlaveDSM "This signal is for communication between calibration equipment and the ECU. The XCP based calibration equipment required to communicate with the ECU for calibration.

Signal encoding as per XCP protocol.";
CM_ SG_ 1568 XcpCalibrationSlavePSM "This signal is for communication between calibration equipment and the ECU. The XCP based calibration equipment required to communicate with the ECU for calibration.

Signal encoding as per XCP protocol.";
CM_ SG_ 1565 XcpCalMasterDSM "This signal is for communication between calibration equipment and the ECU. The XCP based calibration equipment required to communicate with the ECU for calibration.

Signal encoding as per XCP protocol.";
CM_ SG_ 1567 XcpCalMasterPSM "This signal is for communication between calibration equipment and the ECU. The XCP based calibration equipment required to communicate with the ECU for calibration.

Signal encoding as per XCP protocol.";
BA_DEF_ BO_  "GenMsgSendType" ENUM  "cyclic","spontaneous","cyclicIfActive","spontaneousWithDelay","cyclicAndSpontaneous","cyclicAndSpontaneousWithDelay";
BA_DEF_ BO_  "GenMsgCycleTime" FLOAT 0 300000;
BA_DEF_ BO_  "GenMsgStartDelayTime" FLOAT 0 300000;
BA_DEF_ BO_  "GenMsgDelayTime" FLOAT 0 300000;
BA_DEF_ SG_  "GenSigSendType" ENUM  "Cyclic","OnWrite","OnWriteWithRepetition","OnChange","OnChangeWithRepetition","IfActive","IfActiveWithRepetition","NoSigSendType";
BA_DEF_ SG_  "GenSigStartValue" FLOAT -1.79769313486232E+308 1.84467440737096E+019;
BA_DEF_DEF_  "GenMsgSendType" "";
BA_DEF_DEF_  "GenMsgCycleTime" 0;
BA_DEF_DEF_  "GenMsgStartDelayTime" 0;
BA_DEF_DEF_  "GenMsgDelayTime" 0;
BA_DEF_DEF_  "GenSigSendType" "Cyclic";
BA_DEF_DEF_  "GenSigStartValue" 0;
BA_ "GenMsgSendType" BO_ 1865 1;
BA_ "GenMsgSendType" BO_ 1867 1;
BA_ "GenMsgDelayTime" BO_ 1024 120;
BA_ "GenMsgSendType" BO_ 1024 1;
BA_ "GenMsgDelayTime" BO_ 1025 5;
BA_ "GenMsgSendType" BO_ 1025 1;
BA_ "GenMsgDelayTime" BO_ 1029 245;
BA_ "GenMsgSendType" BO_ 1029 1;
BA_ "GenMsgCycleTime" BO_ 324 120;
BA_ "GenMsgSendType" BO_ 324 0;
BA_ "GenMsgDelayTime" BO_ 1565 5;
BA_ "GenMsgSendType" BO_ 1565 1;
BA_ "GenMsgDelayTime" BO_ 1567 5;
BA_ "GenMsgSendType" BO_ 1567 1;
BA_ "GenSigSendType" SG_ 1944 TesterPhysicalResFTCMB 1;
BA_ "GenSigSendType" SG_ 1849 TesterPhysicalResKVM 1;
BA_ "GenSigSendType" SG_ 2025 TesterPhysicalResLPDM 1;
BA_ "GenSigSendType" SG_ 1963 TesterPhysicalResPSM 1;
BA_ "GenSigSendType" SG_ 1917 TesterPhysicalResRGTM 1;
BA_ "GenSigSendType" SG_ 1982 TesterPhysicalResRGTMB 1;
BA_ "GenSigSendType" SG_ 1802 TesterPhysicalResRLSM 1;
BA_ "GenSigSendType" SG_ 2024 TesterPhysicalResRPDM 1;
BA_ "GenSigSendType" SG_ 1899 TesterPhysicalResRRSM 1;
BA_ "GenSigSendType" SG_ 1887 TesterPhysicalResTBM 1;
BA_ "GenSigSendType" SG_ 1834 TesterPhysicalResVIM 1;
BA_ "GenSigSendType" SG_ 1807 TesterPhysicalResWDCM 1;
BA_ "GenSigSendType" SG_ 1024 VehicleConfParameters 1;
BA_ "GenSigSendType" SG_ 1025 CcfAlternator 1;
BA_ "GenSigSendType" SG_ 1025 CcfBifuel 1;
BA_ "GenSigSendType" SG_ 1025 CcfDoors 1;
BA_ "GenSigSendType" SG_ 1025 CcfEngine 1;
BA_ "GenSigSendType" SG_ 1025 CcfFuel 1;
BA_ "GenSigSendType" SG_ 1025 CcfTransmissionDriveLn 1;
BA_ "GenSigSendType" SG_ 1025 CcfVehicleType 1;
BA_ "GenSigSendType" SG_ 1025 CcfAlarm 1;
BA_ "GenSigSendType" SG_ 1025 CcfFuelTankVolume 1;
BA_ "GenSigSendType" SG_ 1025 CcfGearbox 1;
BA_ "GenSigSendType" SG_ 1025 CcfGearboxType 1;
BA_ "GenSigSendType" SG_ 1025 CcfHeadlightsType 1;
BA_ "GenSigSendType" SG_ 1025 CcfSeatMassage 1;
BA_ "GenSigSendType" SG_ 1025 CcfSteeringWheelPosn 1;
BA_ "GenSigSendType" SG_ 1025 CcfAckSignalLockAlarm 1;
BA_ "GenSigSendType" SG_ 1025 CcfAutoLockingBySpeed 1;
BA_ "GenSigSendType" SG_ 1025 CcfChildLockRearDrs 1;
BA_ "GenSigSendType" SG_ 1025 CcfKeyLockProtection2EXT 1;
BA_ "GenSigSendType" SG_ 1025 CcfKeyLockProtectionINT 1;
BA_ "GenSigSendType" SG_ 1025 CcfLevelSensorIfAlarm 1;
BA_ "GenSigSendType" SG_ 1025 CcfUnlockSetting 1;
BA_ "GenSigSendType" SG_ 1025 CcfBatteryRear 1;
BA_ "GenSigSendType" SG_ 1025 CcfBlindSpotInfoSystem 1;
BA_ "GenSigSendType" SG_ 1025 CcfClimateControlUnit 1;
BA_ "GenSigSendType" SG_ 1025 CcfCoupeFilter 1;
BA_ "GenSigSendType" SG_ 1025 CcfPanicAlarm 1;
BA_ "GenSigSendType" SG_ 1025 CcfPPTCHeater 1;
BA_ "GenSigSendType" SG_ 1025 CcfRoadFrictionDetection 1;
BA_ "GenSigSendType" SG_ 1025 CcfBrand 1;
BA_ "GenSigSendType" SG_ 1025 CcfFreqRemoteControls 1;
BA_ "GenSigSendType" SG_ 1025 CcfHeatedWindscreen 1;
BA_ "GenSigSendType" SG_ 1025 CcfHillDescentControl 1;
BA_ "GenSigSendType" SG_ 1025 CcfParkingAssistance 1;
BA_ "GenSigSendType" SG_ 1025 CcfParkingBrakeType 1;
BA_ "GenSigSendType" SG_ 1025 CcfSafetyBeltReminder 1;
BA_ "GenSigSendType" SG_ 1025 CcfActiveSuspension 1;
BA_ "GenSigSendType" SG_ 1025 CcfCentralLockType 1;
BA_ "GenSigSendType" SG_ 1025 CcfDrivenAxle 1;
BA_ "GenSigSendType" SG_ 1025 CcfRearWheelType 1;
BA_ "GenSigSendType" SG_ 1025 CcfSideWindows 1;
BA_ "GenSigSendType" SG_ 1025 CcfSteeringGear 1;
BA_ "GenSigSendType" SG_ 1025 CcfWheelbaseSeries 1;
BA_ "GenSigSendType" SG_ 1025 CcfAirbagPassengerSide 1;
BA_ "GenSigSendType" SG_ 1025 CcfAutoLights 1;
BA_ "GenSigSendType" SG_ 1025 CcfCutoffSwitchPassAirbag 1;
BA_ "GenSigSendType" SG_ 1025 CcfMemoryFunction 1;
BA_ "GenSigSendType" SG_ 1025 CcfPuddleLightOuterMirrors 1;
BA_ "GenSigSendType" SG_ 1025 CcfRearViewMirrorsOuter 1;
BA_ "GenSigSendType" SG_ 1025 CcfSideAirbagDriver 1;
BA_ "GenSigSendType" SG_ 1025 CcfAuxiliaryLights 1;
BA_ "GenSigSendType" SG_ 1025 CcfEmergencyBrakeLight 1;
BA_ "GenSigSendType" SG_ 1025 CcfInCarEntertainment 1;
BA_ "GenSigSendType" SG_ 1025 CcfPowerWindows 1;
BA_ "GenSigSendType" SG_ 1025 CcfRadioFrequencyBand 1;
BA_ "GenSigSendType" SG_ 1025 CcfRoofHatch 1;
BA_ "GenSigSendType" SG_ 1025 CcfTrimLevel 1;
BA_ "GenSigSendType" SG_ 1025 CcfPowerHeatedMirrors 1;
BA_ "GenSigSendType" SG_ 1025 CcfRearGlazing 1;
BA_ "GenSigSendType" SG_ 1025 CcfDampSensor 1;
BA_ "GenSigSendType" SG_ 1025 CcfDoorHandleTechnology 1;
BA_ "GenSigSendType" SG_ 1025 CcfMirrorMountTurnSig 1;
BA_ "GenSigSendType" SG_ 1025 CcfRearDoorSunblinds 1;
BA_ "GenSigSendType" SG_ 1025 Ccf4x4InfoDisplay 1;
BA_ "GenSigSendType" SG_ 1025 CcfAdvancedChauffeurFunc 1;
BA_ "GenSigSendType" SG_ 1025 CcfDoorLatchType 1;
BA_ "GenSigSendType" SG_ 1025 CcfLowSpdIntEmergBrake 1;
BA_ "GenSigSendType" SG_ 1025 CcfModelYear 1;
BA_ "GenSigSendType" SG_ 1025 CcfAmbientLighting 1;
BA_ "GenSigSendType" SG_ 1025 CcfConnectAndView 1;
BA_ "GenSigSendType" SG_ 1025 CcfDynamici 1;
BA_ "GenSigSendType" SG_ 1025 CcfHandbook 1;
BA_ "GenSigSendType" SG_ 1025 CcfNavigationSpeedInhibit 1;
BA_ "GenSigSendType" SG_ 1025 CcfPassiveLockErrorTones 1;
BA_ "GenSigSendType" SG_ 1025 CcfRearDiff 1;
BA_ "GenSigSendType" SG_ 1025 CcfCameraHMIStrategy 1;
BA_ "GenSigSendType" SG_ 1025 CcfDeplBatterySystem 1;
BA_ "GenSigSendType" SG_ 1025 CcfDriverBuckleSwitch 1;
BA_ "GenSigSendType" SG_ 1025 CcfDriverKneeAirbag 1;
BA_ "GenSigSendType" SG_ 1025 CcfDriverPassBeltPret 1;
BA_ "GenSigSendType" SG_ 1025 CcfDriverSwtchLdLimit 1;
BA_ "GenSigSendType" SG_ 1025 CcfEventDataRecorder 1;
BA_ "GenSigSendType" SG_ 1025 CcfFntDIFbdkMech 1;
BA_ "GenSigSendType" SG_ 1025 CcfInfotainmentType 1;
BA_ "GenSigSendType" SG_ 1025 CcfLeftCurtainAirbag 1;
BA_ "GenSigSendType" SG_ 1025 CcfLeftRearHeadAbag 1;
BA_ "GenSigSendType" SG_ 1025 CcfLeftSideAirbag 1;
BA_ "GenSigSendType" SG_ 1025 CcfmPACOS 1;
BA_ "GenSigSendType" SG_ 1025 CcfPADLamp 1;
BA_ "GenSigSendType" SG_ 1025 CcfPassBuckleSwitch 1;
BA_ "GenSigSendType" SG_ 1025 CcfPassOccWghtSensor 1;
BA_ "GenSigSendType" SG_ 1025 CcfRightCurtainAirbag 1;
BA_ "GenSigSendType" SG_ 1025 CcfRightRearHeadAbag 1;
BA_ "GenSigSendType" SG_ 1025 CcfRightSideAirbag 1;
BA_ "GenSigSendType" SG_ 1025 CcfRollOverSensing 1;
BA_ "GenSigSendType" SG_ 1025 CcfThirdRowChiller 1;
BA_ "GenSigSendType" SG_ 1025 CcfTrunkLmpOutput 1;
BA_ "GenSigSendType" SG_ 1025 CcfWindowCalibration 1;
BA_ "GenSigSendType" SG_ 1025 CcfWindowOpFeedback 1;
BA_ "GenSigSendType" SG_ 1025 CcfATPC 1;
BA_ "GenSigSendType" SG_ 1025 CcfBumperType 1;
BA_ "GenSigSendType" SG_ 1025 CcfDLNAStatus 1;
BA_ "GenSigSendType" SG_ 1025 CcfDriverFrontAirbag 1;
BA_ "GenSigSendType" SG_ 1025 CcfDriverPassRetractor 1;
BA_ "GenSigSendType" SG_ 1025 CcfGracenotes 1;
BA_ "GenSigSendType" SG_ 1025 CcfPassFrontAirbag 1;
BA_ "GenSigSendType" SG_ 1025 CcfRemoteStartCapable 1;
BA_ "GenSigSendType" SG_ 1025 CcfAirIonizer 1;
BA_ "GenSigSendType" SG_ 1025 CcfAutoAccessHeight 1;
BA_ "GenSigSendType" SG_ 1025 CcfCameraBtnFCIM 1;
BA_ "GenSigSendType" SG_ 1025 CcfClusterAlertGFX 1;
BA_ "GenSigSendType" SG_ 1025 CcfDepSideSteps 1;
BA_ "GenSigSendType" SG_ 1025 CcfDriverDoorLock 1;
BA_ "GenSigSendType" SG_ 1025 CcfDSSOffRoadOperation 1;
BA_ "GenSigSendType" SG_ 1025 CcfDualViewBtnFCIM 1;
BA_ "GenSigSendType" SG_ 1025 CcfECOmodeText 1;
BA_ "GenSigSendType" SG_ 1025 CcfKeyFobTechnology 1;
BA_ "GenSigSendType" SG_ 1025 CcfPassDoorLock 1;
BA_ "GenSigSendType" SG_ 1025 CcfPedProtectSystem 1;
BA_ "GenSigSendType" SG_ 1025 CcfRearExitDetect 1;
BA_ "GenSigSendType" SG_ 1025 CcfRestrictSunroofOpen 1;
BA_ "GenSigSendType" SG_ 1025 CcfRLPassDoorLock 1;
BA_ "GenSigSendType" SG_ 1025 CcfRRPassDoorLock 1;
BA_ "GenSigSendType" SG_ 1025 CcfSoftCloseDoors 1;
BA_ "GenSigSendType" SG_ 1025 CcfSunGblClTelLock 1;
BA_ "GenSigSendType" SG_ 1025 CcfTelLock 1;
BA_ "GenSigSendType" SG_ 1025 CcfTelUnlock 1;
BA_ "GenSigSendType" SG_ 1025 CcfTrailerLightTest 1;
BA_ "GenSigSendType" SG_ 1025 CcfVehicleLocator 1;
BA_ "GenSigSendType" SG_ 1025 CcfWalkAwayLocking 1;
BA_ "GenSigSendType" SG_ 1025 CcfWinGblClTelLock 1;
BA_ "GenSigSendType" SG_ 1025 Ccf2ndRowLoadSpace 1;
BA_ "GenSigSendType" SG_ 1025 CcfActiveVanes 1;
BA_ "GenSigSendType" SG_ 1025 CcfArmouredVehicle 1;
BA_ "GenSigSendType" SG_ 1025 CcfDriverDoorLockLED 1;
BA_ "GenSigSendType" SG_ 1025 CcfFntLowBeamProfile 1;
BA_ "GenSigSendType" SG_ 1025 CcfHeightDataInputSelection 1;
BA_ "GenSigSendType" SG_ 1025 CcfHUDNavigation 1;
BA_ "GenSigSendType" SG_ 1025 CcfPassDoorLockLED 1;
BA_ "GenSigSendType" SG_ 1025 CcfPwrTailKickSen 1;
BA_ "GenSigSendType" SG_ 1025 CcfPwrTailProxSenPEPS 1;
BA_ "GenSigSendType" SG_ 1025 CcfRearPosProfile 1;
BA_ "GenSigSendType" SG_ 1025 CcfRearSMProfile 1;
BA_ "GenSigSendType" SG_ 1025 CcfRearStopProfile 1;
BA_ "GenSigSendType" SG_ 1025 CcfRLPassDoorLockLED 1;
BA_ "GenSigSendType" SG_ 1025 CcfRRPassDoorLockLED 1;
BA_ "GenSigSendType" SG_ 1025 CcfStopStartInhibitIcon 1;
BA_ "GenSigSendType" SG_ 1025 CcfTelAlarmReset 1;
BA_ "GenSigSendType" SG_ 1025 CcfVASSensorOvride 1;
BA_ "GenSigSendType" SG_ 1025 CcfAlrmSensOnSingLock 1;
BA_ "GenSigSendType" SG_ 1025 CcfBodyStyleRoofStructure 1;
BA_ "GenSigSendType" SG_ 1025 CcfDynamicProgMode 1;
BA_ "GenSigSendType" SG_ 1025 CcfECOProgMode 1;
BA_ "GenSigSendType" SG_ 1025 CcfFntDRLOpenLoad 1;
BA_ "GenSigSendType" SG_ 1025 CcfFntFogOpenLoad 1;
BA_ "GenSigSendType" SG_ 1025 CcfFntLowBeamOpenLoad 1;
BA_ "GenSigSendType" SG_ 1025 CcfFntPosOpenLoad 1;
BA_ "GenSigSendType" SG_ 1025 CcfFntSMOpenLoad 1;
BA_ "GenSigSendType" SG_ 1025 CcfLockFuelFillFlap 1;
BA_ "GenSigSendType" SG_ 1025 CcfMaxVehicleSpeed 1;
BA_ "GenSigSendType" SG_ 1025 CcfMHLastUserMode 1;
BA_ "GenSigSendType" SG_ 1025 CcfPartialNetworkEnable 1;
BA_ "GenSigSendType" SG_ 1025 CcfRearPosOpenLoad 1;
BA_ "GenSigSendType" SG_ 1025 CcfRockCrawlMode 1;
BA_ "GenSigSendType" SG_ 1025 CcfSandProgMode 1;
BA_ "GenSigSendType" SG_ 1025 CcfSideWinGlassThick 1;
BA_ "GenSigSendType" SG_ 1025 CcfUSB2Hub 1;
BA_ "GenSigSendType" SG_ 1025 CcfUSB3Repeater 1;
BA_ "GenSigSendType" SG_ 1025 CcfAutoAccess 1;
BA_ "GenSigSendType" SG_ 1025 CcfCoolingFanFitment 1;
BA_ "GenSigSendType" SG_ 1025 CcfDriverMemDrSwtchPk 1;
BA_ "GenSigSendType" SG_ 1025 CcfEDiffType 1;
BA_ "GenSigSendType" SG_ 1025 CcfGenericEngPwrOut 1;
BA_ "GenSigSendType" SG_ 1025 CcfHdlampLvlSensPos 1;
BA_ "GenSigSendType" SG_ 1025 CcfLRTerrainJGAllRdLaunch 1;
BA_ "GenSigSendType" SG_ 1025 CcfPassMemDrSwtchPk 1;
BA_ "GenSigSendType" SG_ 1025 CcfPTCruiseFitment 1;
BA_ "GenSigSendType" SG_ 1025 CcfRearDriverMemDrSwtchPk 1;
BA_ "GenSigSendType" SG_ 1025 CcfRearPassMemDrSwtchPk 1;
BA_ "GenSigSendType" SG_ 1025 CcfSpdoCalkmhOffset 1;
BA_ "GenSigSendType" SG_ 1025 CcfSpdoCalPercentScale 1;
BA_ "GenSigSendType" SG_ 1025 CcfSplitStopFailStrat 1;
BA_ "GenSigSendType" SG_ 1025 CcfSteerWlhlSwtchType 1;
BA_ "GenSigSendType" SG_ 1025 CcfTowAssist 1;
BA_ "GenSigSendType" SG_ 1025 CcfTPMSCalibration 1;
BA_ "GenSigSendType" SG_ 1025 CcfBrakeDiscMaterial 1;
BA_ "GenSigSendType" SG_ 1025 CcfBrakeDiscSizeFront 1;
BA_ "GenSigSendType" SG_ 1025 CcfBrakeDiscSizeRear 1;
BA_ "GenSigSendType" SG_ 1025 CcfElectricFan 1;
BA_ "GenSigSendType" SG_ 1025 CcfRearDriverLinSWP 1;
BA_ "GenSigSendType" SG_ 1025 CcfRearPassLinSWP 1;
BA_ "GenSigSendType" SG_ 1025 CcfServiceInterval 1;
BA_ "GenSigSendType" SG_ 1025 CcfSportbrake 1;
BA_ "GenSigSendType" SG_ 1025 CcfTyreDynamicRollRad 1;
BA_ "GenSigSendType" SG_ 1025 CcfBrakeWarningSymbol 1;
BA_ "GenSigSendType" SG_ 1025 CcfChassisDescription 1;
BA_ "GenSigSendType" SG_ 1025 CcfConfigDynamicMode 1;
BA_ "GenSigSendType" SG_ 1025 CcfGearboxdescription 1;
BA_ "GenSigSendType" SG_ 1025 ccfGenericWheelBase 1;
BA_ "GenSigSendType" SG_ 1025 CcfPTAODieWaterInSensr 1;
BA_ "GenSigSendType" SG_ 1025 CcfReverseGearSelStrat 1;
BA_ "GenSigSendType" SG_ 1025 CcfTransmissionSelectr 1;
BA_ "GenSigSendType" SG_ 1025 CcfVINPart1 1;
BA_ "GenSigSendType" SG_ 1025 CcfVINPart2 1;
BA_ "GenSigSendType" SG_ 1025 CcfFntClusterCableLgth 1;
BA_ "GenSigSendType" SG_ 1025 CcfFntDispCableLgth 1;
BA_ "GenSigSendType" SG_ 1025 CcfVINPart3 1;
BA_ "GenSigSendType" SG_ 1025 CcfAllSurfaceInfo 1;
BA_ "GenSigSendType" SG_ 1025 CcfBrowserSearch 1;
BA_ "GenSigSendType" SG_ 1025 CcfDriverWinSWPack 1;
BA_ "GenSigSendType" SG_ 1025 CcfFntUIPCableLgth 1;
BA_ "GenSigSendType" SG_ 1025 CcfRearLftDispCableLgth 1;
BA_ "GenSigSendType" SG_ 1025 CcfRearRghtDisplayCableLgth 1;
BA_ "GenSigSendType" SG_ 1025 CcfRearUIPLnk1CableLgth 1;
BA_ "GenSigSendType" SG_ 1025 CcfRearUIPLnk2CableLgth 1;
BA_ "GenSigSendType" SG_ 1025 CcfRrLmpBhWhTgateOpen 1;
BA_ "GenSigSendType" SG_ 1025 CcfSeatLumbSWFittedD 1;
BA_ "GenSigSendType" SG_ 1025 CcfSeatLumbSWFittedP 1;
BA_ "GenSigSendType" SG_ 1025 CcfSeatLumbSWFittedRD 1;
BA_ "GenSigSendType" SG_ 1025 CcfSeatLumbSWFittedRP 1;
BA_ "GenSigSendType" SG_ 1025 CcfSeatMasgSWFittedD 1;
BA_ "GenSigSendType" SG_ 1025 CcfSeatMasgSWFittedP 1;
BA_ "GenSigSendType" SG_ 1025 CcfSeatMasgSWFittedRD 1;
BA_ "GenSigSendType" SG_ 1025 CcfSeatMasgSWFittedRP 1;
BA_ "GenSigSendType" SG_ 1025 CcfSeatMovSWFittedD 1;
BA_ "GenSigSendType" SG_ 1025 CcfSeatMovSWFittedP 1;
BA_ "GenSigSendType" SG_ 1025 CcfSeatMovSWFittedRD 1;
BA_ "GenSigSendType" SG_ 1025 CcfSeatMovSWFittedRP 1;
BA_ "GenSigSendType" SG_ 1025 CcfSeatPSASWFitted 1;
BA_ "GenSigSendType" SG_ 1025 CcfDieselEMSEmissMkt 1;
BA_ "GenSigSendType" SG_ 1025 CcfDriverID 1;
BA_ "GenSigSendType" SG_ 1025 CcfDriverIDKeys 1;
BA_ "GenSigSendType" SG_ 1025 CcfDriverIDPhones 1;
BA_ "GenSigSendType" SG_ 1025 CcfDriverIDSeats 1;
BA_ "GenSigSendType" SG_ 1025 CcfEcoDataGallonType 1;
BA_ "GenSigSendType" SG_ 1025 CcfFrntLowerDispKeys 1;
BA_ "GenSigSendType" SG_ 1025 CcfFrntLowerDispVariant 1;
BA_ "GenSigSendType" SG_ 1025 CcfFrntUpperDeployable 1;
BA_ "GenSigSendType" SG_ 1025 CcfFrntUpperDispVariant 1;
BA_ "GenSigSendType" SG_ 1025 CcfFrontPassengerID 1;
BA_ "GenSigSendType" SG_ 1025 CcfNGICamBanStrat 1;
BA_ "GenSigSendType" SG_ 1025 CcfNonDepIllumDoorHnd 1;
BA_ "GenSigSendType" SG_ 1025 CcfPersonalisation 1;
BA_ "GenSigSendType" SG_ 1025 CcfRow2PassengerID 1;
BA_ "GenSigSendType" SG_ 1025 CcfRow3PassengerID 1;
BA_ "GenSigSendType" SG_ 1025 CcfSmartExitFntDrvDr 1;
BA_ "GenSigSendType" SG_ 1025 CcfSmartExitFntPassDoor 1;
BA_ "GenSigSendType" SG_ 1025 CcfSmartExitRrDrvDoor 1;
BA_ "GenSigSendType" SG_ 1025 CcfSmartExitRrPassDoor 1;
BA_ "GenSigSendType" SG_ 1025 CcfTransCalIndex 1;
BA_ "GenSigSendType" SG_ 1025 CcfChargingInlet1 1;
BA_ "GenSigSendType" SG_ 1025 CcfChargingInlet2 1;
BA_ "GenSigSendType" SG_ 1025 CcfEMMaxDurEngOff 1;
BA_ "GenSigSendType" SG_ 1025 CcfFMMaxFuelAge 1;
BA_ "GenSigSendType" SG_ 1025 CcfFntPassWdowSwtchPk 1;
BA_ "GenSigSendType" SG_ 1025 CcfFrntDrvWdowSwtchpk 1;
BA_ "GenSigSendType" SG_ 1025 CcfMicrophoneType 1;
BA_ "GenSigSendType" SG_ 1025 CcfRrDrWdowSwtchPk 1;
BA_ "GenSigSendType" SG_ 1025 CcfRrPassWdowSwtchpk 1;
BA_ "GenSigSendType" SG_ 1025 CcfSelectStateCharge 1;
BA_ "GenSigSendType" SG_ 1025 CcfTelematicsSpkrType 1;
BA_ "GenSigSendType" SG_ 1025 CcfTimedChrgFeature 1;
BA_ "GenSigSendType" SG_ 1025 CcfWirelessCharger 1;
BA_ "GenSigSendType" SG_ 1025 CcfAuxCoolingPump 1;
BA_ "GenSigSendType" SG_ 1025 CcfBrakePedalFeel 1;
BA_ "GenSigSendType" SG_ 1025 CcfCleanSurroundCams 1;
BA_ "GenSigSendType" SG_ 1025 CcfCntrRetractPretRow1 1;
BA_ "GenSigSendType" SG_ 1025 CcfCntrRetractPretRow2 1;
BA_ "GenSigSendType" SG_ 1025 CcfCntrRetractPretRow3 1;
BA_ "GenSigSendType" SG_ 1025 CcfFarSideOccImpAbgRow1 1;
BA_ "GenSigSendType" SG_ 1025 CcfGrndMarkingDetect 1;
BA_ "GenSigSendType" SG_ 1025 CcfIMCClusterAPIXClrDpth 1;
BA_ "GenSigSendType" SG_ 1025 CcfIMCClusterAPIXVideoSpd 1;
BA_ "GenSigSendType" SG_ 1025 CcfOpenableICP 1;
BA_ "GenSigSendType" SG_ 1025 CcfParkAidCommsBus 1;
BA_ "GenSigSendType" SG_ 1025 CcfParkAssistHMI 1;
BA_ "GenSigSendType" SG_ 1025 CcfPNPreConEnable 1;
BA_ "GenSigSendType" SG_ 1025 CcfRearRoofBlindFitted 1;
BA_ "GenSigSendType" SG_ 1025 CcfReverseMirrorDip 1;
BA_ "GenSigSendType" SG_ 1025 CcfReverseMirrorDipStrat 1;
BA_ "GenSigSendType" SG_ 1025 CcfRoofType 1;
BA_ "GenSigSendType" SG_ 1025 CcfSeatThermHMIControl 1;
BA_ "GenSigSendType" SG_ 1025 CcfAskOnExit 1;
BA_ "GenSigSendType" SG_ 1025 CcfBacklightStratSel 1;
BA_ "GenSigSendType" SG_ 1025 CcfBodyKitStyle 1;
BA_ "GenSigSendType" SG_ 1025 CcfClearExitDetectionSystem 1;
BA_ "GenSigSendType" SG_ 1025 CcfDriveAssist 1;
BA_ "GenSigSendType" SG_ 1025 CcfDriverHeatedCalfRest 1;
BA_ "GenSigSendType" SG_ 1025 CcfDynamicLiteMode 1;
BA_ "GenSigSendType" SG_ 1025 CcfEngineNoiseCancel 1;
BA_ "GenSigSendType" SG_ 1025 CcfFront23BuckSwitch 1;
BA_ "GenSigSendType" SG_ 1025 CcfHeatedDoorArmrest 1;
BA_ "GenSigSendType" SG_ 1025 CcfHeatedMapPocket 1;
BA_ "GenSigSendType" SG_ 1025 CcfHtdFrntCntreArmrst 1;
BA_ "GenSigSendType" SG_ 1025 CcfHtdRearCntreArmrst 1;
BA_ "GenSigSendType" SG_ 1025 CcfIntelEmrgBrkingCAEB 1;
BA_ "GenSigSendType" SG_ 1025 CcfLowerGloveBox 1;
BA_ "GenSigSendType" SG_ 1025 CcfRow3BuckleSwitch 1;
BA_ "GenSigSendType" SG_ 1025 CcfSAPServerType 1;
BA_ "GenSigSendType" SG_ 1025 CcfSeatTherm2ndRowHMIControl 1;
BA_ "GenSigSendType" SG_ 1025 CcfSuspensionType 1;
BA_ "GenSigSendType" SG_ 1025 CcfTaskLighting 1;
BA_ "GenSigSendType" SG_ 1025 CcfUpperGloveBox 1;
BA_ "GenSigSendType" SG_ 1025 CcfUWBPEPSRANGEADJUSTUSEVSA 1;
BA_ "GenSigSendType" SG_ 1025 CcfADBInitialisation 1;
BA_ "GenSigSendType" SG_ 1025 CcfAutoVentsType 1;
BA_ "GenSigSendType" SG_ 1025 CcfDisplaySeatTempIntensity 1;
BA_ "GenSigSendType" SG_ 1025 CcfDisplaySeatTempZone 1;
BA_ "GenSigSendType" SG_ 1025 CcfDriverMicrophoneType 1;
BA_ "GenSigSendType" SG_ 1025 CcfElectFrntLoadspace 1;
BA_ "GenSigSendType" SG_ 1025 CcfExhaustHeatshieldType 1;
BA_ "GenSigSendType" SG_ 1025 CcfExhaustType 1;
BA_ "GenSigSendType" SG_ 1025 CcfMirrorPositionFeature 1;
BA_ "GenSigSendType" SG_ 1025 CcfRearBumperType 1;
BA_ "GenSigSendType" SG_ 1025 CcfSeatMsg2ndRowHMIControl 1;
BA_ "GenSigSendType" SG_ 1025 CcfSeatMsgHMIControl 1;
BA_ "GenSigSendType" SG_ 1025 CcfSlopeInformation 1;
BA_ "GenSigSendType" SG_ 1025 CcfTouristMode 1;
BA_ "GenSigSendType" SG_ 1025 CcfUWBSATFreqChannel 1;
BA_ "GenSigSendType" SG_ 1025 CcfWheelInformation 1;
BA_ "GenSigSendType" SG_ 1025 CcfAdapDrvBeamSeg 1;
BA_ "GenSigSendType" SG_ 1025 CcfAdasNCapESS 1;
BA_ "GenSigSendType" SG_ 1025 CcfAdasNCapLKAUpcomTraff 1;
BA_ "GenSigSendType" SG_ 1025 CcfBCMInteriorLightDelay 1;
BA_ "GenSigSendType" SG_ 1025 CcfBCMInteriorLightTrunk 1;
BA_ "GenSigSendType" SG_ 1025 CcfBrakeFluidLvlSource 1;
BA_ "GenSigSendType" SG_ 1025 CcfDeployableSideStepType 1;
BA_ "GenSigSendType" SG_ 1025 CcfDynBendingLight 1;
BA_ "GenSigSendType" SG_ 1025 CcfESSCalibration 1;
BA_ "GenSigSendType" SG_ 1025 CcfExteriorMirrorAutoUnfold 1;
BA_ "GenSigSendType" SG_ 1025 CcfFuelGaugeVariant2 1;
BA_ "GenSigSendType" SG_ 1025 CcfLKARE 1;
BA_ "GenSigSendType" SG_ 1025 CcfPassKneeAirbag 1;
BA_ "GenSigSendType" SG_ 1025 CcfSeatMvmtModuleType 1;
BA_ "GenSigSendType" SG_ 1025 CcfSignPostDimming 1;
BA_ "GenSigSendType" SG_ 1025 CcfSupMainBeamRoutIntensity 1;
BA_ "GenSigSendType" SG_ 1025 CcfTJAICARE 1;
BA_ "GenSigSendType" SG_ 1025 CcfWakeupShutdownSeqTyp 1;
BA_ "GenSigSendType" SG_ 1025 CcfACCAccelProfileSelect 1;
BA_ "GenSigSendType" SG_ 1025 CcfACCLeadCarDistDisp 1;
BA_ "GenSigSendType" SG_ 1025 CcfACCStopGapSelect 1;
BA_ "GenSigSendType" SG_ 1025 CcfAdasDCR 1;
BA_ "GenSigSendType" SG_ 1025 CcfAdasLongCRA 1;
BA_ "GenSigSendType" SG_ 1025 CcfAdasLongRPC 1;
BA_ "GenSigSendType" SG_ 1025 CcfAdasNCapCyclistAEB 1;
BA_ "GenSigSendType" SG_ 1025 CcfAdasTJP 1;
BA_ "GenSigSendType" SG_ 1025 CcfAutoHold 1;
BA_ "GenSigSendType" SG_ 1025 CcfDSMFitment 1;
BA_ "GenSigSendType" SG_ 1025 CcfESSCalNo 1;
BA_ "GenSigSendType" SG_ 1025 CcfIntMirrorVariant 1;
BA_ "GenSigSendType" SG_ 1025 CcfLaneKeepAssistLDW 1;
BA_ "GenSigSendType" SG_ 1025 CcfLeftManoeuvringLgt 1;
BA_ "GenSigSendType" SG_ 1025 CcfParkPawlLocation 1;
BA_ "GenSigSendType" SG_ 1025 CcfPassHeatedCalfRest 1;
BA_ "GenSigSendType" SG_ 1025 CcfPSMFitment 1;
BA_ "GenSigSendType" SG_ 1025 CcfR2SMFitment 1;
BA_ "GenSigSendType" SG_ 1025 CcfR3SMFitment 1;
BA_ "GenSigSendType" SG_ 1025 CcfRghtManoeuvringLgt 1;
BA_ "GenSigSendType" SG_ 1025 CcfRLSMFitment 1;
BA_ "GenSigSendType" SG_ 1025 CcfRRSMFitment 1;
BA_ "GenSigSendType" SG_ 1025 CcfSeatMassHanded 1;
BA_ "GenSigSendType" SG_ 1025 CcfARNCCalNo 1;
BA_ "GenSigSendType" SG_ 1025 CcfASDExhaustCalNo 1;
BA_ "GenSigSendType" SG_ 1025 CcfAVNCalNo 1;
BA_ "GenSigSendType" SG_ 1025 CcfCDLGlobalClose 1;
BA_ "GenSigSendType" SG_ 1025 CcfCDLGlobalOpen 1;
BA_ "GenSigSendType" SG_ 1025 CcfCityUrbanAutoEmerBraking 1;
BA_ "GenSigSendType" SG_ 1025 CcfCyCAutoEmerBraking 1;
BA_ "GenSigSendType" SG_ 1025 CcfEOCCalNo 1;
BA_ "GenSigSendType" SG_ 1025 CcfFrontBeltMinder 1;
BA_ "GenSigSendType" SG_ 1025 CcfFrontPreCrashSunRoof 1;
BA_ "GenSigSendType" SG_ 1025 CcfFwdCollisionWarn 1;
BA_ "GenSigSendType" SG_ 1025 CcfIntelligentEmerBraking 1;
BA_ "GenSigSendType" SG_ 1025 CcfJuncAutoEmerBraking 1;
BA_ "GenSigSendType" SG_ 1025 CcfOverspeedIndia 1;
BA_ "GenSigSendType" SG_ 1025 CcfPedAutoEmerBraking 1;
BA_ "GenSigSendType" SG_ 1025 CcfAutolampFastResponse 1;
BA_ "GenSigSendType" SG_ 1025 CcfChargeFlap1 1;
BA_ "GenSigSendType" SG_ 1025 CcfChargeFlap2 1;
BA_ "GenSigSendType" SG_ 1025 CcfEOCExhaustCalNo 1;
BA_ "GenSigSendType" SG_ 1025 CcfHeadlampWash 1;
BA_ "GenSigSendType" SG_ 1025 CcfMemorySwitchType 1;
BA_ "GenSigSendType" SG_ 1025 CcfRainSensorFitment 1;
BA_ "GenSigSendType" SG_ 1025 CcfRCTAConfiguration 1;
BA_ "GenSigSendType" SG_ 1025 CcfSeatSwitchPackPos 1;
BA_ "GenSigSendType" SG_ 1025 CcfSMRFGlobalClose 1;
BA_ "GenSigSendType" SG_ 1025 CcfWiperColdClimDLRWash 1;
BA_ "GenSigSendType" SG_ 1025 CcfWiperCollarSwtchRnSenSeni 1;
BA_ "GenSigSendType" SG_ 1025 CcfWiperDripWipeFeature 1;
BA_ "GenSigSendType" SG_ 1025 CcfWiperFntSpeedDepend 1;
BA_ "GenSigSendType" SG_ 1025 CcfWiperHdlmpWshPressure 1;
BA_ "GenSigSendType" SG_ 1025 CcfWiperHeadlmpWashDLR 1;
BA_ "GenSigSendType" SG_ 1025 CcfWiperInterSpdDepend 1;
BA_ "GenSigSendType" SG_ 1025 CcfWiperProgramWipeActive 1;
BA_ "GenSigSendType" SG_ 1025 CcfWiperRearContinue 1;
BA_ "GenSigSendType" SG_ 1025 CcfWiperRrHlfMoonParkSwtch 1;
BA_ "GenSigSendType" SG_ 1025 CcfWiperTwinWasherBottle 1;
BA_ "GenSigSendType" SG_ 1025 CcfWiperUpStroke 1;
BA_ "GenSigSendType" SG_ 1025 CcfActiveExhaustMap 1;
BA_ "GenSigSendType" SG_ 1025 CcfClimateSeatSigType 1;
BA_ "GenSigSendType" SG_ 1025 CcfCornerOnThreshold 1;
BA_ "GenSigSendType" SG_ 1025 CcfDIFlashOnArmDisarm 1;
BA_ "GenSigSendType" SG_ 1025 CcfDoubleLockingChirp 1;
BA_ "GenSigSendType" SG_ 1025 CcfDriverConditionMon 1;
BA_ "GenSigSendType" SG_ 1025 CcfHeadrestDrop 1;
BA_ "GenSigSendType" SG_ 1025 CcfHVBattRegCompliance 1;
BA_ "GenSigSendType" SG_ 1025 CcfNASTrailerLighting 1;
BA_ "GenSigSendType" SG_ 1025 CcfOpenCloseRFKey 1;
BA_ "GenSigSendType" SG_ 1025 CcfPreCrashWindowLift 1;
BA_ "GenSigSendType" SG_ 1025 CcfRemoteConvRoofOperation 1;
BA_ "GenSigSendType" SG_ 1025 CcfSecurityDIFlashOnErr 1;
BA_ "GenSigSendType" SG_ 1025 CcfSecurityErrorTone 1;
BA_ "GenSigSendType" SG_ 1025 CcfSmartEye 1;
BA_ "GenSigSendType" SG_ 1025 CcfTailgateRemoteRel 1;
BA_ "GenSigSendType" SG_ 1025 CcfTJAICAHOD 1;
BA_ "GenSigSendType" SG_ 1025 CcfTripComputerUnitsWh 1;
BA_ "GenSigSendType" SG_ 1025 CcfWindowPWMMode 1;
BA_ "GenSigSendType" SG_ 1025 CcfAutoSSSelectInFCPB 1;
BA_ "GenSigSendType" SG_ 1025 CcfDSCSelectInFCPB 1;
BA_ "GenSigSendType" SG_ 1025 CcfHDCSelectInFCPB 1;
BA_ "GenSigSendType" SG_ 1025 CcfRemoteWingMirrorFold 1;
BA_ "GenSigSendType" SG_ 1025 CcfTerComSelectInFCPB 1;
BA_ "GenSigSendType" SG_ 1025 CcfTerDynSelectInFCPB 1;
BA_ "GenSigSendType" SG_ 1025 CcfTerECOSelectInFCPB 1;
BA_ "GenSigSendType" SG_ 1025 CcfDD00GlobalRealTime 1;
BA_ "GenSigSendType" SG_ 1025 CcfDD02MainECUSupVolts 1;
BA_ "GenSigSendType" SG_ 1025 CcfDD06PowerModePKT 1;
BA_ "GenSigSendType" SG_ 1025 CcfDD01TotalDistance 1;
BA_ "GenSigSendType" SG_ 1025 CcfDD04InCarTemp 1;
BA_ "GenSigSendType" SG_ 1025 CcfDD05OutdoorTemp 1;
BA_ "GenSigSendType" SG_ 1029 VehicleInfoParametersBO 1;
BA_ "GenSigSendType" SG_ 1566 XcpCalibrationSlaveDSM 1;
BA_ "GenSigSendType" SG_ 1568 XcpCalibrationSlavePSM 1;
VAL_ 1025 CcfAlternator 0 "Not Supported" 1 "Alternator 150A" 2 "Alternator 180A" 3 "Alternator 220A" 4 "Alternator 120A" 5 "Alternator 150A V" 7 "Alternator 70A" 8 "Alternator 90A" 9 "Alternator 110A" 10 "No Alternator Fitted" 11 "Alternator 210A" 12 "Alternator 230A" 13 "Alternator 180A V" 255 "Error" ;
VAL_ 1025 CcfBifuel 0 "Not supported" 1 "Not Bifuel" 2 "Bifuel (LPG)" 3 "Bifuel (CNG)" 255 "Error" ;
VAL_ 1025 CcfDoors 0 "Not supported" 2 "5 Door" 3 "4 Door" 4 "2 Door" 5 "3 Door" 255 "Error" ;
VAL_ 1025 CcfEngine 0 "Undefined" 11 "2.2L DI4 190PS DW12c" 49 "DW12 2.2L I4 DSL 175PS" 69 "I4 2.0L Petrol DISI 200/280" 92 "DW12C I4 2.2L 16V DSL" 119 "Lion TDV8 4.4L  (Only for JLR)" 133 "3.6 DOHC V8 TC DIESEL 280 PS" 135 "2.7 V6 24V DOHC EFI T/C DSL" 136 "5.0 OHC SGDI NA V8 GAS AJ133" 137 "5.0 OHC SGDI SC V8 GAS AJ133" 144 "3.0 24V DOHC V6 T/C DSL" 154 "AJ126 V6 S/C 3.0L" 155 "AJ200D 2.0 litre" 156 "AJ200P 2.0 litre" 157 "IEM3 2.0L" 171 "NI4/2.0/4V GTDI 240/340" 176 "3.0 V6 DIESEL FULL ELEC HYBRID ENG" 177 "AJ200D 3.0 litre (6 Cyl.)" 178 "AJ200P 3.0 litre (6 Cyl.)" 179 "AJ200P 1.5 litre (3 Cyl.)" 180 "NC10-P8 V8 4.4L Petrol" 253 "No Internal Combustion Engine" 254 "COLOGNE V6" 255 "Error" ;
VAL_ 1025 CcfFuel 0 "Undefined" 1 "Petrol" 2 "Diesel" 3 "Gas/Hybrid" 4 "FLEX FUEL ETHANOL  " 5 "ETHANOL FUEL CAPABILITY " 6 "LPG FUEL CAPABILITY" 7 "ELECTRIC POWERED" 255 "Error" ;
VAL_ 1025 CcfTransmissionDriveLn 0 "Undefined" 1 "2 wheel drive" 2 "All wheel drive (Without disconnect)" 3 "All wheel drive (With disconnect)" 4 "All wheel drive (With eRad System)" 255 "Error" ;
VAL_ 1025 CcfVehicleType 0 "Not supported" 1 "L663" 2 "L560" 3 "L551" 8 "L359 'Landrover Freelander'" 11 "L405 - Range Rover " 12 "L494 - Range Rover Sport " 13 "X152" 14 "X151" 15 "X760" 16 "X150 'Jaguar XK'" 17 "L538 'Evoke'" 18 "L550" 19 "X250 'Jaguar S-Type'" 20 "L319 'Landrover Discovey'" 21 "L320 'Landrover Range Rover Sport'" 26 "X260" 27 "X761" 28 "L462" 36 "L322 'LandRover Range Rover'" 37 "X351 'Jaguar XJ'" 39 "X540" 40 "X590" 41 "X161" 42 "X391" 43 "L460" 44 "L461" 45 "L860" 46 "X262" 47 "X393" 48 "X762" 49 "X763" 50 "L392" 255 "Er" ;
VAL_ 1025 CcfAlarm 0 "Not Supported" 1 "Without Alarm" 2 "Alarm" 3 "Alarm No Cat 1 (perimeter anti theft)" 4 "Alarm Cat 1 (Thatcham alarm)" 255 "Error" ;
VAL_ 1025 CcfFuelTankVolume 0 "Not Supported" 1 "Volume 70 Litre" 2 "Volume 80 Litre" 3 "Volume 68 Litre" 4 "Volume 75 Litre" 5 "Volume 72 Litre" 6 "Volume 60 Litre" 7 "Volume 108 Litre" 8 "Volume 42.8 Litre" 9 "Volume 100 Litre" 10 "Volume 150 Litre" 11 "Fuel Tank Small (50L)" 12 "Fuel Tank Medium (55L)" 13 "Fuel Tank Large (62L)" 14 "Fuel Tank X-Large (66L)" 15 "Fuel Tank Flat Floor (for G-Mav 62L)" 16 "Fuel Tank AWD (AWD vehicles 66L)" 255 "Error" ;
VAL_ 1025 CcfGearbox 0 "Undefined" 1 "Manual 6-speed FWD" 2 "Manual 6-speed AWD" 3 "Automatic 6-speed FWD" 4 "Automatic 6-speed AWD" 5 "Continuous variable gearbox CFT23" 6 "Manual 5-speed FWD" 7 "Manual 5-speed FWD" 8 "Powershift, 6-speed, FWD" 9 "6 SPD AUTO TRANS DCPS" 10 "1 SPD AUTO TRANS" 11 "6 SPD AUTO TRANS 6F MID-RANGE (6F35)" 16 "Manual, 6-speed, FWD" 17 "Manual, 5-speed, FWD" 48 "6 SPD MAN TRANS-MT82" 49 "6 SP MAN TRANS-VMT6" 50 "5 SPD MAN TRANS VXT75" 51 "5 SPD MAN TRANS EAO MT75" 52 "Cft26 Cvt Auto Transaxle Zf" 53 "Automatic 6-speed Aisin F21" 54 "CVT Auto Transaxle, FWD" 55 "IB5 ASM 5-Speed Auto Shift Manual Transmission" 56 "FN Auto 4-Speed Automatic Transmission" 57 "FN Auto 5-Speed Automatic Transmission" 64 "G4E Auto 4-Speed Automatic Transmission" 68 "B6, Manual, 6-speed, FWD" 71 "6 SPD AUTO TRANS-HP26(not for Volvo)" 72 "6 SPD AUTO TRANS-HP28(not for Volvo)" 73 "6R80 Gearbox, type" 74 "ZF 8 Speed Automatic Gearbox " 80 "9 Speed Auto Gearbox " 255 "Error" ;
VAL_ 1025 CcfGearboxType 0 "Undefined" 1 "Manual gearbox" 2 "Automatic gearbox" 3 "Powershift Gearbox" 255 "Error" ;
VAL_ 1025 CcfHeadlightsType 0 "Not supported" 1 "Halogen lights without adjuster" 2 "Halogen lights with adjuster" 3 "Gas Discharger Lights with auto. adj." 4 "Advanced Front lightning system with auto. adj. / Button controlled / Mech or no tourist light" 5 "AFS123 Front Ligthing System" 6 "Not Currently Used" 7 "EcoLED" 8 "Matrix LED non-AFS123/non-IHB" 9 "Matrix LED AFS123/non-IHB" 10 "Matrix LED AFS123/IHB" 11 "Pixel LED non-AFS123/non-IHB" 12 "Pixel LED AFS123/non-IHB" 13 "Pixel LED AFS123/IHB" 255 "Error" ;
VAL_ 1025 CcfSeatMassage 0 "Not supported" 1 "Seat Massage not Fitted" 2 "Front seat 1x1 massage fitted" 3 "Rear seat 1x1 massage fitted" 4 "Front 1x1 and Rear 1x1 seat massage fitted" 5 "Front Seat 3x1 Massage Fitted" 6 "Rear Seat 3x1 Massage Fitted" 7 "Front Seat 5x5 Massage Fitted" 8 "Rear Seat 5x5 Massage Fitted" 9 "Front 3x1 & Rear 1x1 seat massage fitted" 10 "Front 3x1 & Rear 3x1 Seat Massage" 11 "Front 5x5 & Rear 3x1 Seat Massage" 12 "Front 5x5 & Rear 5x5 Seat Massage" 13 "Front 25x5 & Rear 25x5 seat Massage" 14 "Front Massage 25x5 Fitted" 15 "Front Massage 20x5 No Rear Massage" 255 "Error" ;
VAL_ 1025 CcfSteeringWheelPosn 0 "Undefined" 1 "Left Hand Drive" 2 "Right Hand Drive" 255 "Error" ;
VAL_ 1025 CcfAckSignalLockAlarm 0 "Not Supported" 1 "Lock acknowledge (no unlock)" 2 "Lock/unlock acknowledge" 255 "Error" ;
VAL_ 1025 CcfAutoLockingBySpeed 0 "Not Supported" 1 "Without automatic locking" 2 "With automatic locking" 3 "Automatic Locking Disabled" 255 "Error" ;
VAL_ 1025 CcfChildLockRearDrs 0 "Not supported" 2 "Manual child lock" 3 "Electrical child lock rear doors" 4 "Electrical lockout eg. for police vehicles" 5 "Electrical child lock rear doors and Tailgate" 255 "Error" ;
VAL_ 1025 CcfKeyLockProtection2EXT 0 "Not Supported" 1 "Off" 2 "Ext scan for key adjacent to tailgate prior to tailgate closure" 3 "Ext scan for key adjacent to tailgate post closure" 4 "Ext scan for key prior/post to tailgate closure - both options 2 and 3 above" 255 "Error" ;
VAL_ 1025 CcfKeyLockProtectionINT 0 "Not Supported" 1 "Off" 2 "Interior Scan for ADDITIONAL/NEW Key ENTERING LOADSPACE (todays boot pop functionality)" 3 "Interior Scan for ANY KEY IN VEHICLE to prevent clash of scans between additional key & any key" 255 "Error" ;
VAL_ 1025 CcfLevelSensorIfAlarm 0 "Not Supported" 1 "Without level sensor" 2 "With level sensor" 255 "Error" ;
VAL_ 1025 CcfUnlockSetting 0 "Not Supported" 1 "One step opening" 2 "Two step opening" 3 "One step opening with slam lock" 4 "Two step opening with slam lock" 5 "Two step opening with cargo slam lock and cabin reverse cycling" 255 "Error" ;
VAL_ 1025 CcfBatteryRear 0 "Not supported" 1 "No Rear Battery" 4 "Twin Battery Not For Volvo" 255 "Error" ;
VAL_ 1025 CcfBlindSpotInfoSystem 0 "Not supported" 1 "Without Blind Spot Information System" 2 "Blind Spot Information System, Camera" 3 "Blind Spot Information System With Radar 'Direct LED'" 4 "Blind Spot Information System With Radar 'CAN LED'" 5 "Blind Spot Information System with Lane Change Merge Aid System 'Direct LED' NOT FOR VOLVO" 6 "Blind Spot Information System with RTD (Rear traffic detection)" 7 "Blind Spot Information System disabled with RTD (Rear traffic detection)" 255 "Error" ;
VAL_ 1025 CcfClimateControlUnit 0 "Undefined" 1 "Electronic Climate Control" 2 "Air Condition" 3 "Automatic Temperature Control" 4 "Without Air Condition" 5 "E C C - High Performance" 6 "E C C - Medium Performance" 7 "E C C - Low Performance " 8 "Single Zone ATC" 9 "Dual Zone ATC" 10 "3 - Zone ATC" 11 "4 - Zone ATC" 255 "Error" ;
VAL_ 1025 CcfCoupeFilter 0 "Not supported" 1 "Pollen Filter" 2 "Air Quality System" 255 "Error" ;
VAL_ 1025 CcfPanicAlarm 0 "Not supported" 1 "Without Panic alarm" 2 "Panic alarm" 3 "Panic alarm limited" 255 "Error" ;
VAL_ 1025 CcfPPTCHeater 0 "Undefined" 1 "Without PTC heater" 2 "With PTC heater" 255 "Error" ;
VAL_ 1025 CcfRoadFrictionDetection 0 "Not supported" 1 "Without Road Friction Detection System" 2 "Road Friction Detection System" 255 "Error" ;
VAL_ 1025 CcfBrand 0 "Not supported" 3 "Land Rover" 4 "Jaguar" 255 "Error" ;
VAL_ 1025 CcfFreqRemoteControls 0 "Not supported" 1 "Frequency 315 MHz" 24 "Frequency 868 MHz" 33 "Frequency 915 MHz" 34 "Frequency 447 MHz" 35 "Frequency 426 MHz" 36 "Frequency 434 MHz" 37 "315 MHz Low Power" 38 "Frequency 868 MHz Single Channel" 255 "Error" ;
VAL_ 1025 CcfHeatedWindscreen 0 "Undefined" 1 "No Heated Frontscreen/wiper park/heated jets" 2 "Heated Frontscreen only" 3 "Heated Frontscreen & heated jets only" 4 "Heated Wiper Park & heated jets only" 5 "Heated Frontscreen & wiper park & heated jets" 255 "Error" ;
VAL_ 1025 CcfHillDescentControl 0 "Not supported" 1 "Without Hill Descent Control" 2 "Hill Descent Control" 255 "Error" ;
VAL_ 1025 CcfParkingAssistance 0 "Not supported" 1 "Without Parking Assistance" 2 "PDC (Rear)" 3 "PDC (Front, Rear)" 4 "PDC (360)" 5 "PDC (Front, Rear) - Parking (Parallel)" 6 "PDC (Front, Rear) - Parking (Parallel, Exit)" 7 "PDC (Front, Rear) - Parking (Parallel, Perpendicular)" 8 "PDC (Front, Rear) - Parking (Parallel, Perpendicular, Exit)" 9 "PDC (360) - Parking (Parallel, Perpendicular)" 10 "PDC (360) - Parking (Parallel, Perpendicular, Exit)" 255 "Error" ;
VAL_ 1025 CcfParkingBrakeType 0 "Not Supported" 2 "Electrical Parking Brake" 3 "Mechanical Parking Brake" 255 "Error" ;
VAL_ 1025 CcfSafetyBeltReminder 0 "Not supported" 1 "EU type" 2 "US type incl. key warning" 3 "EU type -5 star EURO-NCAP" 4 "EU type -5 star logic front system" 7 "US type US logic" 8 "US type US logic front system" 16 "EU type all seats gen. 4 logic" 17 "EU type front seats gen. 4 logic" 18 "US type all seats gen. 4 logic" 19 "US type front seats gen. 4 logic" 20 "EU Type All Seats Gen. 3D Logic" 21 "US Type All Seats Gen. 3D Logic" 255 "Error" ;
VAL_ 1025 CcfActiveSuspension 0 "Not supported" 1 "Without Continuous Controlled Chassi" 2 "Continuous Controlled Chassi" 255 "Error" ;
VAL_ 1025 CcfCentralLockType 0 "Not supported" 1 "Without Burglarproof Locks" 2 "Burglarproof Locks" 4 "Manual Locks Not For Volvo" 255 "Error" ;
VAL_ 1025 CcfDrivenAxle 0 "Not supported" 1 "All Front Wheel Drive" 2 "All Rear Wheel Drive" 3 "All Wheel Drive" 4 "LIMITED SLIP REAR AXLE" 5 "LOCKING REAR AXLE" 6 "OPEN STYLE REAR AXLE" 255 "Error" ;
VAL_ 1025 CcfRearWheelType 0 "Not supported" 1 "Single Rear Wheels" 2 "Dual Rear Wheels" 255 "Error" ;
VAL_ 1025 CcfSideWindows 0 "Not supported" 1 "Tempered Side Windows" 2 "Laminated Side Windows" 3 "Tempered Side Windows With Water Repellent Glass" 4 "Laminated Side Windows With IR And Water Repellent Glass" 255 "Error" ;
VAL_ 1025 CcfSteeringGear 0 "Not supported" 1 "Steering Gear Not Speed Sensitive" 2 "Steering Gear Speed Sensitive" 255 "Error" ;
VAL_ 1025 CcfWheelbaseSeries 0 "Not supported" 1 "0.8S SERIES" 2 "1.0S SERIES" 3 "1.0M SERIES" 4 "1.3S SERIES" 5 "1.3M SERIES" 6 "1.5S SERIES" 7 "1.5M SERIES" 8 "1.5L SERIES" 9 "1.3L SERIES" 16 "1.7M SERIES" 17 "1.9EF SERIES" 18 "1.7L SERIES" 19 "1.7EF SERIES" 20 "1.9M SERIES" 21 "1.9L SERIES" 22 "4.6T Medium Wheelbase" 23 "4.6T Long Wheelbase" 24 "4.6T Extended Wheelbase" 25 "260S ECO" 32 "260L ECO" 33 "280S ECO" 34 "280L ECO" 35 "300S ECO" 36 "300L ECO" 37 "280L" 38 "350M ECO" 39 "350 EL" 40 "410 E" 41 "410 M" 48 "410 L" 49 "470M" 50 "470 L" 51 "470 E" 52 "470 EL" 53 "390M" 54 "390 L" 55 "390 E" 56 "330S ECO" 255 "Error" ;
VAL_ 1025 CcfAirbagPassengerSide 0 "Not supported" 1 "Without Passenger Airbag" 2 "With Passenger Airbag" 255 "Error" ;
VAL_ 1025 CcfAutoLights 0 "Not supported" 1 "Without Auto Lights" 2 "With Auto Lights" 3 "Auto High Lamp Headlamp" 4 "Automatic Head Beam Control On/Off" 5 "Automatic Head Beam Control Progressive" 255 "Error" ;
VAL_ 1025 CcfCutoffSwitchPassAirbag 0 "Not supported" 1 "Without Cut-Off Switch Passenger Airbag" 2 "Cut-Off Switch Passenger Airbag" 255 "Error" ;
VAL_ 1025 CcfMemoryFunction 0 "Not supported" 1 "Without Memory" 2 "With Memory" 255 "Error" ;
VAL_ 1025 CcfPuddleLightOuterMirrors 0 "Not supported" 1 "Without Puddle Light" 2 "With Puddle Light" 3 "Puddle Light On Driver Side Only" 4 "Puddle Light On Passenger side Only" 255 "Error" ;
VAL_ 1025 CcfRearViewMirrorsOuter 0 "Not supported" 1 "Without Retractable Mirrors" 2 "With Retractable Mirrors" 3 "With Retractable Mirrors And Integrated Logic" 4 "With Retractable Mirrors and Auto Drive away Unfold" 255 "Error" ;
VAL_ 1025 CcfSideAirbagDriver 0 "Not supported" 1 "Without Side Airbag Driver" 2 "With Side Airbag Driver" 255 "Error" ;
VAL_ 1025 CcfAuxiliaryLights 0 "Not supported" 1 "Without Auxiliary Lights" 2 "Auxiliary Lights Button Controlled" 3 "Auxiliary Lights Menu Controlled" 255 "Error" ;
VAL_ 1025 CcfEmergencyBrakeLight 0 "Not supported" 1 "Without Emergency Brake Light" 2 "Emergency Brake Light Flashing" 3 "Emergency Brake Light Extended Light Area" 4 "Emergency Brake Light - Hazard Warn" 255 "Error" ;
VAL_ 1025 CcfInCarEntertainment 0 "Not supported" 1 "Less ICE PACK" 2 "Low Level Tape + AM/FM Radio" 3 "Low Level CD + AM/FM Radio" 4 "High Level CD + AM/FM Radio" 5 "High Level CDx6 + AM/FM Radio" 6 "Nav Low Level CD + AM/FM Radio" 7 "Nav High Level CD + AM/FM Radio" 8 "3000Nt Series ICE Pack" 9 "Low Level CDx6 + AM/FM Radio" 16 "Premium Level Radio / 6CD" 17 "High Level DVD + AM / FM Radio" 18 "High Level CD + AM/FM Radio With DAB" 19 "High Level CDx6 + AM/FM Radio With DAB" 20 "High Level CD + AM/FM Diversity Radio Branded" 21 "Low Level CD + AM/FM Radio Branded" 22 "FNA Single Tuner/Single CD (L0F)" 23 "FNA Single Tuner/Single CD + SDARS (L1F)" 24 "FNA Single Tuner/Single CD + SDARS + HD (L1F)" 255 "Error" ;
VAL_ 1025 CcfPowerWindows 0 "Not supported" 1 "DCU Powered Front Windows" 2 "DCU Powered Front & Rear Windows" 3 "Non-DCU Powered Windows" 4 "DCU Driver Powered Window Only" 255 "Error" ;
VAL_ 1025 CcfRadioFrequencyBand 0 "Not supported" 1 "Frequency Band And Step For Europe" 2 "Frequency Band And Step For USA" 3 "Frequency Band And Step For ROW" 4 "Frequency Band And Step For Japan" 5 "Frequency Band And Step For Gulf States" 8 "Frequency Band And Step For Australia" 9 "Frequency Band And Step For Japan (with extended FM range)" 10 "Frequency Band And Step For Europe & RoW - - FM ONLY" 11 "Frequency Band And Step For USA - FM ONLY" 12 "Frequency Band And Step For Japan - FM ONLY" 13 "Frequency Band And Step For Gulf - FM ONLY" 255 "Error" ;
VAL_ 1025 CcfRoofHatch 0 "Not supported" 1 "Roof Hatch" 2 "No Roof Hatch" 255 "Error" ;
VAL_ 1025 CcfTrimLevel 0 "Not supported" 1 "Cloth" 2 "Leather" 3 "Partial Leather" 255 "Error" ;
VAL_ 1025 CcfPowerHeatedMirrors 0 "Not supported" 1 "Short Arm Manual Mirror" 2 "Short Arm Power/Heated Mirror" 3 "Long Arm Manual Mirror" 4 "Long Arm Power/Heated Mirror" 5 "Short Arm Power/Not Heated" 255 "Error" ;
VAL_ 1025 CcfRearGlazing 0 "Undefined" 1 "No Rear Glass" 2 "Plain Rear Glass" 3 "Heated Rear Glass" 255 "Error" ;
VAL_ 1025 CcfDampSensor 0 "Undefined" 1 "Without Damp Sensor" 2 "Damp Sensor" 255 "Error" ;
VAL_ 1025 CcfDoorHandleTechnology 0 "Not supported" 1 "not Passive entry fitted" 2 "fully microswitch handle (lock & unlock)" 3 "touch sensor unlock microswitch lock" 4 "touch sensor lock and microswitch unlock" 5 "fully touch sensor (lock & unlock)" 6 "deployable handle (front only)" 7 "deployable handle (front & rear)" 255 "Error" ;
VAL_ 1025 CcfMirrorMountTurnSig 0 "Undefined error condition if used" 2 "Mirror mounted turn signal" 255 "Error" ;
VAL_ 1025 CcfRearDoorSunblinds 0 "Not supported" 1 "Without Rear Door Blinds" 2 "With Rear Door Blinds without Switches" 3 "With Rear Door Blinds with Switches" 255 "Error" ;
VAL_ 1025 Ccf4x4InfoDisplay 0 "Not Supported" 1 "Not Enabled" 2 "Enabled" 255 "Error" ;
VAL_ 1025 CcfAdvancedChauffeurFunc 0 "Undefined error condition if used" 1 "AFC not Fitted" 2 "Base Level AFC Fitted" 3 "Mid Level AFC Fitted" 4 "High Level AFC Fitted" 255 "Error" ;
VAL_ 1025 CcfDoorLatchType 0 "Not configured" 1 "C1 Latch" 2 "Unilatch" 255 "Error" ;
VAL_ 1025 CcfLowSpdIntEmergBrake 0 "Undefined error condition if used " 1 "Without LSIEB" 2 "With Rear only LSIEB" 3 "With Front and Rear LSIEB" 255 "Error" ;
VAL_ 1025 CcfModelYear 0 "Undefined error condition if used" 255 "Error" ;
VAL_ 1025 CcfAmbientLighting 0 "Undefined error condition if used" 1 "Not fitted" 2 "Dual colour fitted auto button disabled" 3 "Dual colour fitted auto button enabled" 4 "Tri colour fitted auto button disabled" 5 "Tri colour fitted auto button enabled" 6 "Non-mixing dual colour fitted auto button disabled" 7 "Non-mixing dual colour fitted auto button enabled" 8 "3 Zone Tri-colour fitted - auto button disabled" 9 "3 Zone Tri-colour fitted - auto button enabled" 255 "Error" ;
VAL_ 1025 CcfConnectAndView 0 "Not Supported" 1 "Not Fitted" 2 "CE App Projection Features - mySPIN Fitted Only" 4 "CE App Projection Features - CarPlay Fitted Only" 6 "CE App Projection Features - mySPIN CarPlay Fitted Only" 8 "CE App Projection Features - Android Auto Fitted Only" 10 "CE App Projection Features - mySPIN Android Auto Fitted Only" 12 "CE App Projection Features - CarPlay Android Auto Fitted Only" 14 "CE App Projection Features - mySPIN CarPlay and Android Auto Fitted" 16 "CE App Projection Features - Baidu CarLife Fitted Only" 18 "CE App Projection Features - mySPIN Baidu CarLife Fitted Only" 20 "CE App Projection Features - CarPlay Baidu CarLife Fitted Only" 22 "CE App Projection Features - mySPIN CarPlay Baidu CarLife Fitted Only" 24 "CE App Projection Features - Android Auto Baidu CarLife Fitted Only" 26 "CE App Projection Features - mySPIN Android Auto Baidu CarLife Fitted Only" 28 "CE App Projection Features - CarPlay Android Auto Baidu CarLife Fitted Only" 30 "CE App Projection Features - mySPIN CarPlay Android Auto Baidu CarLife Fitted" 255 "Error" ;
VAL_ 1025 CcfDynamici 0 "Not supported" 1 "Dynamic-i Not Fitted" 2 "Dynamic-i Content without Configurable Dynamic Mode Screen" 3 "Dynamic-i Content with Configurable Dynamic Mode Screen" 4 "Configurable Dynamic Mode Screen Without Dynamic-i Content" 255 "Error" ;
VAL_ 1025 CcfHandbook 0 "Undefined error condition if used" 1 "No Handbook" 2 "Handbook Set A (NAS)" 3 "Handbook Set B (ROW)" 255 "Error" ;
VAL_ 1025 CcfNavigationSpeedInhibit 0 "Undefined error condition if used" 1 "User interaction not allowed at speed." 2 "User interaction allowed at speed." 255 "Error" ;
VAL_ 1025 CcfPassiveLockErrorTones 0 "Undefined error condition if used" 1 "Chirps off" 2 "Chirps on" 255 "Error" ;
VAL_ 1025 CcfRearDiff 0 "Undefined error condition if used" 1 "Rear e-diff not fitted" 2 "Rear e-diff fitted" 3 "Torque vectoring diff (TVD) fitted" 255 "Error" ;
VAL_ 1025 CcfDeplBatterySystem 0 "Not Supported" 1 "Without Deployable Battery System" 2 "With Deployable Battery System" 3 "Error" ;
VAL_ 1025 CcfDriverBuckleSwitch 0 "Not Supported" 1 "Without Driver Buckle Switch" 2 "With Driver Buckle Switch" 3 "Error" ;
VAL_ 1025 CcfDriverKneeAirbag 0 "Not Supported" 1 "Without Driver Knee Airbag" 2 "With Driver Knee Airbag" 3 "Error" ;
VAL_ 1025 CcfDriverPassBeltPret 0 "Not supported" 1 "Without Drv and Pass Belt Buckle Pretensioners" 2 "With Drv Belt Buckle Pretensioners only" 3 "With Pass Belt Buckle Pretensioners only" 4 "With Drv and Pass Belt Buckle Pretensioners" 5 "Reserved" 6 "Reserved" 7 "Error" ;
VAL_ 1025 CcfDriverSwtchLdLimit 0 "Not Supported" 1 "Without Driver Load Limit" 2 "With Driver Load Limit" 3 "Error" ;
VAL_ 1025 CcfEventDataRecorder 0 "Not Supported" 1 "Without Event Data Recorder" 2 "With Event Data Recorder" 3 "Error" ;
VAL_ 1025 CcfFntDIFbdkMech 0 "Not Supported" 1 "BCM detects fault directly" 2 "BCM receives fault data via LIN" 3 "Error" ;
VAL_ 1025 CcfInfotainmentType 0 "Not Supported" 1 "Gen 2.1" 2 "NGI Low Line" 3 "NGI Mid Line" 4 "NGI High Line" 5 "NLI Low Line" 6 "NLI High Line" 7 "Error" ;
VAL_ 1025 CcfLeftCurtainAirbag 0 "Not Supported" 1 "Without Left Curtain Airbag" 2 "With Left Curtain Airbag" 3 "Error" ;
VAL_ 1025 CcfLeftRearHeadAbag 0 "Not Supported" 1 "Without Left Rear Head Airbag" 2 "With Left Rear Head Airbag" 3 "Error" ;
VAL_ 1025 CcfLeftSideAirbag 0 "Not Supported" 1 "Without Left Side Airbag" 2 "With Left Side Airbag" 3 "Error" ;
VAL_ 1025 CcfmPACOS 0 "Not supported" 1 "Without Passenger Airbag Deactivation Switch" 2 "With Passenger Airbag Deactivation Switch" 3 "With Menu Driven Passenger Airbag Cut-off Switch (mPACOS)" 7 "Error" ;
VAL_ 1025 CcfPADLamp 0 "Not Supported" 1 "Without PAD Lamp" 2 "With PAD Lamp" 3 "With Dual PAD Lamps" 7 "Error" ;
VAL_ 1025 CcfPassBuckleSwitch 0 "Not Supported" 1 "Without Passenger Buckle Switch" 2 "With Passenger Buckle Switch" 3 "Error" ;
VAL_ 1025 CcfPassOccWghtSensor 0 "Not Supported" 1 "Without Passenger Occupant Weight Sensor" 2 "With Passenger Occupant Weight Sensor" 3 "Error" ;
VAL_ 1025 CcfRightCurtainAirbag 0 "Not Supported" 1 "Without Right Curtain Airbag" 2 "With Right Curtain Airbag" 3 "Error" ;
VAL_ 1025 CcfRightRearHeadAbag 0 "Not Supported" 1 "Without Right Rear Head Airbag" 2 "With Right Rear Head Airbag" 3 "Error" ;
VAL_ 1025 CcfRightSideAirbag 0 "Not Supported" 1 "Without Right Side Airbag" 2 "With Right Side Airbag" 3 "Error" ;
VAL_ 1025 CcfRollOverSensing 0 "Not Supported" 1 "No Roll Over Sensing (RoSe)" 2 "with RoSe 2" 3 "with RoSe 1" 4 "with RoSe 1 Slow Roll" 7 "Error" ;
VAL_ 1025 CcfThirdRowChiller 0 "Undefined" 1 "Not Fitted" 2 "Fitted" 3 "Error" ;
VAL_ 1025 CcfTrunkLmpOutput 0 "Not Supported" 1 "Courtesy Feed" 2 "Dedicated Feed" 3 "Error" ;
VAL_ 1025 CcfWindowCalibration 0 "Not Supported" 1 "UK" 2 "India" 3 "China" 7 "Error" ;
VAL_ 1025 CcfWindowOpFeedback 0 "Not Supported" 1 "Hall Sensors" 2 "No Hall Sensors" 3 "PWM Function" 4 "Armoured" 7 "Error" ;
VAL_ 1025 CcfATPC 0 "Not Supported" 5 "No HDC or LSPC" 6 "HDC only" 9 "LSPC only" 16 "HDC and LSPC" 255 "Error" ;
VAL_ 1025 CcfBumperType 0 "Not Supported" 1 "Pattern 1 - (N/A)" 2 "Pattern 2 - (S/C)" 3 "Pattern 3 - Performance" 4 "Pattern 4 - Reserved" 5 "Pattern 5 - Reserved" 6 "Pattern 6 - JLR Accessory 1" 7 "Pattern 7 - Reserved" 15 "Error" ;
VAL_ 1025 CcfDLNAStatus 0 "Not Supported" 1 "Disabled" 2 "Enabled" 15 "Eerror" ;
VAL_ 1025 CcfDriverFrontAirbag 0 "Not Supported" 1 "Without Driver Front Airbag Stage 1 &Stage 2" 2 "With Driver Front Airbag Stage 1 only" 3 "With Driver Front Airbag Stage 1 & Stage 2" 7 "Error" ;
VAL_ 1025 CcfDriverPassRetractor 0 "Not Supported" 1 "Without Drv and Pass Retractor" 2 "With Drv Retractor only" 3 "With Pass Retractor only" 4 "With Drv and Pass Retractor" 5 "Reserved" 6 "Reserved" 7 "Error" ;
VAL_ 1025 CcfGracenotes 0 "Not Supported" 1 "No Gracenotes Database" 2 "China" 3 "Europe" 4 "Japan" 5 "Korea" 6 "Latin America" 7 "North America" 8 "Global" 15 "Error" ;
VAL_ 1025 CcfPassFrontAirbag 0 "Not Supported" 1 "Without Passenger  Front Airbag Stage 1 &Stage 2" 2 "With Passenger  Front Airbag Stage 1 only" 3 "With Passenger Front Airbag Stage 1 & Stage 2" 7 "Error" ;
VAL_ 1025 CcfRemoteStartCapable 0 "Not supported" 1 "Vehicle supports RES" 2 "RES not suopported" 3 "Error" ;
VAL_ 1025 CcfAirIonizer 0 "Not supported" 1 "Front and Rear Air Ionizer not fitted" 2 "Front Air Ionizer fitted" 3 "Rear Air Ionizer fitted" 4 "Front and Rear Air Ionizer fitted" 7 "Error" ;
VAL_ 1025 CcfAutoAccessHeight 0 "Undefined" 1 "Not Fitted" 2 "Fitted" 3 "Error" ;
VAL_ 1025 CcfCameraBtnFCIM 0 "Undefined" 1 "Not Fitted" 2 "Fitted" 3 "Error" ;
VAL_ 1025 CcfClusterAlertGFX 0 "Not Supported" 1 "Generic Warning Display" 2 "Market Derivative Warning Display #1" 3 "Market Derivative Warning Display #2" 4 "Market Derivative Warning Display #3" 7 "Error" ;
VAL_ 1025 CcfDepSideSteps 0 "Undefined" 1 "Not Fitted" 2 "Fitted" 3 "Error" ;
VAL_ 1025 CcfDriverDoorLock 0 "Not supported" 1 "No Switch Fitted" 2 "Lock Only" 3 "Unlock Only" 4 "Lock & Unlock Only" 7 "Error" ;
VAL_ 1025 CcfDSSOffRoadOperation 0 "Undefined" 1 "Not Fitted" 2 "Fitted" 3 "Error" ;
VAL_ 1025 CcfDualViewBtnFCIM 0 "Undefined" 1 "Not Fitted" 2 "Fitted" 3 "Error" ;
VAL_ 1025 CcfECOmodeText 0 "Not Supported" 1 "Off" 2 "On" 3 "Error" ;
VAL_ 1025 CcfKeyFobTechnology 0 "Not supported" 1 "PEPS2" 2 "PEPS" 3 "UWBPEPS" 7 "Error" ;
VAL_ 1025 CcfPassDoorLock 0 "Not supported" 1 "No Switch Fitted" 2 "Lock Only" 3 "Unlock Only" 4 "Lock & Unlock Only" 7 "Error" ;
VAL_ 1025 CcfPedProtectSystem 0 "Not supported" 1 "Not Fitted" 2 "Fitted" 3 "Error" ;
VAL_ 1025 CcfRearExitDetect 0 "Undefined" 1 "Not Fitted" 2 "Fitted" 3 "Error" ;
VAL_ 1025 CcfRestrictSunroofOpen 0 "Not Supported" 1 "Unrestricted" 2 "Restricted" 3 "Error" ;
VAL_ 1025 CcfRLPassDoorLock 0 "Not supported" 1 "No Switch Fitted" 2 "Lock Only" 3 "Unlock Only" 4 "Lock & Unlock Only" 7 "Error" ;
VAL_ 1025 CcfRRPassDoorLock 0 "Not supported" 1 "No Switch Fitted" 2 "Lock Only" 3 "Unlock Only" 4 "Lock & Unlock Only" 7 "Error" ;
VAL_ 1025 CcfSoftCloseDoors 0 "Not supported" 1 "Not Fitted" 2 "Fitted - Door Module Controlled" 3 "Fitted - Stand Alone Controlled" 7 "Error" ;
VAL_ 1025 CcfSunGblClTelLock 0 "Not Supported" 1 "Disabled" 2 "Enabled" 3 "Error" ;
VAL_ 1025 CcfTelLock 0 "Not Supported" 1 "Disabled" 2 "Enabled" 3 "Error" ;
VAL_ 1025 CcfTelUnlock 0 "Not Supported" 1 "Disabled" 2 "Enabled" 3 "Error" ;
VAL_ 1025 CcfTrailerLightTest 0 "Undefined" 1 "Not Fitted" 2 "Fitted" 3 "Error" ;
VAL_ 1025 CcfVehicleLocator 0 "Not Supported" 1 "Disabled" 2 "Enabled" 3 "Error" ;
VAL_ 1025 CcfWalkAwayLocking 0 "Not Supported" 1 "Not Enabled" 2 "Enabled" 3 "Error" ;
VAL_ 1025 CcfWinGblClTelLock 0 "Not Supported" 1 "Disabled" 2 "Enabled" 3 "Error" ;
VAL_ 1025 Ccf2ndRowLoadSpace 0 "Not Supported" 1 "Not Fitted" 2 "2nd Row Fitted" 3 "Error" ;
VAL_ 1025 CcfActiveVanes 0 "Undefined" 1 "No ActiveVanes fitted" 2 "ActiveVanes fitted (upper OR lower OR both)" 3 "Error" ;
VAL_ 1025 CcfArmouredVehicle 0 "Not supported" 1 "Standard" 2 "Armoured" 3 "Error" ;
VAL_ 1025 CcfDriverDoorLockLED 0 "Not supported" 1 "Not Fitted" 2 "Global" 3 "Local" 7 "Error" ;
VAL_ 1025 CcfFntLowBeamProfile 0 "Not Supported" 1 "Diagnostic Profile 1" 2 "Diagnostic Profile 2" 3 "Diagnostic Profile 3" 4 "Diagnostic Profile 4" 5 "Diagnostic Profile 5" 6 "Diagnostic Profile 6" 7 "Diagnostic Profile 7" 8 "Diagnostic Profile 8" 9 "Diagnostic Profile 9" 10 "Diagnostic Profile 10" 11 "Diagnostic Profile 11" 12 "Diagnostic Profile 12" 13 "Diagnostic Profile 13" 14 "Diagnostic Profile 14" 15 "Diagnostic Profile 15" 16 "Diagnostic Profile 16" 17 "Diagnostic Profile 17" 18 "Diagnostic Profile 18" 19 "Diagnostic Profile 19" 20 "Diagnostic Profile 20" 21 "Diagnostic Profile 21" 22 "Diagnostic Profile 22" 23 "Diagnostic Profile 23" 24 "Diagnostic Profile 24" 25 "Diagnostic Profile 25" 26 "Diagnostic Profile 26" 27 "Diagnostic Profile 27" 28 "Diagnostic Profile 28" 29 "Diagnostic Profile 29" 30 "Diagnostic Profile 30" 31 "Diagnostic Profile 31" 32 "Diagnostic Profile 32" 63 "Error" ;
VAL_ 1025 CcfHeightDataInputSelection 0 "Not Supported" 1 "Height via Analogue Height sensors" 2 "Height via CAN" 3 "Erro" ;
VAL_ 1025 CcfHUDNavigation 0 "Undefined" 1 "Not Fitted" 2 "Fitted" 3 "Error" ;
VAL_ 1025 CcfPassDoorLockLED 0 "Not supported" 1 "Not Fitted" 2 "Global" 3 "Local" 7 "Error" ;
VAL_ 1025 CcfPwrTailKickSen 0 "Not Supported" 1 "Power tailgate with Kick Sensing not fitted" 2 "Power tailgate with Kick Sensing fitted" 3 "Error" ;
VAL_ 1025 CcfPwrTailProxSenPEPS 0 "Not Supported" 1 "Power tailgate with Proximity Sensing not fitted" 2 "Power tailgate with Proximity Sensing fitted" 3 "Error" ;
VAL_ 1025 CcfRearPosProfile 0 "Not Supported" 1 "Diagnostic Profile 1" 2 "Diagnostic Profile 2" 3 "Diagnostic Profile 3" 4 "Diagnostic Profile 4" 5 "Diagnostic Profile 5" 6 "Diagnostic Profile 6" 7 "Diagnostic Profile 7" 8 "Diagnostic Profile 8" 9 "Diagnostic Profile 9" 10 "Diagnostic Profile 10" 11 "Diagnostic Profile 11" 12 "Diagnostic Profile 12" 13 "Diagnostic Profile 13" 14 "Diagnostic Profile 14" 15 "Diagnostic Profile 15" 16 "Diagnostic Profile 16" 17 "Diagnostic Profile 17" 18 "Diagnostic Profile 18" 19 "Diagnostic Profile 19" 20 "Diagnostic Profile 20" 21 "Diagnostic Profile 21" 22 "Diagnostic Profile 22" 23 "Diagnostic Profile 23" 24 "Diagnostic Profile 24" 25 "Diagnostic Profile 25" 26 "Diagnostic Profile 26" 27 "Diagnostic Profile 27" 28 "Diagnostic Profile 28" 29 "Diagnostic Profile 29" 30 "Diagnostic Profile 30" 31 "Diagnostic Profile 31" 32 "Diagnostic Profile 32" 63 "Error" ;
VAL_ 1025 CcfRearSMProfile 0 "Not Supported" 1 "Diagnostic Profile 1" 2 "Diagnostic Profile 2" 3 "Diagnostic Profile 3" 4 "Diagnostic Profile 4" 5 "Diagnostic Profile 5" 6 "Diagnostic Profile 6" 7 "Diagnostic Profile 7" 8 "Diagnostic Profile 8" 9 "Diagnostic Profile 9" 10 "Diagnostic Profile 10" 11 "Diagnostic Profile 11" 12 "Diagnostic Profile 12" 13 "Diagnostic Profile 13" 14 "Diagnostic Profile 14" 15 "Diagnostic Profile 15" 16 "Diagnostic Profile 16" 17 "Diagnostic Profile 17" 18 "Diagnostic Profile 18" 19 "Diagnostic Profile 19" 20 "Diagnostic Profile 20" 21 "Diagnostic Profile 21" 22 "Diagnostic Profile 22" 23 "Diagnostic Profile 23" 24 "Diagnostic Profile 24" 25 "Diagnostic Profile 25" 26 "Diagnostic Profile 26" 27 "Diagnostic Profile 27" 28 "Diagnostic Profile 28" 29 "Diagnostic Profile 29" 30 "Diagnostic Profile 30" 31 "Diagnostic Profile 31" 32 "Diagnostic Profile 32" 63 "Error" ;
VAL_ 1025 CcfRearStopProfile 0 "Not Supported" 1 "Diagnostic Profile 1" 2 "Diagnostic Profile 2" 3 "Diagnostic Profile 3" 4 "Diagnostic Profile 4" 5 "Diagnostic Profile 5" 6 "Diagnostic Profile 6" 7 "Diagnostic Profile 7" 8 "Diagnostic Profile 8" 9 "Diagnostic Profile 9" 10 "Diagnostic Profile 10" 11 "Diagnostic Profile 11" 12 "Diagnostic Profile 12" 13 "Diagnostic Profile 13" 14 "Diagnostic Profile 14" 15 "Diagnostic Profile 15" 16 "Diagnostic Profile 16" 17 "Diagnostic Profile 17" 18 "Diagnostic Profile 18" 19 "Diagnostic Profile 19" 20 "Diagnostic Profile 20" 21 "Diagnostic Profile 21" 22 "Diagnostic Profile 22" 23 "Diagnostic Profile 23" 24 "Diagnostic Profile 24" 25 "Diagnostic Profile 25" 26 "Diagnostic Profile 26" 27 "Diagnostic Profile 27" 28 "Diagnostic Profile 28" 29 "Diagnostic Profile 29" 30 "Diagnostic Profile 30" 31 "Diagnostic Profile 31" 32 "Diagnostic Profile 32" 63 "Error" ;
VAL_ 1025 CcfRLPassDoorLockLED 0 "Not supported" 1 "Not Fitted" 2 "Global" 3 "Local" 7 "Error" ;
VAL_ 1025 CcfRRPassDoorLockLED 0 "Not supported" 1 "Not Fitted" 2 "Global" 3 "Local" 7 "Error" ;
VAL_ 1025 CcfStopStartInhibitIcon 0 "Not Supported" 1 "Stop Start Inhibited Icon disabled (Non-CFSS)" 2 "Stop Start Inhibited Icon enabled (CFSS)" 3 "Error" ;
VAL_ 1025 CcfTelAlarmReset 0 "Not Supported" 1 "Disabled" 2 "Enabled" 3 "Error" ;
VAL_ 1025 CcfVASSensorOvride 0 "Not Supported" 1 "Disabled" 2 "Enabled" 3 "Error" ;
VAL_ 1025 CcfAlrmSensOnSingLock 0 "Not Supported" 1 "No Alarm Sensors on Single Lock" 2 "Alarm Sensors on Single Lock" 3 "Error" ;
VAL_ 1025 CcfBodyStyleRoofStructure 0 "Not Supported" 1 "Fixed" 2 "Folding (flexible)" 3 "Error" ;
VAL_ 1025 CcfDynamicProgMode 0 "Not Supported" 1 "Not available for selection" 2 "Available for selection without timeout" 3 "Available for selection with timeout" 7 "Error" ;
VAL_ 1025 CcfECOProgMode 0 "Not Supported" 1 "Not available for selection" 2 "Available for selection without timeout" 3 "Available for selection with timeout" 7 "Error" ;
VAL_ 1025 CcfFntDRLOpenLoad 0 "Not Supported" 1 "No OL" 2 "OL in OFF state" 3 "OL in ON state" 7 "Error" ;
VAL_ 1025 CcfFntFogOpenLoad 0 "Not Supported" 1 "No OL" 2 "OL in OFF state" 3 "OL in ON state" 7 "Error" ;
VAL_ 1025 CcfFntLowBeamOpenLoad 0 "Not Supported" 1 "No OL" 2 "OL in OFF state" 3 "OL in ON state" 7 "Error" ;
VAL_ 1025 CcfFntPosOpenLoad 0 "Not Supported" 1 "No OL" 2 "OL in OFF state" 3 "OL in ON state" 7 "Error" ;
VAL_ 1025 CcfFntSMOpenLoad 0 "Not Supported" 1 "No OL" 2 "OL in OFF state" 3 "OL in ON state" 7 "Error" ;
VAL_ 1025 CcfLockFuelFillFlap 0 "Not supported" 1 "Not Fitted" 2 "Fitted" 3 "Error" ;
VAL_ 1025 CcfMaxVehicleSpeed 0 "Default Speed (250 km/h)" 1 "Plant Limiter enabled" 255 "Default Speed (250 km/h)" ;
VAL_ 1025 CcfMHLastUserMode 0 "Not Supported" 1 "Last user memory mode disabled" 2 "Last user memory mode enabled" 3 "Not used" ;
VAL_ 1025 CcfPartialNetworkEnable 0 "Not Supported" 1 "Partial Networking Disabled" 2 "Partial Networking Enabled" 3 "Error" ;
VAL_ 1025 CcfRearPosOpenLoad 0 "Not Supported" 1 "No OL" 2 "OL in OFF state" 3 "OL in ON state" 7 "Error" ;
VAL_ 1025 CcfRockCrawlMode 0 "Not supported" 1 "Not available for selection" 2 "Available for selection without timeout" 3 "Available for selection with timeout" 7 "Error" ;
VAL_ 1025 CcfSandProgMode 0 "Not Supported" 1 "Not available for selection" 2 "Available for selection without timeout" 3 "Available for selection with timeout" 7 "Error" ;
VAL_ 1025 CcfSideWinGlassThick 0 "Not Supported" 1 "Standard Glass Thickness" 2 "Acoustic Glass Increased Thickness" 3 "Error" ;
VAL_ 1025 CcfUSB2Hub 0 "Not Supported" 1 "Not Fitted" 2 "Front Only Fitted" 3 "Rear Only Fitted" 4 "Front & Rear Fitted" 7 "Error" ;
VAL_ 1025 CcfUSB3Repeater 0 "Not Supported" 1 "Not Fitted" 2 "Front Only Fitted" 3 "Rear Only Fitted" 4 "Front & Rear Fitted" 7 "Error" ;
VAL_ 1025 CcfAutoAccess 0 "Not Supported" 1 "Feature not available" 2 "Feature available with driver configuration via IPK" 3 "Feature available with driver configuration via IMC" 7 "Error" ;
VAL_ 1025 CcfCoolingFanFitment 0 "Undefined" 1 "Single Electric fan/controller fitted" 2 "Twin electric fan/controllers fitted" 3 "Viscous & electric fan fitted" 4 "Viscous fan fitted" ;
VAL_ 1025 CcfDriverMemDrSwtchPk 0 "Not supported" 1 "Not Fitted" 2 "Fitted" 3 "Error" ;
VAL_ 1025 CcfEDiffType 0 "Not supported" 1 "EDiff Type 1" 15 "Error" ;
VAL_ 1025 CcfGenericEngPwrOut 0 "Undefined" 31 "Error state" ;
VAL_ 1025 CcfHdlampLvlSensPos 0 "Not Supported" 1 "Left side height sensors" 2 "Right side height sensors" 3 "Error" ;
VAL_ 1025 CcfLRTerrainJGAllRdLaunch 0 "Not Supported" 1 "Disabled" 2 "Enabled" 3 "Error" ;
VAL_ 1025 CcfPassMemDrSwtchPk 0 "Not supported" 1 "Not Fitted" 2 "Fitted" 3 "Error" ;
VAL_ 1025 CcfPTCruiseFitment 0 "Undefined" 1 "No Cruise fitted" 2 "Normal cruise fitted" 3 "ACC fitted" 4 "ACC with Queue Assist fitted" 7 "Error" ;
VAL_ 1025 CcfRearDriverMemDrSwtchPk 0 "Not supported" 1 "Not Fitted" 2 "Fitted" 3 "Error" ;
VAL_ 1025 CcfRearPassMemDrSwtchPk 0 "Not supported" 1 "Not Fitted" 2 "Fitted" 3 "Error" ;
VAL_ 1025 CcfSpdoCalkmhOffset 0 "Not supported" 1 "+ 0.0 km/h" 2 "+ 0.5 km/h" 3 "+ 1.0 km/h" 4 "+ 1.5 km/h" 5 "+ 2.0 km/h" 6 "+ 2.5 km/h" 7 "+ 3.0 km/h" 8 "+ 3.5 km/h" 15 "Error" ;
VAL_ 1025 CcfSpdoCalPercentScale 0 "Not supported" 1 "0.0% Scaling" 2 "0.5% Scaling" 3 "1.0% Scaling" 4 "1.5% Scaling" 5 "2.0% Scaling" 6 "2.5% Scaling" 7 "3.0% Scaling" 8 "3.5% Scaling" 9 "4.0% Scaling" 10 "4.5% Scaling" 11 "5.0% Scaling" 12 "5.5% Scaling" 13 "6.0% Scaling" 14 "6.5% Scaling" 15 "7.0% Scaling" 16 "7.5% Scaling" 31 "Error" ;
VAL_ 1025 CcfSplitStopFailStrat 0 "Not Supported" 1 "Strategy disabled" 2 "Bodyside lamp failure results in tailgate lamp switching off" 3 "Tailgate lamp failure results in bodyside lamp switching off" 4 "Either lamp fails results in remaining lamp switching off" 7 "Error" ;
VAL_ 1025 CcfSteerWlhlSwtchType 0 "Not Supported" 1 "SWS Dual LIN & AmbientLight (default)" 2 "SWS Single LIN" 3 "SWS CAN & LIN AmbientLight" 7 "Error" ;
VAL_ 1025 CcfTowAssist 0 "Not supported" 1 "Not Enabled" 2 "Tow Assist 2" 3 "Tow Assist 3" 4 "Tow Assist 4" 7 "Error" ;
VAL_ 1025 CcfTPMSCalibration 0 "Not Supported" 1 "TPMS Cal 1" 2 "TPMS Cal 2" 100 "TPMS Cal 100" 254 "No TPMS calibration selected" 255 "Error" ;
VAL_ 1025 CcfBrakeDiscMaterial 0 "Undefined" 1 "Iron" 2 "CCM (Carbon Ceramic Matrix)" 7 "Error" ;
VAL_ 1025 CcfBrakeDiscSizeFront 0 "Undefined" 1 "14 inch" 2 "15 inch" 3 "16 inch" 4 "17 inch" 5 "18 inch" 6 "19 inch" 7 "20 inch" 8 "16.5 inch" 15 "Error" ;
VAL_ 1025 CcfBrakeDiscSizeRear 0 "Undefined" 1 "14 inch" 2 "15 inch" 3 "16 inch" 4 "17 inch" 5 "18 inch" 6 "19 inch" 7 "20 inch" 8 "16.5 inch" 15 "Error" ;
VAL_ 1025 CcfElectricFan 0 "Not Supported" 1 "Not Fitted" 2 "Single" 3 "Double" 4 "Not Used" 5 "Not Used" 6 "Not Used" 7 "Error" ;
VAL_ 1025 CcfRearDriverLinSWP 0 "Not Supported" 1 "Not Fitted" 2 "Dual Window" 3 "Dual Window with SeatAway" 15 "Error" ;
VAL_ 1025 CcfRearPassLinSWP 0 "Not Supported" 1 "Not Fitted" 2 "Dual Window" 3 "Dual Window with SeatAway" 15 "Error" ;
VAL_ 1025 CcfServiceInterval 0 "Undefined" 65534 "Service announcement = off" 65535 "Error" ;
VAL_ 1025 CcfSportbrake 0 "Not supported" 1 "Standard" 2 "Sportbrake" 3 "Error" ;
VAL_ 1025 CcfTyreDynamicRollRad 0 "" 2000 "2000mm (X260/X260 LWB)" 2050 "2050mm (X360 X760) / 2101mm (X152) / 2300mm (L560 X761) / 2298mm (L550 20MY+ L551 19MY+ X540 18MY+)" 2101 "2101mm (X152)" 2300 "2300mm (L560, L663, X761)" 2325 "2325mm (D8 L551) / 2387mm (L405 L462 L494) / 2463mm (L460) / 2471mm (L663 only)" 2387 "2387mm (L405, L462, L494)" 65535 "Error" ;
VAL_ 1025 CcfBrakeWarningSymbol 0 "Not Supported" 1 "ISO + text" 2 "ISO" 3 "Text" 7 "Error" ;
VAL_ 1025 CcfChassisDescription 0 "Undefined" 1 "No sub-variant" 2 "'R' Chassis" 3 "'RS / SVR' Chassis" 4 "Unused" 5 "'ABB+' Chassis" 6 "Special Vehicle Operations 1 (Project 7)" 7 "Special Vehicle Operations 2" 15 "Error" ;
VAL_ 1025 CcfConfigDynamicMode 0 "Not supported" 1 "Not Fitted" 2 "Fitted" 3 "Error" ;
VAL_ 1025 CcfGearboxdescription 0 "Not supported" 1 "6 Speed Auto" 2 "8 Speed Auto (8HP70)" 3 "8 Speed Auto (8HP76)" 4 "8 Speed Auto (8HP45)" 5 "8 Speed Auto (8HP51)" 6 "9 Speed Auto (9HP50)" 7 "Hybrid 8 Speed Auto(8P70H)" 8 "Hybrid 8 Speed Auto(8P75PH)" 9 "8 Speed Auto (AW 8G30)" 10 "Electrical Drive System (No gearbox fitted)" 15 "Error" ;
VAL_ 1025 ccfGenericWheelBase 0 "Undefined" 15 "Error" ;
VAL_ 1025 CcfPTAODieWaterInSensr 0 "Undefined" 1 "Not Fitted" 2 "Fitted" 3 "Error" ;
VAL_ 1025 CcfReverseGearSelStrat 0 "Not Supported" 1 "Reverse Gear Selection Strategy Disabled" 2 "Reverse Gear Selection Strategy Enabled" 3 "Error" ;
VAL_ 1025 CcfTransmissionSelectr 0 "Undefined" 1 "Electrical Gear Selector (Shift-by-Wire)" 2 "Mechanical Gear Selector (Bowden Cable)" 3 "Stick Shifter (Shift-by-Wire)" 4 "Slave Shifter (TCM Logical control)" 5 "Virtual Shifter (Simulated signals)" 7 "Error" ;
VAL_ 1025 CcfFntClusterCableLgth 0 "Not Supported" 1 "Not Fitted" 2 "0 - 1.9m" 3 "2 - 2.9m" 4 "3 - 3.9m" 5 "4 - 4.9m" 6 "5 - 5.9m" 7 "6 - 6.9m" 8 "7 - 7.9m" 14 "Length Unknown - Load Default" 15 "Error" ;
VAL_ 1025 CcfFntDispCableLgth 0 "Not Supported" 1 "Not Fitted" 2 "0 - 1.9m" 3 "2 - 2.9m" 4 "3 - 3.9m" 5 "4 - 4.9m" 6 "5 - 5.9m" 7 "6 - 6.9m" 8 "7 - 7.9m" 14 "Length Unknown - Load Default" 15 "Error" ;
VAL_ 1025 CcfAllSurfaceInfo 0 "Not supported" 1 "Not Fitted" 2 "Fitted" 3 "Error" ;
VAL_ 1025 CcfBrowserSearch 0 "Not Supported" 1 "Default" 2 "Search Engine 1" 3 "Search Engine 2" 4 "Search Engine 3" 5 "Search Engine 4" 6 "Search Engine 5" 7 "Error" ;
VAL_ 1025 CcfDriverWinSWPack 0 "Not supported" 1 "No switch fitted" 2 "Rear Window Lock Out Switch" 3 "Global Open/Close Switch" 7 "Error" ;
VAL_ 1025 CcfFntUIPCableLgth 0 "Not Supported" 1 "Not Fitted" 2 "0 - 1.9m" 3 "2 - 2.9m" 4 "3 - 3.9m" 5 "4 - 4.9m" 6 "5 - 5.9m" 7 "6 - 6.9m" 8 "7 - 7.9m" 14 "Length Unknown - Load Default" 15 "Error" ;
VAL_ 1025 CcfRearLftDispCableLgth 0 "Not Supported" 1 "Not Supported" 2 "0 - 1.9m" 3 "2 - 2.9m" 4 "3 - 3.9m" 5 "4 - 4.9m" 6 "5 - 5.9m" 7 "6 - 6.9m" 8 "7 - 7.9m" 14 "Length Unknown - Load Default" 15 "Error" ;
VAL_ 1025 CcfRearRghtDisplayCableLgth 0 "Not Supported" 1 "Not Fitted" 2 "0 - 1.9m" 3 "2 - 2.9m" 4 "3 - 3.9m" 5 "4 - 4.9m" 6 "5 - 5.9m" 7 "6 - 6.9m" 8 "7 - 7.9m" 14 "Length Unknown - Load Default" 15 "Error" ;
VAL_ 1025 CcfRearUIPLnk1CableLgth 0 "Not Supported" 1 "Not Fitted" 2 "0 - 1.9m" 3 "2 - 2.9m" 4 "3 - 3.9m" 5 "4 - 4.9m" 6 "5 - 5.9m" 7 "6 - 6.9m" 8 "7 - 7.9m" 14 "Length Unknown - Load Default" 15 "Error" ;
VAL_ 1025 CcfRearUIPLnk2CableLgth 0 "Not Supported" 1 "Not Fitted" 2 "0 - 1.9m" 3 "2 - 2.9m" 4 "3 - 3.9m" 5 "4 - 4.9m" 6 "5 - 5.9m" 7 "6 - 6.9m" 8 "7 - 7.9m" 14 "Length Unknown - Load Default" 15 "Error" ;
VAL_ 1025 CcfRrLmpBhWhTgateOpen 0 "Not Supported" 1 "TrunkStatusOutput Disabled" 2 "TrunkStatusOutput Enabled" 3 "Error" ;
VAL_ 1025 CcfSeatLumbSWFittedD 0 "Not supported" 1 "Not Fitted" 2 "Fitted" 3 "Error" ;
VAL_ 1025 CcfSeatLumbSWFittedP 0 "Not supported" 1 "Not Fitted" 2 "Fitted" 3 "Error" ;
VAL_ 1025 CcfSeatLumbSWFittedRD 0 "Not supported" 1 "Not Fitted" 2 "Fitted" 3 "Error" ;
VAL_ 1025 CcfSeatLumbSWFittedRP 0 "Not supported" 1 "Not Fitted" 2 "Fitted" 3 "Error" ;
VAL_ 1025 CcfSeatMasgSWFittedD 0 "Not supported" 1 "Not Fitted" 2 "Fitted" 3 "Error" ;
VAL_ 1025 CcfSeatMasgSWFittedP 0 "Not supported" 1 "Not Fitted" 2 "Fitted" 3 "Error" ;
VAL_ 1025 CcfSeatMasgSWFittedRD 0 "Not supported" 1 "Not Fitted" 2 "Fitted" 3 "Error" ;
VAL_ 1025 CcfSeatMasgSWFittedRP 0 "Not supported" 1 "Not Fitted" 2 "Fitted" 3 "Error" ;
VAL_ 1025 CcfSeatMovSWFittedD 0 "Not supported" 1 "Not Fitted" 2 "Fitted" 3 "Error" ;
VAL_ 1025 CcfSeatMovSWFittedP 0 "Not supported" 1 "Not Fitted" 2 "Fitted" 3 "Error" ;
VAL_ 1025 CcfSeatMovSWFittedRD 0 "Not supported" 1 "Not Fitted" 2 "Fitted" 3 "Error" ;
VAL_ 1025 CcfSeatMovSWFittedRP 0 "Not supported" 1 "Not Fitted" 2 "Fitted" 3 "Error" ;
VAL_ 1025 CcfSeatPSASWFitted 0 "Not supported" 1 "Not Fitted" 2 "Fitted" 3 "Error" ;
VAL_ 1025 CcfDieselEMSEmissMkt 0 "Not supported" 1 "Federal" 2 "Euro" 3 "Japan" 4 "Brazil" 5 "RoW" 6 "Bio_Fuel" 7 "China" 15 "Error" ;
VAL_ 1025 CcfDriverID 0 "Not Supported" 1 "Not Fitted" 2 "Manual" 3 "Automatic" 7 "Error" ;
VAL_ 1025 CcfDriverIDKeys 0 "Not supported" 1 "Not Fitted" 2 "Fitted" 3 "Error" ;
VAL_ 1025 CcfDriverIDPhones 0 "Not supported" 1 "Not Fitted" 2 "Fitted" 3 "Error" ;
VAL_ 1025 CcfDriverIDSeats 0 "Not supported" 1 "Not Fitted" 2 "Fitted" 3 "Error" ;
VAL_ 1025 CcfEcoDataGallonType 0 "Not Supported" 1 "Imperial Gallons" 2 "US Gallons" 7 "Error" ;
VAL_ 1025 CcfFrntLowerDispKeys 0 "Not Supported" 1 "Not Fitted" 2 "4 Keys" 3 "2 Keys" 7 "Error" ;
VAL_ 1025 CcfFrntLowerDispVariant 0 "Not supported" 1 "Not Fitted" 2 "Panasonic 10 inch Single View" 3 "ALPS 5 inch Single View" 15 "Error" ;
VAL_ 1025 CcfFrntUpperDeployable 0 "Not supported" 1 "Not Fitted" 2 "Fitted" 3 "Error" ;
VAL_ 1025 CcfFrntUpperDispVariant 0 "Not Supported" 1 "Not Fitted" 2 "Panasonic 10 Inch Single View" 3 "Visteon 10 Inch Single View" 15 "Error" ;
VAL_ 1025 CcfFrontPassengerID 0 "Not Supported" 1 "Not Fitted" 2 "Manual" 3 "Automatic" 4 "Error" ;
VAL_ 1025 CcfNGICamBanStrat 0 "Not Supported" 1 "No Warning Banner Displayed by Infotainment" 2 "Warning Banner Displayed by Infotainment" 3 "Error" ;
VAL_ 1025 CcfNonDepIllumDoorHnd 0 "Not supported" 1 "Not Fitted" 2 "Fitted" 3 "Error" ;
VAL_ 1025 CcfPersonalisation 0 "Not Supported" 1 "Not Fitted" 2 "Driver Only" 3 "Front Row" 4 "Front Row + Row2" 5 "Front Row + Row2 + Row3" 7 "Error" ;
VAL_ 1025 CcfRow2PassengerID 0 "Not Supported" 1 "Not Fitted" 2 "Manual" 3 "Automatic" 7 "Error" ;
VAL_ 1025 CcfRow3PassengerID 0 "Not Supported" 1 "Not Fitted" 2 "Manual" 3 "Automatic" 7 "Error" ;
VAL_ 1025 CcfSmartExitFntDrvDr 0 "Undefined" 1 "Not Fitted" 2 "Fitted" 3 "Error" ;
VAL_ 1025 CcfSmartExitFntPassDoor 0 "Undefined" 1 "Not Fitted" 2 "Fitted" 3 "Error" ;
VAL_ 1025 CcfSmartExitRrDrvDoor 0 "Undefined" 1 "Not Fitted" 2 "Fitted" 3 "Error" ;
VAL_ 1025 CcfSmartExitRrPassDoor 0 "Undefined" 1 "Not Fitted" 2 "Fitted" 3 "Error" ;
VAL_ 1025 CcfTransCalIndex 0 "Not supported" 1 "Calibration Index #1" 2 "Calibration Index #2" 3 "Calibration Index #3" 4 "Calibration Index #4" 5 "Calibration Index #5" 6 "Calibration Index #6" 7 "Error" ;
VAL_ 1025 CcfChargingInlet1 0 "Not Supported" 1 "Inlet Not Fitted" 2 "AC Type 1" 3 "AC Type 2" 4 "AC GBT" 5 "AC+DC Type 1 Combo" 6 "AC+DC Type 2 Combo" 7 "DC GBT" 8 "DC Chademo" 15 "Error" ;
VAL_ 1025 CcfChargingInlet2 0 "Not Supported" 1 "Inlet Not Fitted" 2 "AC Type 1" 3 "AC Type 2" 4 "AC GBT" 5 "AC+DC Type 1 Combo" 6 "AC+DC Type 2 Combo" 7 "DC GBT" 8 "DC Chademo" 15 "Error" ;
VAL_ 1025 CcfEMMaxDurEngOff 0 "Not supported" 255 "Error" ;
VAL_ 1025 CcfFMMaxFuelAge 0 "Not supported" 255 "Error" ;
VAL_ 1025 CcfFntPassWdowSwtchPk 0 "Not Supported" 1 "Not Fitted" 2 "Hardwired" 15 "Error" ;
VAL_ 1025 CcfFrntDrvWdowSwtchpk 0 "Not Supported" 1 "Not Fitted" 2 "Non Capacitive switchpack" 3 "Capacitive switchpack" 15 "Error" ;
VAL_ 1025 CcfMicrophoneType 0 "Not Supported" 1 "Not Fitted" 2 "Microphone Type 1" 3 "Microphone Type 2" 4 "Microphone Type 3" 5 "Microphone Type 4" 6 "Microphone Type 5" 15 "Error" ;
VAL_ 1025 CcfRrDrWdowSwtchPk 0 "Not Supported" 1 "Not Fitted" 2 "Hardwired" 3 "LIN Dual Window Switch + Seat Away" 4 "LIN Single Window Switch + Multi-function" 5 "LIN Single Window Switch" 6 "LIN Dual Window Switch" 15 "Error" ;
VAL_ 1025 CcfRrPassWdowSwtchpk 0 "Not Supported" 1 "Not Fitted" 2 "Hardwired" 3 "LIN Dual Window Switch + Seat Away" 4 "LIN Single Window Switch + Multi-function" 5 "LIN Single Window Switch" 6 "LIN Dual Window Switch" 15 "Error" ;
VAL_ 1025 CcfSelectStateCharge 0 "Not supported" 1 "Not Fitted" 2 "Fitted" 3 "Error" ;
VAL_ 1025 CcfTelematicsSpkrType 0 "Not Supported" 1 "Not Fitted" 2 "TELEMATICS_MID_RANGE " 3 "PREMIUM_COAXIAL" 4 "SUPER_PREMIUM_COAXIAL " 5 "PREMIUM_MIDRANGE" 6 "SUPER_PREMIUM_MIDRANGE " 7 "TELEMATICS_80mm" 15 "Error" ;
VAL_ 1025 CcfTimedChrgFeature 0 "Not Supported" 1 "Timed Charging not fitted" 2 "Timed Charging fitted" 3 "Timed Charging with geofencing fitted" 7 "Error" ;
VAL_ 1025 CcfWirelessCharger 0 "Not supported" 1 "Not Fitted" 2 "Fitted" 7 "Error" ;
VAL_ 1025 CcfAuxCoolingPump 0 "Undefined" 1 "AuxCoolingPump not fitted" 2 "AuxCoolingPump Fitted (PCM controlled)" 3 "AuxCoolingPump Fitted (HVAC controlled)" 4 "Dual AuxCoolingPump Fitted (PCM & HVAC controlled)" 5 "Reserved" 6 "Reserved" 7 "Error" ;
VAL_ 1025 CcfBrakePedalFeel 0 "Not supported" 1 "Not Fitted" 2 "Brake Pedal Feel 1" 3 "Brake Pedal Feel 2" 4 "Brake Pedal Feel 3" 5 "Brake Pedal Feel 4" 6 "Brake Pedal Feel 5" 7 "Brake Pedal Feel 6" 8 "Brake Pedal Feel 7" 9 "Brake Pedal Feel 8" 10 "Brake Pedal Feel 9" 11 "Brake Pedal Feel 10" 255 "Error" ;
VAL_ 1025 CcfCleanSurroundCams 0 "Not Supported" 1 "No Clean Camera" 2 "Rear Active Hide Camera" 3 "Rear Camera Wash with independent manual command" 4 "Rear Camera Wash with automatic command" 7 "Error" ;
VAL_ 1025 CcfCntrRetractPretRow1 0 "Not Supported" 1 "Without Center Retractor Pretensioner Row1" 2 "With Center Retractor Pretensioner Row1" 3 "Error" ;
VAL_ 1025 CcfCntrRetractPretRow2 0 "Not Supported" 1 "Without Center Retractor Pretensioner Row2" 2 "With Center Retractor Pretensioner Row2" 3 "Error" ;
VAL_ 1025 CcfCntrRetractPretRow3 0 "Not Supported" 1 "Without Center Retractor Pretensioner Row3" 2 "With Center Retractor Pretensioner Row3" 3 "Error" ;
VAL_ 1025 CcfFarSideOccImpAbgRow1 0 "Not Supported" 1 "Without FarSide OccupantImpact Airbag Row1" 2 "With Without FarSide OccupantImpact Airbag Row1" 3 "Error" ;
VAL_ 1025 CcfGrndMarkingDetect 0 "Not supported" 1 "Not available" 2 "Available" 3 "Error" ;
VAL_ 1025 CcfIMCClusterAPIXClrDpth 0 "Not Supported" 1 "Not Fitted" 2 "16 bit RGB565" 3 "18 bit RGB666" 4 "24 bit" 15 "Error" ;
VAL_ 1025 CcfIMCClusterAPIXVideoSpd 0 "Not Supported" 1 "Not Fitted" 2 "500 Megabits/second" 3 "1 Gigabits/second" 4 "3 Gigabits/second" 15 "Error" ;
VAL_ 1025 CcfOpenableICP 0 "Not supported" 1 "Not Fitted" 2 "Fitted" 3 "Error" ;
VAL_ 1025 CcfParkAidCommsBus 0 "Invalid" 1 "CAN bus" 2 "LIN bus" 3 "Reserved" ;
VAL_ 1025 CcfParkAssistHMI 0 "Not supported" 1 "Low Line HMI" 2 "High Line Dynamic" 3 "High Line Static" 7 "Error" ;
VAL_ 1025 CcfPNPreConEnable 0 "Not Supported" 1 "Disabled" 2 "Enabled" 3 "Error" ;
VAL_ 1025 CcfRearRoofBlindFitted 0 "Not supported" 1 "Not Fitted" 2 "Fitted" 3 "Error" ;
VAL_ 1025 CcfReverseMirrorDip 0 "Not supported" 1 "Not enabled" 2 "Passenger Mirror Only" 3 "Both Mirrors" 7 "Error" ;
VAL_ 1025 CcfReverseMirrorDipStrat 0 "Not supported" 1 "Not enabled" 2 "Fixed Dip" 3 "Adjustable Memory Dip" 7 "Error" ;
VAL_ 1025 CcfRoofType 0 "Not Supported" 1 "Fixed Roof" 2 "Convertible Soft Top" 3 "Convertible Hard Top" 7 "Error" ;
VAL_ 1025 CcfSeatThermHMIControl 0 "Not Supported" 1 "Display All Row Seat Thermal Pages in Touchscreen" 2 "Do not display any Seat Thermal pages in Touchscreen" 3 "Display 1st Row Seat Thermal Page in Touchscreen (not 2nd or 3rd)" 4 "Display 2nd Row Seat Thermal Page in Touchscreen (not 1st or 3rd)" 5 "Display 1st & 2nd Row Seat Thermal Pages in Touchscreen (not 3rd)" 6 "Display 3rd Row Seat Thermal Page in Touchscreen (not 1st & 2nd)" 7 "Display 1st & 3rd Row Seat Thermal Pages in Touchscreen (not 2nd)" 8 "Display 2nd & 3rd Row Seat Thermal Pages in Touchscreen (not 1st)" 15 "Error" ;
VAL_ 1025 CcfAskOnExit 0 "Not Supported" 1 "Disabled" 2 "Enabled" 3 "Error" ;
VAL_ 1025 CcfBacklightStratSel 0 "Not Supported" 1 "BacklightNight/DayControlStrategy" 2 "BacklightLinearControlStrategy (No Night/Day Switching)" 3 "Error" ;
VAL_ 1025 CcfBodyKitStyle 0 "Not Supported" 1 "Core body kit" 2 "Dynamic body kit" 15 "Error" ;
VAL_ 1025 CcfClearExitDetectionSystem 0 "Not supported" 1 "Not Fitted" 2 "Fitted" 3 "Error" ;
VAL_ 1025 CcfDriveAssist 0 "Not Supported" 1 "Drive Assist Not Avaliable" 2 "Drive Assist Avaliable" 3 "Error" ;
VAL_ 1025 CcfDriverHeatedCalfRest 0 "Not Supported" 1 "Not Fitted" 2 "Heated Calf Rest fitted on second row driver-side seat" 3 "Error" ;
VAL_ 1025 CcfDynamicLiteMode 0 "Not Supported" 1 "Not available for selection" 2 "Available for selection without timeout" 3 "Available for selection with timeout" 7 "Error" ;
VAL_ 1025 CcfEngineNoiseCancel 0 "Not Supported" 1 "Engine Noise Cancellation Not Fitted" 2 "Engine Noise Cancellation Fitted" 3 "Error" ;
VAL_ 1025 CcfFront23BuckSwitch 0 "Not supported" 1 "2 Seats in Row 1" 2 "3 Seats in Row 1" 3 "Error " ;
VAL_ 1025 CcfHeatedDoorArmrest 0 "Not Supported" 1 "Not Fitted" 2 "Front Only" 3 "Rear Only" 4 "Front and Rear" 7 "Error" ;
VAL_ 1025 CcfHeatedMapPocket 0 "Not Supported" 1 "Not Fitted" 2 "Fitted" 3 "Error" ;
VAL_ 1025 CcfHtdFrntCntreArmrst 0 "Not Supported" 1 "Not Fitted" 2 "Single Centre" 3 "Front Left and Right" 7 "Error" ;
VAL_ 1025 CcfHtdRearCntreArmrst 0 "Not Supported" 1 "Not Fitted" 2 "Single Centre" 3 "Front Left and Right" 7 "Error" ;
VAL_ 1025 CcfIntelEmrgBrkingCAEB 0 "Not Supported" 1 "CAEB Not Fitted" 2 "CAEB Fitted" 3 "Error" ;
VAL_ 1025 CcfLowerGloveBox 0 "Not Supported" 1 "Not Fitted" 2 "Manuala" 3 "Electric" 7 "Error" ;
VAL_ 1025 CcfRow3BuckleSwitch 0 "Not Supported" 1 "2 Seats in Row 3" 2 "3 Seats in Row 3" 3 "Error" ;
VAL_ 1025 CcfSAPServerType 0 "Not Supported" 1 "No SAP Server" 2 "Actia SAP Server" 3 "LG SAP Server" 7 "Error" ;
VAL_ 1025 CcfSeatTherm2ndRowHMIControl 0 "Not Supported" 1 "Display 2nd row Seat Thermal page" 2 "Do not display 2nd row Seat Thermal page" 3 "Error" ;
VAL_ 1025 CcfSuspensionType 0 "Not supported" 1 "Coil-Coil" 2 "2 Corner Air" 3 "4 Corner Air" 15 "Error" ;
VAL_ 1025 CcfTaskLighting 0 "Not Supported" 1 "Not Fitted" 2 "Dimmable Task Light Fitted" 3 "Error" ;
VAL_ 1025 CcfUpperGloveBox 0 "Not Supported" 1 "Not Fitted" 2 "Manuala" 3 "Electric" 7 "Error" ;
VAL_ 1025 CcfUWBPEPSRANGEADJUSTUSEVSA 0 "Not Supported" 1 "3 Metres" 2 "4 Metres" 3 "5 Metres" 7 "Error" ;
VAL_ 1025 CcfADBInitialisation 0 "Not supported" 1 "Not Fitted" 2 "Fitted" 3 "Error" ;
VAL_ 1025 CcfAutoVentsType 0 "Not Supported" 1 "Auto Vents fitted with Always Open and Auto" 2 "Auto Vents fitted with Auto and Dynamic" 7 "Error" ;
VAL_ 1025 CcfDisplaySeatTempIntensity 0 "Not Supported" 1 "Display All Row Seat Temperature Intensity controls in Front Touchscreen" 2 "Do not display any Seat Temperature Intensity controls in Front Touchscreen" 3 "Display 1st Row seat Temperature Intensity controls in Front Touchscreen (not 2nd or 3rd)" 4 "Display 2nd Row Seat Temperature Intensity controls in Front Touchscreen (not 1st or 3rd)" 5 "Display 1st & 2nd Row Seat Temperature Intensity controls in Front Touchscreen (not 3rd)" 6 "Display 3rd Row Seat Temperature Intensity controls in Front Touchscreen (not 1st & 2nd)" 7 "UnallocatedDisplay 1st & 3rd Row Seat Temperature Intensity controls in Front Touchscreen (not 2nd)" 8 "Display 2nd & 3rd Row Seat Temperature Intensity controls in Front Touchscreen (not 1st)" 15 "Error" ;
VAL_ 1025 CcfDisplaySeatTempZone 0 "Not Supported" 1 "Display All Row Seat Zone controls in Front Touchscreen" 2 "Do not display any Seat Zone controls in Front Touchscreen" 3 "Display 1st Row seat Zone controls in Front Touchscreen (not 2nd or 3rd)" 4 "Display 2nd Row Seat Zone controls in Front Touchscreen (not 1st or 3rd)" 5 "Display 1st & 2nd Row Seat Zone controls in Front Touchscreen (not 3rd)" 6 "Display 3rd Row Seat Zone controls in Front Touchscreen (not 1st & 2nd)" 7 "Display 1st & 3rd Row Seat Zone controls in Front Touchscreen (not 2nd)" 8 "Display 2nd & 3rd Row Seat Zone controls in Front Touchscreen (not 1st)" 15 "Error" ;
VAL_ 1025 CcfDriverMicrophoneType 0 "Not Supported" 1 "Not Fitted" 2 "Unbalanced Microphone" 3 "Balanced Microphone" 7 "Error" ;
VAL_ 1025 CcfElectFrntLoadspace 0 "Not supported" 1 "Not Fitted" 2 "Fitted" 3 "Error" ;
VAL_ 1025 CcfExhaustHeatshieldType 0 "Not Supported" 1 "HEAT SHIELD TYPE 1" 2 "HEAT SHIELD TYPE 2" 3 "HEAT SHIELD TYPE 3" 4 "HEAT SHIELD TYPE 4" 5 "HEAT SHIELD TYPE 5" 6 "HEAT SHIELD TYPE 6" 7 "HEAT SHIELD TYPE 7" 8 "HEAT SHIELD TYPE 8" 9 "HEAT SHIELD TYPE 9" 10 "HEAT SHIELD TYPE 10" 11 "HEAT SHIELD TYPE 11" 12 "HEAT SHIELD TYPE 12" 13 "HEAT SHIELD TYPE 13" 14 "HEAT SHIELD TYPE 14" 15 "HEAT SHIELD TYPE 15" 16 "Not Fitted" 31 "Error" ;
VAL_ 1025 CcfExhaustType 0 "Not Supported" 1 "SINGLE SIDED" 2 "TWO SIDED" 3 "CENTRE" 4 "Not Fitted" 7 "Error" ;
VAL_ 1025 CcfMirrorPositionFeature 0 "Not Supported" 1 "Not fitted (feature not present)" 2 "Estimated Folded/Unfolded" 3 "Accurate Folded/Unfolded (using microswitches)" 4 "Accurate intermediate position (reserved for future use)" 7 "Error" ;
VAL_ 1025 CcfRearBumperType 0 "Not Supported" 1 "CORE TYPE 1" 2 "CORE TYPE 2" 3 "CORE TYPE 3" 4 "CORE TYPE 4" 5 "CORE TYPE 5" 6 "DYNAMIC TYPE 1" 7 "DYNAMIC TYPE 2" 8 "DYNAMIC TYPE 3" 9 "DYNAMIC TYPE 4" 10 "DYNAMIC TYPE 5" 11 "SVO TYPE 1" 12 "SVO TYPE 2" 13 "SVO TYPE 3" 14 "SVO TYPE 4" 15 "SVO TYPE 5" 31 "Error" ;
VAL_ 1025 CcfSeatMsg2ndRowHMIControl 0 "Not Supported" 1 "Display 2nd row Seat Massage page" 2 "Do not display 2nd row Seat Massage page" 3 "Error" ;
VAL_ 1025 CcfSeatMsgHMIControl 0 "Not Supported" 1 "Display All Row Seat Massage Pages in Touchscreen" 2 "Do not display any Seat Massage pages in Touchscreen" 3 "Display 1st Row Seat Massage Page in Touchscreen (not 2nd or 3rd)" 4 "Display 2nd Row Seat Massage Page in Touchscreen (not 1st or 3rd)" 5 "Display 1st & 2nd Row Seat Massage Pages in Touchscreen (not 3rd)" 6 "Display 3rd Row Seat Massage Page in Touchscreen (not 1st & 2nd)" 7 "Display 1st & 3rd Row Seat Massage Pages in Touchscreen (not 2nd)" 8 "Display 2nd & 3rd Row Seat Massage Pages in Touchscreen (not 1st)" 15 "Error" ;
VAL_ 1025 CcfSlopeInformation 0 "Not Supported" 1 "Not Fitted" 2 "Fitted" 3 "Use legacy logic" 7 "Error" ;
VAL_ 1025 CcfTouristMode 0 "Not supported" 1 "Not Fitted" 2 "Fitted" 3 "Error" ;
VAL_ 1025 CcfUWBSATFreqChannel 0 "Not Supported" 1 "Not Fitted" 2 "Frequency 3.99 GHz" 3 "Frequency 6.4 GHz" 4 "Frequency 4.5 GHz" 255 "Error" ;
VAL_ 1025 CcfWheelInformation 0 "Not Supported" 1 "Not Fitted" 2 "Fitted" 3 "Use legacy logic" 7 "Error" ;
VAL_ 1025 CcfAdapDrvBeamSeg 0 "Not Supported" 1 "1 Segment" 2 "2 Segments" 3 "3 Segments" 4 "4 Segments" 5 "5 Segments" 6 "6 Segments" 7 "7 Segments" 8 "8 Segments" 9 "9 Segments" 10 "10 Segments" 11 "11 Segments" 12 "12 Segments" 13 "13 Segments" 14 "14 Segments" 15 "15 Segments" 16 "16 Segments" 17 "17 Segments" 18 "18 Segments" 19 "19 Segments" 20 "20 Segments" 21 "21 Segments" 22 "22 Segments" 23 "23 Segments" 24 "24 Segments" 25 "25 Segments" 255 "Error" ;
VAL_ 1025 CcfAdasNCapESS 0 "Not Supported" 1 "Not Fitted" 2 "Fitted" 3 "Error" ;
VAL_ 1025 CcfAdasNCapLKAUpcomTraff 0 "Not Supported" 1 "Not Fitted" 2 "Fitted" 3 "Error" ;
VAL_ 1025 CcfBCMInteriorLightDelay 0 "Not Supported" 1 "0  Off Delay (Seconds)" 2 "15 Off Delay (Seconds)" 3 "30 Off Delay (Seconds)" 4 "45 Off Delay (Seconds)" 5 "60 Off Delay (Seconds)" 6 "75 Off Delay (Seconds)" 7 "Error" ;
VAL_ 1025 CcfBCMInteriorLightTrunk 0 "Not Supported" 1 "Interior lamps activated with trunk ajar - Disabled" 2 "Interior lamps activated with trunk ajar - Enabled" 3 "Error" ;
VAL_ 1025 CcfBrakeFluidLvlSource 0 "Not Supported" 1 "Brake Fluid Level signal from BCM (BrakeFluidLevelWarning)" 2 "Brake Fluid Level signal from ABS (BrakeFluidLevelWarning2)" 3 "Error" ;
VAL_ 1025 CcfDeployableSideStepType 0 "Not Supported" 1 "Calibration Required" 2 "Type 1 (440 Hall counts)" 3 "Type 2 (360 Hall counts)" 4 "Type 3 (Hall counts TBC)" 5 "Type 4 (Hall counts TBC)" 6 "Type 5 (Hall counts TBC)" 7 "Type 6 (Hall counts TBC)" 8 "Type 7 (Hall counts TBC)" 9 "Type 8 (Hall counts TBC)" 10 "Type 9 (Hall counts TBC)" 11 "Type 10 (Hall counts TBC)" 12 "Type 11 (Hall counts TBC)" 13 "Type 12 (Hall counts TBC)" 14 "Type 13 (Hall counts TBC)" 15 "Error" ;
VAL_ 1025 CcfDynBendingLight 0 "Not supported" 1 "Not Fitted" 2 "Fitted" 3 "Error" ;
VAL_ 1025 CcfESSCalibration 0 "Not Supported" 1 "Not Fitted" 2 "Calibration 1" 3 "Calibration 2" 4 "Calibration 3" 5 "Calibration 4" 6 "Calibration 5" 7 "Error" ;
VAL_ 1025 CcfExteriorMirrorAutoUnfold 0 "Not Supported" 1 "Automatic External Mirrors Unfold Not Enabled" 2 "Automatic External Mirrors Unfold Enabled" 7 "Error" ;
VAL_ 1025 CcfFuelGaugeVariant2 0 "Not Supported" 1 "Fuel Gauge Variant 1" 2 "Fuel Gauge Variant 2" 3 "Fuel Gauge Variant 3" 4 "Fuel Gauge Variant 4" 5 "Fuel Gauge Variant 5" 6 "Fuel Gauge Variant 6" 7 "Fuel Gauge Variant 7" 8 "Fuel Gauge Variant 8" 9 "Fuel Gauge Variant 9" 10 "Fuel Gauge Variant 10" 11 "Fuel Gauge Variant 11" 12 "Fuel Gauge Variant 12" 13 "Fuel Gauge Variant 13" 14 "Fuel Gauge Variant 14" 15 "Error" ;
VAL_ 1025 CcfLKARE 0 "Not Supported" 1 "Not Fitted" 2 "Fitted" 3 "Error" ;
VAL_ 1025 CcfPassKneeAirbag 0 "Not supported" 1 "Without Passenger knee airbag" 2 "With Passenger knee airbag" 3 "Error" ;
VAL_ 1025 CcfSeatMvmtModuleType 0 "Not Supported" 1 "No seat movement fitted" 2 "Seat movement module per side: i.e. up to 2 Driver and Passenger all rows" 3 "Seat movement module per seat: i.e. up to 4 Driver and Passenger front & 2nd rows" 15 "Error" ;
VAL_ 1025 CcfSignPostDimming 0 "Not supported" 1 "Not Fitted" 2 "Fitted" 3 "Error" ;
VAL_ 1025 CcfSupMainBeamRoutIntensity 0 "Not Supported" 1 "Disabled" 2 "Enabled at 10% Intensity" 3 "Enabled at 20% Intensity" 4 "Enabled at 30% Intensity" 5 "Enabled at 40% Intensity" 6 "Enabled at 50% Intensity" 7 "Enabled at 60% Intensity" 8 "Enabled at 70% Intensity" 9 "Enabled at 80% Intensity" 10 "Enabled at 90% Intensity" 11 "Enabled at 100% Intensity" 15 "Error" ;
VAL_ 1025 CcfTJAICARE 0 "Not supported" 1 "Not Fitted" 2 "Fitted" 3 "Error" ;
VAL_ 1025 CcfWakeupShutdownSeqTyp 0 "Not Supported" 1 "DI and Position" 2 "Disabled" 3 "Sequence 1" 4 "Sequence 2" 5 "Sequence 3" 6 "Sequence 4" 7 "Sequence 5" 8 "Sequence 6" 9 "Sequence 7" 10 "Sequence 8" 11 "Sequence 9" 12 "Sequence 10" 13 "Sequence 11" 14 "Sequence 12" 31 "Error" ;
VAL_ 1025 CcfACCAccelProfileSelect 0 "Not supported" 1 "Not Fitted" 2 "Fitted" 3 "Error" ;
VAL_ 1025 CcfACCLeadCarDistDisp 0 "Not supported" 1 "Not Fitted" 2 "Fitted" 3 "Error" ;
VAL_ 1025 CcfACCStopGapSelect 0 "Not supported" 1 "Not Fitted" 2 "Fitted" 3 "Error" ;
VAL_ 1025 CcfAdasDCR 0 "Not Supported" 1 "DCR not fitted" 2 "DCR fitted" 3 "Error" ;
VAL_ 1025 CcfAdasLongCRA 0 "Not Supported" 1 "Not Fitted" 2 "Fitted" 3 "Error" ;
VAL_ 1025 CcfAdasLongRPC 0 "Not Supported" 1 "Not Fitted" 2 "Fitted" 3 "Error" ;
VAL_ 1025 CcfAdasNCapCyclistAEB 0 "Not supported" 1 "Not Fitted" 2 "Fitted" 3 "Error" ;
VAL_ 1025 CcfAdasTJP 0 "Not Supported" 1 "Not Fitted" 2 "Fitted" 3 "Error" ;
VAL_ 1025 CcfAutoHold 0 "Not Supported" 1 "HVH Disabled" 2 "HVH Enabled" 3 "Error" ;
VAL_ 1025 CcfDSMFitment 0 "Not Supported" 1 "Not Fitted" 2 "Fitted" 3 "Error" ;
VAL_ 1025 CcfESSCalNo 0 "Not Supported" 1 "Calibration 1" 2 "Calibration 2" 3 "Calibration 3" 4 "Calibration 4" 5 "Calibration 5" 6 "Calibration 6" 7 "Calibration 7" 8 "Calibration 8" 9 "Calibration 9" 10 "Calibration 10" 11 "Calibration 11" 12 "Calibration 12" 13 "Calibration 13" 14 "Calibration 14" 15 "Calibration 15" 16 "Calibration 16" 17 "Calibration 17" 18 "Calibration 18" 19 "Calibration 19" 20 "Calibration 20" 254 "Cal Number Not Applicable" 255 "Error" ;
VAL_ 1025 CcfIntMirrorVariant 0 "Not Supported" 1 "Not Fitted" 2 "IRVM" 3 "IRVM and Additional Bezel" 4 "IRVM and Homelink" 5 "IRVM and Additional Bezel and Homelink" 6 "SRVM" 7 "SRVM and Additional Bezel" 8 "SRVM and Homelink" 9 "SRVM and Additional Bezel and Homelink" 15 "Error" ;
VAL_ 1025 CcfLaneKeepAssistLDW 0 "Not supported" 1 "Not Fitted" 2 "Fitted" 3 "Error" ;
VAL_ 1025 CcfLeftManoeuvringLgt 0 "Not supported" 1 "Not Fitted" 2 "Fitted" 3 "Error" ;
VAL_ 1025 CcfParkPawlLocation 0 "Not Supported" 1 "Transmission - Front Axle only" 2 "Transmission - Rear Axle only" 3 "Transmission - Front and Rear Axles" 4 "EDU - Front Axle only" 5 "EDU - Rear Axle only" 6 "EDU - Frontand Rear Axles" 7 "Wheels - Front Axle only" 8 "Wheels - Rear Axle only" 9 "Wheels - Front and Rear Axle" 15 "Error" ;
VAL_ 1025 CcfPassHeatedCalfRest 0 "Not Supported" 1 "Not Fitted" 2 "Heated Calf Rest fitted on second row passenger-side seat" 3 "Error" ;
VAL_ 1025 CcfPSMFitment 0 "Not Supported" 1 "Not Fitted" 2 "Fitted" 3 "Error" ;
VAL_ 1025 CcfR2SMFitment 0 "Not Supported" 1 "Not Fitted" 2 "Fitted" 3 "Error" ;
VAL_ 1025 CcfR3SMFitment 0 "Not Supported" 1 "Not Fitted" 2 "Fitted" 3 "Error" ;
VAL_ 1025 CcfRghtManoeuvringLgt 0 "Not supported" 1 "Not Fitted" 2 "Fitted" 3 "Error" ;
VAL_ 1025 CcfRLSMFitment 0 "Not Supported" 1 "Not Fitted" 2 "Fitted" 3 "Error" ;
VAL_ 1025 CcfRRSMFitment 0 "Not Supported" 1 "Not Fitted" 2 "Fitted" 3 "Error" ;
VAL_ 1025 CcfSeatMassHanded 0 "Not Supported" 1 "Rear massage signals inverted on LHD vehicles straight on RHD vehicles" 2 "Rear massage signals straight on all vehicles" 3 "Error" ;
VAL_ 1025 CcfARNCCalNo 0 "Not Supported" 1 "Calibration 1" 2 "Calibration 2" 3 "Calibration 3" 4 "Calibration 4" 5 "Calibration 5" 6 "Calibration 6" 7 "Calibration 7" 8 "Calibration 8" 9 "Calibration 9" 10 "Calibration 10" 11 "Calibration 11" 12 "Calibration 12" 13 "Calibration 13" 14 "Calibration 14" 15 "Calibration 15" 16 "Calibration 16" 17 "Calibration 17" 18 "Calibration 18" 19 "Calibration 19" 20 "Calibration 20" 254 "Cal Number Not Applicable" 255 "Error" ;
VAL_ 1025 CcfASDExhaustCalNo 0 "Not Supported" 1 "Calibration 1" 2 "Calibration 2" 3 "Calibration 3" 4 "Calibration 4" 5 "Calibration 5" 6 "Calibration 6" 7 "Calibration 7" 8 "Calibration 8" 9 "Calibration 9" 10 "Calibration 10" 11 "Calibration 11" 12 "Calibration 12" 13 "Calibration 13" 14 "Calibration 14" 15 "Calibration 15" 16 "Calibration 16" 17 "Calibration 17" 18 "Calibration 18" 19 "Calibration 19" 20 "Calibration 20" 254 "Cal Number Not Applicable" 255 "Error" ;
VAL_ 1025 CcfAVNCalNo 0 "Not Supported" 1 "Calibration 1" 2 "Calibration 2" 3 "Calibration 3" 4 "Calibration 4" 5 "Calibration 5" 6 "Calibration 6" 7 "Calibration 7" 8 "Calibration 8" 9 "Calibration 9" 10 "Calibration 10" 11 "Calibration 11" 12 "Calibration 12" 13 "Calibration 13" 14 "Calibration 14" 15 "Calibration 15" 16 "Calibration 16" 17 "Calibration 17" 18 "Calibration 18" 19 "Calibration 19" 20 "Calibration 20" 254 "Cal Number Not Applicable" 255 "Error" ;
VAL_ 1025 CcfCDLGlobalClose 0 "Not Supported" 1 "Disabled" 2 "Enabled" 3 "Error" ;
VAL_ 1025 CcfCDLGlobalOpen 0 "Not Supported" 1 "Disabled" 2 "Enabled" 3 "Error" ;
VAL_ 1025 CcfCityUrbanAutoEmerBraking 0 "Not Supported" 1 "CUIEB Not fitted" 2 "CUIEB fitted" 3 "Error" ;
VAL_ 1025 CcfCyCAutoEmerBraking 0 "Not Supported" 1 "CAEB Not fitted" 2 "CAEB fitted" 3 "Error" ;
VAL_ 1025 CcfEOCCalNo 0 "Not Supported" 1 "Calibration 1" 2 "Calibration 2" 3 "Calibration 3" 4 "Calibration 4" 5 "Calibration 5" 6 "Calibration 6" 7 "Calibration 7" 8 "Calibration 8" 9 "Calibration 9" 10 "Calibration 10" 11 "Calibration 11" 12 "Calibration 12" 13 "Calibration 13" 14 "Calibration 14" 15 "Calibration 15" 16 "Calibration 16" 17 "Calibration 17" 18 "Calibration 18" 19 "Calibration 19" 20 "Calibration 20" 254 "Cal Number Not Applicable" 255 "Error" ;
VAL_ 1025 CcfFrontBeltMinder 0 "Not Supported" 1 "Beltminder Fully OFF" 2 "Beltminder Minimum Warning" 3 "Beltminder ON (ECE type)" 4 "Beltminder ON (FMVSS type)" 7 "Error" ;
VAL_ 1025 CcfFrontPreCrashSunRoof 0 "Not Supported" 1 "FPC SunRoof Not Fitted" 2 "FPC SunRoof Fitted" 3 "Error" ;
VAL_ 1025 CcfFwdCollisionWarn 0 "Not Supported" 1 "Without FCW" 2 "FCW with Forward Warning Only" 3 "FCW with Forward and Cross Traffic Warning" 7 "Error" ;
VAL_ 1025 CcfIntelligentEmerBraking 0 "Not Supported" 1 "IEB Not fitted" 2 "IEB fitted" 3 "Error" ;
VAL_ 1025 CcfJuncAutoEmerBraking 0 "Not Supported" 1 "JAEB Not fitted" 2 "JAEB fitted" 3 "Error" ;
VAL_ 1025 CcfOverspeedIndia 0 "Not Supported" 1 "Disabled" 2 "Enabled" 3 "Error" ;
VAL_ 1025 CcfPedAutoEmerBraking 0 "Not Supported" 1 "PAEB Not fitted" 2 "PAEB fitted" 3 "Error" ;
VAL_ 1025 CcfAutolampFastResponse 0 "Not Supported" 1 "Disabled" 2 "Enabled" 3 "Error" ;
VAL_ 1025 CcfChargeFlap1 0 "Not Supported" 1 "Charge Flap Not Fitted" 2 "Hardwired Type" 3 "Hardwired Type with Feedback" 4 "LIN Type" 5 "LIN Type with feedback" 6 "External Relay type" 7 "Charge Flap TypeY" 8 "Charge Flap TypeZ" 15 "Error" ;
VAL_ 1025 CcfChargeFlap2 0 "Not Supported" 1 "Charge Flap Not Fitted" 2 "Hardwired Type" 3 "Hardwired Type with Feedback" 4 "LIN Type" 5 "LIN Type with feedback" 6 "External Relay type" 7 "Charge Flap TypeY" 8 "Charge Flap TypeZ" 15 "Error" ;
VAL_ 1025 CcfEOCExhaustCalNo 0 "Not Supported" 1 "Calibration 1" 2 "Calibration 2" 3 "Calibration 3" 4 "Calibration 4" 5 "Calibration 5" 6 "Calibration 6" 7 "Calibration 7" 8 "Calibration 8" 9 "Calibration 9" 10 "Calibration 10" 11 "Calibration 11" 12 "Calibration 12" 13 "Calibration 13" 14 "Calibration 14" 15 "Calibration 15" 16 "Calibration 16" 17 "Calibration 17" 18 "Calibration 18" 19 "Calibration 19" 20 "Calibration 20" 254 "Cal Number Not Applicable" 255 "Error" ;
VAL_ 1025 CcfHeadlampWash 0 "Not supported" 1 "Not Fitted" 2 "Fitted" 3 "Error" ;
VAL_ 1025 CcfMemorySwitchType 0 "Not Supported" 1 "Resistive Ladder" 2 "LIN Node" 3 "Error" ;
VAL_ 1025 CcfRainSensorFitment 0 "Not supported" 1 "Not Fitted" 2 "Fitted" 3 "Error" ;
VAL_ 1025 CcfRCTAConfiguration 0 "Not Supported" 1 "Legacy" 2 "Motion based alert" 3 "Brake function" 7 "Error" ;
VAL_ 1025 CcfSeatSwitchPackPos 0 "Not Supported" 1 "No Switch Pack Fitted/Feature not fitted" 2 "Fitted to Seat" 3 "Fitted to Door" 7 "Error" ;
VAL_ 1025 CcfSMRFGlobalClose 0 "Not Supported" 1 "Disabled" 2 "Enabled" 3 "Error" ;
VAL_ 1025 CcfWiperColdClimDLRWash 0 "Not Supported" 1 "Disabled" 2 "Enabled" 3 "Error" ;
VAL_ 1025 CcfWiperCollarSwtchRnSenSeni 0 "Not Supported" 1 "Disabled" 2 "Enabled" 3 "Error" ;
VAL_ 1025 CcfWiperDripWipeFeature 0 "Not Supported" 1 "Disabled" 2 "Enabled" 3 "Error" ;
VAL_ 1025 CcfWiperFntSpeedDepend 0 "Not Supported" 1 "Disabled" 2 "Enabled" 3 "Error" ;
VAL_ 1025 CcfWiperHdlmpWshPressure 0 "Not Supported" 1 "Low" 2 "High" 3 "Error" ;
VAL_ 1025 CcfWiperHeadlmpWashDLR 0 "Not Supported" 1 "Disabled" 2 "Enabled" 3 "Error" ;
VAL_ 1025 CcfWiperInterSpdDepend 0 "Not Supported" 1 "Disabled" 2 "Enabled" 3 "Error" ;
VAL_ 1025 CcfWiperProgramWipeActive 0 "Not Supported" 1 "Disabled" 2 "Enabled" 3 "Error" ;
VAL_ 1025 CcfWiperRearContinue 0 "Not Supported" 1 "Disabled" 2 "Enabled" 3 "Error" ;
VAL_ 1025 CcfWiperRrHlfMoonParkSwtch 0 "Not Supported" 1 "Disabled" 2 "Enabled" 3 "Error" ;
VAL_ 1025 CcfWiperTwinWasherBottle 0 "Not supported" 1 "Not Fitted" 2 "Fitted" 3 "Error" ;
VAL_ 1025 CcfWiperUpStroke 0 "Not Supported" 1 "Disabled" 2 "Enabled" 3 "Error" ;
VAL_ 1025 CcfActiveExhaustMap 0 "Not Supported" 1 "Default Map" 2 "Map_A" 3 "Map_B" 4 "Map_C" 5 "Map_D" 6 "Map_E" 7 "Map_F" 8 "Map_G" 9 "Map_H" 10 "Map_I" 11 "Map_J" 12 "Map_K" 13 "Map_L" 14 "Map_M" 15 "Error" ;
VAL_ 1025 CcfClimateSeatSigType 0 "Not Supported" 1 "ON required before seat part selection and intensity change" 2 "Seat part selection and intensity change indicates ON" 3 "Error" ;
VAL_ 1025 CcfCornerOnThreshold 0 "Not Supported" 255 "Error" ;
VAL_ 1025 CcfDIFlashOnArmDisarm 0 "Undefined" 1 "Disabled" 2 "Enabled" 3 "Error" ;
VAL_ 1025 CcfDoubleLockingChirp 0 "Undefined" 1 "Disabled" 2 "Enabled" 3 "Error" ;
VAL_ 1025 CcfDriverConditionMon 0 "Not Supported" 1 "Not Fitted" 2 "Variant A: Driver fatigue warning" 3 "Variant B: Driver fatigue warning & Rest area assistance" 4 "Variant C: Driver fatigue warning, Rest area assistance & Distraction signal" 5 "Variant D: Driver fatigue warning, Rest area assistance, Distraction monitoring & Unresponsiveness Warning" 15 "Error" ;
VAL_ 1025 CcfHeadrestDrop 0 "Not Supported" 1 "Headrest Drop Not Fitted" 2 "Headrest Drop Fitted to all Foldable seats" 15 "Error" ;
VAL_ 1025 CcfHVBattRegCompliance 0 "Not Supported" 1 "ECE/UN (Rest of World)" 2 "GB/GBT (China)" 3 "Japan Blue Book (Japan)" 4 "KMVSS (Korea)" 5 "FMVSS (US)" 6 "IS/AIS (India)" 7 "GOST (Russia)" 15 "Error" ;
VAL_ 1025 CcfNASTrailerLighting 0 "Not Supported" 1 "Disabled" 2 "Enabled" 3 "Error" ;
VAL_ 1025 CcfOpenCloseRFKey 0 "Not Supported" 1 "Upper Only" 2 "Upper & Lower" 3 "Error" ;
VAL_ 1025 CcfPreCrashWindowLift 0 "Not Supported" 1 "Window Lift Not Available" 2 "Window Lift Available " 3 "Error" ;
VAL_ 1025 CcfRemoteConvRoofOperation 0 "Not Supported" 1 "Disabled" 2 "Enabled" 3 "Error" ;
VAL_ 1025 CcfSecurityDIFlashOnErr 0 "Undefined" 1 "Disabled" 2 "Enabled" 3 "Error" ;
VAL_ 1025 CcfSecurityErrorTone 0 "Undefined" 1 "Disabled" 2 "Enabled" 3 "Error" ;
VAL_ 1025 CcfSmartEye 0 "Not Supported" 1 "SmartEye Not Fitted" 2 "SmartEye Fitted" 3 "Error" ;
VAL_ 1025 CcfTailgateRemoteRel 0 "Not Supported" 1 "Tailgate" 2 "Glass Only" 3 "Error" ;
VAL_ 1025 CcfTJAICAHOD 0 "Not Supported" 1 "Not Enabled" 2 "Enabled - 1 warning strategy" 3 "Enabled - 3 warnings strategy" 7 "Error" ;
VAL_ 1025 CcfTripComputerUnitsWh 0 "Undefined" 1 "Not Fitted" 2 "Fitted" 3 "Error" ;
VAL_ 1025 CcfWindowPWMMode 0 "Not Supported" 1 "PWM Not Supported" 2 "PWM Supported" 3 "Error" ;
VAL_ 1025 CcfAutoSSSelectInFCPB 0 "Not Supported" 1 "Control interface not available in FCPB" 2 "Available as single purpose button" 3 "Selectable within rotary" 4 "Available as shared purpose button" 5 "Rotary used for selection within touch screen" 7 "Error" ;
VAL_ 1025 CcfDSCSelectInFCPB 0 "Not Supported" 1 "Control interface not available in FCPB" 2 "Available as single purpose button" 3 "Selectable within rotary" 4 "Available as shared purpose button" 5 "Rotary used for selection within touch screen" 7 "Error" ;
VAL_ 1025 CcfHDCSelectInFCPB 0 "Not Supported" 1 "Control interface not available in FCPB" 2 "Available as single purpose button" 3 "Selectable within rotary" 4 "Available as shared purpose button" 5 "Rotary used for selection within touch screen" 7 "Error" ;
VAL_ 1025 CcfRemoteWingMirrorFold 0 "Not Supported" 1 "Remote Wing Mirror Fold not available" 2 "Remote Wing Mirror Fold available" 3 "Error" ;
VAL_ 1025 CcfTerComSelectInFCPB 0 "Not Supported" 1 "Control interface not available in FCPB" 2 "Available as single purpose button" 3 "Selectable within rotary" 4 "Available as shared purpose button" 5 "Rotary used for selection within touch screen" 7 "Error" ;
VAL_ 1025 CcfTerDynSelectInFCPB 0 "Not Supported" 1 "Control interface not available in FCPB" 2 "Available as single purpose button" 3 "Selectable within rotary" 4 "Available as shared purpose button" 5 "Rotary used for selection within touch screen" 7 "Error" ;
VAL_ 1025 CcfTerECOSelectInFCPB 0 "Not Supported" 1 "Control interface not available in FCPB" 2 "Available as single purpose button" 3 "Selectable within rotary" 4 "Available as shared purpose button" 5 "Rotary used for selection within touch screen" 7 "Error" ;
VAL_ 324 DeviceChargeLevel 0 "Not Charging" 1 "Charging" 2 "Fully Charged" 3 "Undefined" ;
VAL_ 324 WDCFault 0 "No Fault" 1 "High Temp Error" 2 "Foreign Object" 3 "Undefined" ;
SIG_GROUP_ 1944 TST_PhysicalRespFTCMB 1 : TesterPhysicalResFTCMB;
SIG_GROUP_ 1849 TST_PhysicalRespKVM 1 : TesterPhysicalResKVM;
SIG_GROUP_ 2025 TST_PhysicalRespLPDM 1 : TesterPhysicalResLPDM;
SIG_GROUP_ 1963 TST_PhysicalRespPSM 1 : TesterPhysicalResPSM;
SIG_GROUP_ 1917 TST_PhysicalRespRGTM 1 : TesterPhysicalResRGTM;
SIG_GROUP_ 1982 TST_PhysicalRespRGTMB 1 : TesterPhysicalResRGTMB;
SIG_GROUP_ 1802 TST_PhysicalRespRLSM 1 : TesterPhysicalResRLSM;
SIG_GROUP_ 2024 TST_PhysicalRespRPDM 1 : TesterPhysicalResRPDM;
SIG_GROUP_ 1899 TST_PhysicalRespRRSM 1 : TesterPhysicalResRRSM;
SIG_GROUP_ 1887 TST_PhysicalRespTBM 1 : TesterPhysicalResTBM;
SIG_GROUP_ 1834 TST_PhysicalRespVIM 1 : TesterPhysicalResVIM;
SIG_GROUP_ 1807 TST_PhysicalRespWDCM 1 : TesterPhysicalResWDCM;
SIG_GROUP_ 1025 CCFPayload0x01 1 : CcfAlternator CcfBifuel CcfDoors CcfEngine CcfFuel CcfTransmissionDriveLn CcfVehicleType;
SIG_GROUP_ 1025 CCFPayload0x02 1 : CcfAlarm CcfFuelTankVolume CcfGearbox CcfGearboxType CcfHeadlightsType CcfSeatMassage CcfSteeringWheelPosn;
SIG_GROUP_ 1025 CCFPayload0x05 1 : CcfAckSignalLockAlarm CcfAutoLockingBySpeed CcfChildLockRearDrs CcfKeyLockProtection2EXT CcfKeyLockProtectionINT CcfLevelSensorIfAlarm CcfUnlockSetting;
SIG_GROUP_ 1025 CCFPayload0x06 1 : CcfBatteryRear CcfBlindSpotInfoSystem CcfClimateControlUnit CcfCoupeFilter CcfPanicAlarm CcfPPTCHeater CcfRoadFrictionDetection;
SIG_GROUP_ 1025 CCFPayload0x09 1 : CcfBrand CcfFreqRemoteControls CcfHeatedWindscreen CcfHillDescentControl CcfParkingAssistance CcfParkingBrakeType CcfSafetyBeltReminder;
SIG_GROUP_ 1025 CCFPayload0x0C 1 : CcfActiveSuspension CcfCentralLockType CcfDrivenAxle CcfRearWheelType CcfSideWindows CcfSteeringGear CcfWheelbaseSeries;
SIG_GROUP_ 1025 CCFPayload0x0D 1 : CcfAirbagPassengerSide CcfAutoLights CcfCutoffSwitchPassAirbag CcfMemoryFunction CcfPuddleLightOuterMirrors CcfRearViewMirrorsOuter CcfSideAirbagDriver;
SIG_GROUP_ 1025 CCFPayload0x10 1 : CcfAuxiliaryLights CcfEmergencyBrakeLight CcfInCarEntertainment CcfPowerWindows CcfRadioFrequencyBand CcfRoofHatch CcfTrimLevel;
SIG_GROUP_ 1025 CCFPayload0x15 1 : CcfPowerHeatedMirrors CcfRearGlazing;
SIG_GROUP_ 1025 CCFPayload0x1A 1 : CcfDampSensor CcfDoorHandleTechnology;
SIG_GROUP_ 1025 CCFPayload0x1C 1 : CcfMirrorMountTurnSig CcfRearDoorSunblinds;
SIG_GROUP_ 1025 CCFPayload0x21 1 : Ccf4x4InfoDisplay CcfAdvancedChauffeurFunc CcfDoorLatchType CcfLowSpdIntEmergBrake CcfModelYear;
SIG_GROUP_ 1025 CCFPayload0x23 1 : CcfAmbientLighting CcfConnectAndView CcfDynamici CcfHandbook CcfNavigationSpeedInhibit CcfPassiveLockErrorTones CcfRearDiff;
SIG_GROUP_ 1025 CCFPayload0x41 1 : CcfCameraHMIStrategy CcfDeplBatterySystem CcfDriverBuckleSwitch CcfDriverKneeAirbag CcfDriverPassBeltPret CcfDriverSwtchLdLimit CcfEventDataRecorder CcfFntDIFbdkMech CcfInfotainmentType CcfLeftCurtainAirbag CcfLeftRearHeadAbag CcfLeftSideAirbag CcfmPACOS CcfPADLamp CcfPassBuckleSwitch CcfPassOccWghtSensor CcfRightCurtainAirbag CcfRightRearHeadAbag CcfRightSideAirbag CcfRollOverSensing CcfThirdRowChiller CcfTrunkLmpOutput CcfWindowCalibration CcfWindowOpFeedback;
SIG_GROUP_ 1025 CCFPayload0x44 1 : CcfATPC CcfBumperType CcfDLNAStatus CcfDriverFrontAirbag CcfDriverPassRetractor CcfGracenotes CcfPassFrontAirbag CcfRemoteStartCapable;
SIG_GROUP_ 1025 CCFPayload0x49 1 : CcfAirIonizer CcfAutoAccessHeight CcfCameraBtnFCIM CcfClusterAlertGFX CcfDepSideSteps CcfDriverDoorLock CcfDSSOffRoadOperation CcfDualViewBtnFCIM CcfECOmodeText CcfKeyFobTechnology CcfPassDoorLock CcfPedProtectSystem CcfRearExitDetect CcfRestrictSunroofOpen CcfRLPassDoorLock CcfRRPassDoorLock CcfSoftCloseDoors CcfSunGblClTelLock CcfTelLock CcfTelUnlock CcfTrailerLightTest CcfVehicleLocator CcfWalkAwayLocking CcfWinGblClTelLock;
SIG_GROUP_ 1025 CCFPayload0x4A 1 : Ccf2ndRowLoadSpace CcfActiveVanes CcfArmouredVehicle CcfDriverDoorLockLED CcfFntLowBeamProfile CcfHeightDataInputSelection CcfHUDNavigation CcfPassDoorLockLED CcfPwrTailKickSen CcfPwrTailProxSenPEPS CcfRearPosProfile CcfRearSMProfile CcfRearStopProfile CcfRLPassDoorLockLED CcfRRPassDoorLockLED CcfStopStartInhibitIcon CcfTelAlarmReset CcfVASSensorOvride;
SIG_GROUP_ 1025 CCFPayload0x51 1 : CcfAlrmSensOnSingLock CcfBodyStyleRoofStructure CcfDynamicProgMode CcfECOProgMode CcfFntDRLOpenLoad CcfFntFogOpenLoad CcfFntLowBeamOpenLoad CcfFntPosOpenLoad CcfFntSMOpenLoad CcfLockFuelFillFlap CcfMaxVehicleSpeed CcfMHLastUserMode CcfPartialNetworkEnable CcfRearPosOpenLoad CcfRockCrawlMode CcfSandProgMode CcfSideWinGlassThick CcfUSB2Hub CcfUSB3Repeater;
SIG_GROUP_ 1025 CCFPayload0x53 1 : CcfAutoAccess CcfCoolingFanFitment CcfDriverMemDrSwtchPk CcfEDiffType CcfGenericEngPwrOut CcfHdlampLvlSensPos CcfLRTerrainJGAllRdLaunch CcfPassMemDrSwtchPk CcfPTCruiseFitment CcfRearDriverMemDrSwtchPk CcfRearPassMemDrSwtchPk CcfSpdoCalkmhOffset CcfSpdoCalPercentScale CcfSplitStopFailStrat CcfSteerWlhlSwtchType CcfTowAssist CcfTPMSCalibration;
SIG_GROUP_ 1025 CCFPayload0x55 1 : CcfBrakeDiscMaterial CcfBrakeDiscSizeFront CcfBrakeDiscSizeRear CcfElectricFan CcfRearDriverLinSWP CcfRearPassLinSWP CcfServiceInterval CcfSportbrake CcfTyreDynamicRollRad;
SIG_GROUP_ 1025 CCFPayload0x57 1 : CcfBrakeWarningSymbol CcfChassisDescription CcfConfigDynamicMode CcfGearboxdescription ccfGenericWheelBase CcfPTAODieWaterInSensr CcfReverseGearSelStrat CcfTransmissionSelectr CcfVINPart1;
SIG_GROUP_ 1025 CCFPayload0x58 1 : CcfVINPart2;
SIG_GROUP_ 1025 CCFPayload0x59 1 : CcfFntClusterCableLgth CcfFntDispCableLgth CcfVINPart3;
SIG_GROUP_ 1025 CCFPayload0x5A 1 : CcfAllSurfaceInfo CcfBrowserSearch CcfDriverWinSWPack CcfFntUIPCableLgth CcfRearLftDispCableLgth CcfRearRghtDisplayCableLgth CcfRearUIPLnk1CableLgth CcfRearUIPLnk2CableLgth CcfRrLmpBhWhTgateOpen CcfSeatLumbSWFittedD CcfSeatLumbSWFittedP CcfSeatLumbSWFittedRD CcfSeatLumbSWFittedRP CcfSeatMasgSWFittedD CcfSeatMasgSWFittedP CcfSeatMasgSWFittedRD CcfSeatMasgSWFittedRP CcfSeatMovSWFittedD CcfSeatMovSWFittedP CcfSeatMovSWFittedRD CcfSeatMovSWFittedRP CcfSeatPSASWFitted;
SIG_GROUP_ 1025 CCFPayload0x5C 1 : CcfDieselEMSEmissMkt CcfDriverID CcfDriverIDKeys CcfDriverIDPhones CcfDriverIDSeats CcfEcoDataGallonType CcfFrntLowerDispKeys CcfFrntLowerDispVariant CcfFrntUpperDeployable CcfFrntUpperDispVariant CcfFrontPassengerID CcfNGICamBanStrat CcfNonDepIllumDoorHnd CcfPersonalisation CcfRow2PassengerID CcfRow3PassengerID CcfSmartExitFntDrvDr CcfSmartExitFntPassDoor CcfSmartExitRrDrvDoor CcfSmartExitRrPassDoor CcfTransCalIndex;
SIG_GROUP_ 1025 CCFPayload0x5D 1 : CcfChargingInlet1 CcfChargingInlet2 CcfEMMaxDurEngOff CcfFMMaxFuelAge CcfFntPassWdowSwtchPk CcfFrntDrvWdowSwtchpk CcfMicrophoneType CcfRrDrWdowSwtchPk CcfRrPassWdowSwtchpk CcfSelectStateCharge CcfTelematicsSpkrType CcfTimedChrgFeature CcfWirelessCharger;
SIG_GROUP_ 1025 CCFPayload0x5E 1 : CcfAuxCoolingPump CcfBrakePedalFeel CcfCleanSurroundCams CcfCntrRetractPretRow1 CcfCntrRetractPretRow2 CcfCntrRetractPretRow3 CcfFarSideOccImpAbgRow1 CcfGrndMarkingDetect CcfIMCClusterAPIXClrDpth CcfIMCClusterAPIXVideoSpd CcfOpenableICP CcfParkAidCommsBus CcfParkAssistHMI CcfPNPreConEnable CcfRearRoofBlindFitted CcfReverseMirrorDip CcfReverseMirrorDipStrat CcfRoofType CcfSeatThermHMIControl;
SIG_GROUP_ 1025 CCFPayload0x62 1 : CcfAskOnExit CcfBacklightStratSel CcfBodyKitStyle CcfClearExitDetectionSystem CcfDriveAssist CcfDriverHeatedCalfRest CcfDynamicLiteMode CcfEngineNoiseCancel CcfFront23BuckSwitch CcfHeatedDoorArmrest CcfHeatedMapPocket CcfHtdFrntCntreArmrst CcfHtdRearCntreArmrst CcfIntelEmrgBrkingCAEB CcfLowerGloveBox CcfRow3BuckleSwitch CcfSAPServerType CcfSeatTherm2ndRowHMIControl CcfSuspensionType CcfTaskLighting CcfUpperGloveBox CcfUWBPEPSRANGEADJUSTUSEVSA;
SIG_GROUP_ 1025 CCFPayload0x63 1 : CcfADBInitialisation CcfAutoVentsType CcfDisplaySeatTempIntensity CcfDisplaySeatTempZone CcfDriverMicrophoneType CcfElectFrntLoadspace CcfExhaustHeatshieldType CcfExhaustType CcfMirrorPositionFeature CcfRearBumperType CcfSeatMsg2ndRowHMIControl CcfSeatMsgHMIControl CcfSlopeInformation CcfTouristMode CcfUWBSATFreqChannel CcfWheelInformation;
SIG_GROUP_ 1025 CCFPayload0x65 1 : CcfAdapDrvBeamSeg CcfAdasNCapESS CcfAdasNCapLKAUpcomTraff CcfBCMInteriorLightDelay CcfBCMInteriorLightTrunk CcfBrakeFluidLvlSource CcfDeployableSideStepType CcfDynBendingLight CcfESSCalibration CcfExteriorMirrorAutoUnfold CcfFuelGaugeVariant2 CcfLKARE CcfPassKneeAirbag CcfSeatMvmtModuleType CcfSignPostDimming CcfSupMainBeamRoutIntensity CcfTJAICARE CcfWakeupShutdownSeqTyp;
SIG_GROUP_ 1025 CCFPayload0x66 1 : CcfACCAccelProfileSelect CcfACCLeadCarDistDisp CcfACCStopGapSelect CcfAdasDCR CcfAdasLongCRA CcfAdasLongRPC CcfAdasNCapCyclistAEB CcfAdasTJP CcfAutoHold CcfDSMFitment CcfESSCalNo CcfIntMirrorVariant CcfLaneKeepAssistLDW CcfLeftManoeuvringLgt CcfParkPawlLocation CcfPassHeatedCalfRest CcfPSMFitment CcfR2SMFitment CcfR3SMFitment CcfRghtManoeuvringLgt CcfRLSMFitment CcfRRSMFitment CcfSeatMassHanded;
SIG_GROUP_ 1025 CCFPayload0x67 1 : CcfARNCCalNo CcfASDExhaustCalNo CcfAVNCalNo CcfCDLGlobalClose CcfCDLGlobalOpen CcfCityUrbanAutoEmerBraking CcfCyCAutoEmerBraking CcfEOCCalNo CcfFrontBeltMinder CcfFrontPreCrashSunRoof CcfFwdCollisionWarn CcfIntelligentEmerBraking CcfJuncAutoEmerBraking CcfOverspeedIndia CcfPedAutoEmerBraking;
SIG_GROUP_ 1025 CCFPayload0x68 1 : CcfAutolampFastResponse CcfChargeFlap1 CcfChargeFlap2 CcfEOCExhaustCalNo CcfHeadlampWash CcfMemorySwitchType CcfRainSensorFitment CcfRCTAConfiguration CcfSeatSwitchPackPos CcfSMRFGlobalClose CcfWiperColdClimDLRWash CcfWiperCollarSwtchRnSenSeni CcfWiperDripWipeFeature CcfWiperFntSpeedDepend CcfWiperHdlmpWshPressure CcfWiperHeadlmpWashDLR CcfWiperInterSpdDepend CcfWiperProgramWipeActive CcfWiperRearContinue CcfWiperRrHlfMoonParkSwtch CcfWiperTwinWasherBottle CcfWiperUpStroke;
SIG_GROUP_ 1025 CCFPayload0x6B 1 : CcfActiveExhaustMap CcfClimateSeatSigType CcfCornerOnThreshold CcfDIFlashOnArmDisarm CcfDoubleLockingChirp CcfDriverConditionMon CcfHeadrestDrop CcfHVBattRegCompliance CcfNASTrailerLighting CcfOpenCloseRFKey CcfPreCrashWindowLift CcfRemoteConvRoofOperation CcfSecurityDIFlashOnErr CcfSecurityErrorTone CcfSmartEye CcfTailgateRemoteRel CcfTJAICAHOD CcfTripComputerUnitsWh CcfWindowPWMMode;
SIG_GROUP_ 1025 CCFPayload0x6F 1 : CcfAutoSSSelectInFCPB CcfDSCSelectInFCPB CcfHDCSelectInFCPB CcfRemoteWingMirrorFold CcfTerComSelectInFCPB CcfTerDynSelectInFCPB CcfTerECOSelectInFCPB;
SIG_GROUP_ 1025 CCFPayload0xB0 1 : CcfDD00GlobalRealTime CcfDD02MainECUSupVolts CcfDD06PowerModePKT;
SIG_GROUP_ 1025 CCFPayload0xB1 1 : CcfDD01TotalDistance CcfDD04InCarTemp CcfDD05OutdoorTemp;
SIG_GROUP_ 1566 XCPCalibrationSlaveDSM 1 : XcpCalibrationSlaveDSM;
SIG_GROUP_ 1568 XCPCalibrationSlavePSM 1 : XcpCalibrationSlavePSM;
